## CMakeLists.txt
```
# SPDX-License-Identifier: Apache-2.0

cmake_minimum_required(VERSION 3.13.1)

if(DEFINED ENV{MEMFAULT_ZEPHYR_EXTRA_MODULE_INCLUDE})
  list(APPEND ZEPHYR_EXTRA_MODULES $ENV{ZEPHYR_BASE}/../modules/memfault-firmware-sdk/ports)
endif()

# Required for app to compile against nRF Connect SDK <= v1.2
if(DEFINED ENV{MEMFAULT_INCLUDE_ZEPHYR_BOILERPLATE})
  include($ENV{ZEPHYR_BASE}/cmake/app/boilerplate.cmake NO_POLICY_SCOPE)
  include($ENV{ZEPHYR_BASE}/../nrf/cmake/boilerplate.cmake)
endif()

# Starting in nRF Connect SDK >= 1.3, versions are exposed in
# a CMake package:
#   https://github.com/nrfconnect/sdk-nrf/blob/master/share/ncs-package/cmake/NcsConfig.cmake
#
# We can pre-load the package before Zephyr to dynamically change Kconfig options based on version
# which is not something that can be achieved with Zephyr today
find_package(Ncs HINTS $ENV{ZEPHYR_BASE}/../nrf)

# Conditionally set Kconfig variables based on nRF Connect SDK version
# (since setting non-existent variables result in a build time error which
# would break compiling older builds)
#
# Zephyrs Kconfig extension pulls variables via the "CMake variable cache"
# so we set the ones we need here using that:
#   https://docs.zephyrproject.org/latest/guides/build/kconfig/setting.html#the-initial-configuration
if (NCS_VERSION_MAJOR)
  if (${NCS_VERSION_MAJOR} LESS_EQUAL 1 AND ${NCS_VERSION_MINOR} LESS 6 )
    # Required for logging to work from crash, deprecated in Zephyr included in NCS 1.6
    set(CONFIG_LOG_IMMEDIATE y CACHE INTERNAL "")
  elseif (${NCS_VERSION_MAJOR} LESS_EQUAL 1 AND ${NCS_VERSION_MINOR} GREATER_EQUAL 6 )
    set(CONFIG_MEMFAULT_NCS_PROVISION_CERTIFICATES n CACHE INTERNAL "")
    set(CONFIG_MEMFAULT_NCS_DEVICE_ID_RUNTIME y CACHE INTERNAL "")

    set(CONFIG_NEWLIB_LIBC y CACHE INTERNAL "")
  endif()

  # These were removed in NCS 1.9, but are needed prior to that.
  if (${NCS_VERSION_MAJOR} LESS_EQUAL 1 AND ${NCS_VERSION_MINOR} LESS 9 AND ${NCS_VERSION_PATCH} LESS 99)
    set(CONFIG_BSD_LIBRARY y CACHE INTERNAL "")
    set(CONFIG_BSD_LIBRARY_SYS_INIT n CACHE INTERNAL "")
    # ^ Note: CONFIG_BSD_ were renamed to _NRF_MODEM_ in
    # nRF Connect SDK v1.5. We use the legacy names for now
    # so this app can continue to compile on older targets
    #
    # CONFIG_NRF_MODEM_LIB
    # CONFIG_NRF_MODEM_LIB_SYS_INIT

    # For nRF Connect SDK v1.5 default value changed here
    set(CONFIG_AT_CMD_SYS_INIT n CACHE INTERNAL "")
  else()
    # in v1.9+, use the modem_info library to get the IMEI for device_serial
    set(CONFIG_MODEM_INFO y CACHE INTERNAL "")
  endif()
endif()

find_package(Zephyr HINTS $ENV{ZEPHYR_BASE})
project(hello_world)

target_sources(app PRIVATE src/main.c)
target_sources(app PRIVATE src/watchdog.c)
zephyr_include_directories(config)
```

## sample.yaml
```
sample:
  description: Memfault SDK example integration built on top of Hello
    World Sample App with the nRF Connect SDK
  name: Memfault Demo App
```

## west.yml
```
manifest:
  remotes:
    - name: nrf-connect-sdk
      url-base: https://github.com/nrfconnect
  projects:
    - name: sdk-nrf
      remote: nrf-connect-sdk
      path: nrf
      revision: v1.4.0
      import: true
    - name: memfault-firmware-sdk
      url: https://github.com/memfault/memfault-firmware-sdk
      path: modules/memfault-firmware-sdk
      revision: master
  self:
    path: memfault_demo_app
    import: submanifests
```

## prj.conf
```kconfig
# project specific configuration settings


CONFIG_NETWORKING=y
CONFIG_NET_SOCKETS=y
CONFIG_NET_SOCKETS_POSIX_NAMES=y
CONFIG_NET_NATIVE=n

CONFIG_HEAP_MEM_POOL_SIZE=4096
CONFIG_MAIN_STACK_SIZE=4096

CONFIG_MODEM_KEY_MGMT=y
CONFIG_LTE_LINK_CONTROL=y

CONFIG_SHELL=y
CONFIG_SHELL_BACKEND_SERIAL=y

CONFIG_NET_LOG=y

CONFIG_NET_SOCKETS_OFFLOAD=y
CONFIG_MEMFAULT=y
CONFIG_MEMFAULT_NRF_CONNECT_SDK=y
CONFIG_MEMFAULT_ROOT_CERT_STORAGE_NRF9160_MODEM=y
CONFIG_MEMFAULT_HTTP_ENABLE=y
CONFIG_MEMFAULT_HTTP_PERIODIC_UPLOAD=y

# Required for logging backends to work as expected
CONFIG_LOG=y
CONFIG_LOG_BACKEND_UART=y

# Enable capture of recent logs as part of a coredump
CONFIG_MEMFAULT_LOGGING_ENABLE=y

# Enable Bootloader so OTA updates can be performed
CONFIG_BOOTLOADER_MCUBOOT=y
CONFIG_MCUBOOT_IMG_MANAGER=y

# The subsystems we need so OTA payloads can be written to
# flash and updated by MCUBoot
CONFIG_DFU_TARGET=y
CONFIG_DFU_TARGET_MCUBOOT=y
CONFIG_IMG_MANAGER=y
CONFIG_FLASH=y
CONFIG_IMG_ERASE_PROGRESSIVELY=y

# For Memfault FOTA, we will use the FOTA_DOWNLOAD API's
# from the nRF Connect SDK which depends on the DOWNLOAD_CLIENT
CONFIG_FOTA_DOWNLOAD=y
CONFIG_DOWNLOAD_CLIENT=y

# Enable printing of file download progress to console
CONFIG_FOTA_DOWNLOAD_PROGRESS_EVT=y

# Off by default since a small patch is needed to nrf in order to enable
# as of the latest SDK release (nRF Connect SDK v1.4.x)
#  https://mflt.io/nrf-fota
#
# CONFIG_MEMFAULT_FOTA=y
# CONFIG_DOWNLOAD_CLIENT_MAX_FILENAME_SIZE=400
# CONFIG_DOWNLOAD_CLIENT_STACK_SIZE=1600
#
# Note: Can optionally be changed to =y to implement
# a custom event handler for FOTA events
# CONFIG_MEMFAULT_FOTA_DOWNLOAD_CALLBACK_CUSTOM=n

# For nRF Connect SDK's prior to v1.4
CONFIG_MEMFAULT_HTTP_MAX_POST_SIZE=256

# Manually bring up LTE stack
CONFIG_LTE_AUTO_INIT_AND_CONNECT=n

CONFIG_WATCHDOG=y

# Note: See ./CMakeLists.txt for additional Kconfig variables settings as not all variables can be
# set in a single prj.conf for backward compatibility with older versions of the nRF Connect SDK /
# Zephyr
```

## src/main.c
```c
//! @file
//!
//! Copyright (c) Memfault, Inc.
//! See License.txt for details
//!
//! Entry point to Memfault Radio. In this file you will find:
//!  1. Implementation for memfault_platform_get_device_info()
//!  2. g_mflt_http_client_config dependency which needs to be filled in with your Project Key
//!  3. A call to install the Root Certs used by Memfault on the nRF91 modem
//!     (memfault_nrfconnect_port_install_root_certs())
//!  4. Start of the LTE modem & AT interface

#include "memfault_demo_app.h"

#include <string.h>

#include <zephyr.h>
#include <device.h>
#include <sys/printk.h>

#include "memfault/core/build_info.h"
#include "memfault/core/compiler.h"
#include "memfault/core/math.h"
#include "memfault/core/platform/device_info.h"
#include "memfault/http/http_client.h"
#include "memfault/nrfconnect_port/http.h"
#include "memfault/ports/ncs/version.h"
#include <modem/modem_info.h>

// nRF Connect SDK < 1.3
#if (NCS_VERSION_MAJOR == 1) && (NCS_VERSION_MINOR < 3)

#include <lte_lc.h>
#include <at_cmd.h>
#include <at_notif.h>
#include <modem_key_mgmt.h>
#include <net/bsdlib.h>

// nRF Connect SDK < 1.9
#elif (NCS_VERSION_MAJOR == 1) && (NCS_VERSION_MINOR < 9) && (NCS_PATCHLEVEL < 99)

#include <modem/lte_lc.h>
#include <modem/at_cmd.h>
#include <modem/at_notif.h>
#include <modem/modem_key_mgmt.h>

// nRF Connect SDK >= 1.9
#else

#include <modem/lte_lc.h>
#include <nrf_modem_at.h>

#endif

#if (NCS_VERSION_MAJOR == 1) && (NCS_VERSION_MINOR <= 2)
#include <net/bsdlib.h>
static int prv_init_modem_lib(void) {
  return bsdlib_init();
}
#elif (NCS_VERSION_MAJOR == 1) && (NCS_VERSION_MINOR <= 4)
#include <modem/bsdlib.h>
static int prv_init_modem_lib(void) {
  return bsdlib_init();
}
#elif (NCS_VERSION_MAJOR == 1) && (NCS_VERSION_MINOR <= 5)
#include <modem/nrf_modem_lib.h>
static int prv_init_modem_lib(void) {
  return nrf_modem_lib_init(NORMAL_MODE);
}
#else /* nRF Connect SDK >= 1.6 */
#include "memfault_ncs.h"
#include <modem/nrf_modem_lib.h>
static int prv_init_modem_lib(void) {
  return nrf_modem_lib_init(NORMAL_MODE);
}
#endif

#if CONFIG_DFU_TARGET_MCUBOOT
#include <dfu/mcuboot.h>
#endif

// Since the example app manages when the modem starts/stops, we manually configure the device
// serial even when using nRF Connect SDKs including the Memfault integration (by using
// CONFIG_MEMFAULT_NCS_DEVICE_ID_RUNTIME)
#define IMEI_LEN 15
static char s_device_serial[IMEI_LEN + 1 /* '\0' */] = "unknown";

// A direct Memfault integration was added in 1.6
#if (NCS_VERSION_MAJOR == 1) && (NCS_VERSION_MINOR < 6)

// Note: Starting with nRF Connect SDK 1.6, there is a direct integration of Memfault
// and these dependencies are no longer needed!
// See https://mflt.io/nrf-connect-sdk-lib for more details

static char s_fw_version[16] = "1.0.0";

sMfltHttpClientConfig g_mflt_http_client_config = {
  .api_key = "<YOUR PROJECT KEY HERE>",
};

void memfault_platform_get_device_info(sMemfaultDeviceInfo *info) {
  // platform specific version information
  *info = (sMemfaultDeviceInfo) {
    .device_serial = s_device_serial,
    .software_type = "nrf91ns-fw",
    .software_version = s_fw_version,
    .hardware_version = "proto",
  };
}

// stub for function implemented in nRF Connect SDK >= 1.6
static int memfault_ncs_device_id_set(const char *device_id, size_t len) {
  return 0;
}

#endif

#if !MEMFAULT_NCS_VERSION_GT(1, 8)
static int query_modem(const char *cmd, char *buf, size_t buf_len) {
  enum at_cmd_state at_state;
  int ret = at_cmd_write(cmd, buf, buf_len, &at_state);
  if (ret != 0) {
    printk("at_cmd_write [%s] error: %d, at_state: %d\n", cmd, ret, at_state);
  }

  return ret;
}
#endif

static int prv_get_imei(char *buf, size_t buf_len) {
#if MEMFAULT_NCS_VERSION_GT(1, 8)
  // use the cached modem info to fetch the IMEI
  int err = modem_info_init();
  if (err != 0) {
    printk("Modem info Init error: %d\n", err);
  } else {
    modem_info_string_get(MODEM_INFO_IMEI, buf, buf_len);
  }
  return err;
#else
  // use an AT command to read IMEI
  return query_modem("AT+CGSN", buf, buf_len);
#endif
}

static void prv_init_device_info(void) {
  // we'll use the IMEI as the device serial
  char modem_info[MODEM_INFO_MAX_RESPONSE_SIZE];

  int ret = prv_get_imei(modem_info, sizeof(modem_info));
  if (ret != 0) {
    printk("Failed to get IMEI\n\r");
  } else {
    modem_info[IMEI_LEN] = '\0';
    strcpy(s_device_serial, modem_info);
    printk("IMEI: %s\n", s_device_serial);
  }

  // register the device id with memfault port so it is used for reporting
  memfault_ncs_device_id_set(s_device_serial, IMEI_LEN);
}

void main(void) {
  printk("Memfault Demo App Started!\n");

  memfault_demo_app_watchdog_boot();

#if CONFIG_DFU_TARGET_MCUBOOT
  if (!boot_is_img_confirmed()) {
    // Mark the ota image as installed so we don't revert
    printk("Confirming OTA update\n");
    boot_write_img_confirmed();
  }
#endif

  int err = prv_init_modem_lib();
  if (err) {
    printk("Failed to initialize modem!");
    return;
  }

  // These libraries were removed in ncs 1.9
#if !MEMFAULT_NCS_VERSION_GT(1, 8)
  err = at_cmd_init();
  if (err) {
    printk("Failed to initialize AT commands, err %d\n", err);
    return;
  }

  err = at_notif_init();
  if (err) {
    printk("Failed to initialize AT notifications, err %d\n", err);
    return;
  }
#endif

  // requires AT modem interface to be up
  prv_init_device_info();

  // Note: We must provision certs prior to connecting to the LTE network
  // in order to use them
  err = memfault_nrfconnect_port_install_root_certs();
  if (err) {
    return;
  }

  printk("Waiting for network...\n");
  err = lte_lc_init_and_connect();
  if (err) {
    printk("Failed to connect to the LTE network, err %d\n", err);
    return;
  }
  printk("OK\n");
}
```

## src/memfault_demo_app.h
```c
#pragma once

//! @file
//!
//! Copyright (c) Memfault, Inc.
//! See License.txt for details

//! Start watchdog subsystem for demo application
void memfault_demo_app_watchdog_boot(void);

//! Reset watchdog timeout for application
void memfault_demo_app_watchdog_feed(void);
```

## src/watchdog.c
```c
//! @file
//!
//! Copyright (c) Memfault, Inc.
//! See License.txt for details
//!
//! Example configuration of Zephyr hardware watchdog with Memfault software watchdog
//! port such that a coredump is captured ahead of the hardware watchdog firing

#include <zephyr.h>
#include <device.h>
#include <version.h>

#include <drivers/watchdog.h>

#include "memfault/core/debug_log.h"
#include "memfault/ports/watchdog.h"

//! Note: The timeout must be large enough to give us enough time to capture a coredump
//! before the system resets
#define MEMFAULT_WATCHDOG_HW_TIMEOUT_SECS (MEMFAULT_WATCHDOG_SW_TIMEOUT_SECS + 10)

#define WDT_MAX_WINDOW  (MEMFAULT_WATCHDOG_HW_TIMEOUT_SECS * 1000)

#define WATCHDOG_TASK_STACK_SIZE 512
K_THREAD_STACK_DEFINE(s_wdt_task_stack_area, WATCHDOG_TASK_STACK_SIZE);
struct k_thread my_thread_data;

#if KERNEL_VERSION_MAJOR == 2 && KERNEL_VERSION_MINOR < 2
static struct device *s_wdt = NULL;
#else
static const struct device *s_wdt = NULL;
#endif

#if KERNEL_VERSION_MAJOR == 2 && KERNEL_VERSION_MINOR < 3
#define WDT_DEV_NAME DT_WDT_0_NAME
#else
#define WDT_NODE DT_INST(0, nordic_nrf_watchdog)
#define WDT_DEV_NAME DT_LABEL(WDT_NODE)
#endif

static int s_wdt_channel_id = -1;

void memfault_demo_app_watchdog_feed(void) {
  if ((s_wdt == NULL) || (s_wdt_channel_id < 0)) {
    return;
  }

  wdt_feed(s_wdt, s_wdt_channel_id);
  memfault_software_watchdog_feed();
}

//! A basic watchdog implementation
//!
//! Once Zephyr has a Software & Task watchdog in place, the example will be updated to make use of that
//! For more info about watchdog setup in general, see https://mflt.io/root-cause-watchdogs
static void prv_wdt_task(void *arg1, void *arg2, void *arg3) {
  while (1) {
    k_sleep(K_SECONDS(1));

    memfault_demo_app_watchdog_feed();
  }
}

void memfault_demo_app_watchdog_boot(void) {
  MEMFAULT_LOG_DEBUG("Initializing WDT Subsystem");

  s_wdt = device_get_binding(WDT_DEV_NAME);
  if (s_wdt == NULL) {
    printk("No WDT device available\n");
    return;
  }

  struct wdt_timeout_cfg wdt_config = {
    /* Reset SoC when watchdog timer expires. */
    .flags = WDT_FLAG_RESET_SOC,

    /* Expire watchdog after max window */
    .window.min = 0U,
    .window.max = WDT_MAX_WINDOW,
  };

  s_wdt_channel_id = wdt_install_timeout(s_wdt, &wdt_config);
  if (s_wdt_channel_id < 0) {
    MEMFAULT_LOG_ERROR("Watchdog install error, rv=%d", s_wdt_channel_id);
    return;
  }

  const uint8_t options = WDT_OPT_PAUSE_HALTED_BY_DBG;
  int err = wdt_setup(s_wdt, options);
  if (err < 0) {
    MEMFAULT_LOG_ERROR("Watchdog setup error, rv=%d", err);
    return;
  }

  // start a low priority task that feeds the watchdog.
  // We make it the lowest priority so a hot loop in any task above will
  // cause the watchdog to not be fed
  memfault_software_watchdog_enable();
  k_thread_create(&my_thread_data, s_wdt_task_stack_area,
                  K_THREAD_STACK_SIZEOF(s_wdt_task_stack_area),
                  prv_wdt_task,
                  NULL, NULL, NULL,
                  K_LOWEST_APPLICATION_THREAD_PRIO, 0, K_NO_WAIT);
}
```
