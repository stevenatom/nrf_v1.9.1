## CMakeLists.txt
```
cmake_minimum_required(VERSION 3.13.1)
include($ENV{ZEPHYR_BASE}/cmake/app/boilerplate.cmake NO_POLICY_SCOPE)
project(shell)

target_sources(app PRIVATE src/main.c)
```

## sample.yaml
```
sample:
  name: zscilib shell example
tests:
  test:
    tags: zscilib colorimetry
    # The filters below are from DTS
    filter: LED0_GPIO_CONTROLLER
    depends_on: gpio
```

## prj.conf
```kconfig
CONFIG_PRINTK=y
CONFIG_SERIAL=y
CONFIG_CBPRINTF_FP_SUPPORT=y
CONFIG_STDOUT_CONSOLE=y

CONFIG_NEWLIB_LIBC=y
CONFIG_NEWLIB_LIBC_FLOAT_PRINTF=y

CONFIG_FPU=y

CONFIG_SHELL=y
CONFIG_SHELL_HISTORY=y
CONFIG_SHELL_VT100_COLORS=y

CONFIG_ZSL=y
CONFIG_ZSL_SHELL=y
CONFIG_ZSL_SHELL_CLR=y
CONFIG_ZSL_SHELL_ORIENT=y

# Allow out of gamut RGBF value overflow
CONFIG_ZSL_CLR_RGBF_BOUND_CAP=n
```

## src/main.c
```c
/*
 * Copyright (c) 2019 Kevin Townsend
 *
 * SPDX-License-Identifier: Apache-2.0
 */

#include <zephyr.h>
#include <sys/printk.h>
#include <zsl/colorimetry.h>

void main(void)
{
	printk("zscilib     : %s\n", zsl_version);
	printk("\nType 'help' for command options.\n");

	while (1) {
		k_sleep(K_FOREVER);
	}
}
```
