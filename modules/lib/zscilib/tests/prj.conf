## CMakeLists.txt
```
cmake_minimum_required(VERSION 3.13.1)
include($ENV{ZEPHYR_BASE}/cmake/app/boilerplate.cmake NO_POLICY_SCOPE)
project(zsl)

zephyr_include_directories(app PRIVATE $ENV{ZEPHYR_BASE}/kernel/include/)

FILE(GLOB app_sources src/*.c)
target_sources(app PRIVATE ${app_sources})
```

## prj.conf
```kconfig
CONFIG_ZTEST=y
CONFIG_FPU=y
CONFIG_NEWLIB_LIBC=y
CONFIG_ZSL=y
CONFIG_ZTEST_STACKSIZE=16384

# k_malloc requires heap mem allocation (cubic spine interp, etc.)
CONFIG_HEAP_MEM_POOL_SIZE=1024
```

## src/calibration_tests.c
```c
/*
 * Copyright (c) 2021 Kevin Townsend
 *
 * SPDX-License-Identifier: Apache-2.0
 */

#include <ztest.h>
#include <zsl/zsl.h>
#include <zsl/orientation/fusion/calibration.h>
#include "floatcheck.h"

void test_fus_cal_rot_mtx(void)
{
	int rc = 0;

	ZSL_VECTOR_DEF(v, 3);
	ZSL_VECTOR_DEF(v2, 4);
	ZSL_VECTOR_DEF(w, 3);
	ZSL_VECTOR_DEF(w2, 4);
	ZSL_MATRIX_DEF(m, 3, 3);
	ZSL_MATRIX_DEF(m2, 4, 3);
	ZSL_MATRIX_DEF(m3, 3, 4);

	zsl_real_t a[3] = { 1.0, 3.0, -2.0 };
	zsl_real_t b[9] = {
		-0.07407397629608892, 0.2592592572432197, 0.9629629710271213,
		0.8518518296753963, 0.5185185417029887, -0.07407416681195528,
		-0.5185185689195382, 0.8148148007025278, -0.2592592028101106
	};

	/* Assign arrays to vectors and matrices. */
	rc = zsl_vec_from_arr(&v, a);
	zassert_true(rc == 0, NULL);
	rc = zsl_mtx_from_arr(&m, b);
	zassert_true(rc == 0, NULL);

	/* Rotate the vector v using the matrix m. */
	rc = zsl_fus_cal_rot_mtx(&v, &m, &w);
	zassert_true(rc == 0, NULL);
	zassert_true(val_is_equal(w.data[0], -1.222222, 1E-6), NULL);
	zassert_true(val_is_equal(w.data[1], 2.555556, 1E-6), NULL);
	zassert_true(val_is_equal(w.data[2], 2.444444, 1E-6), NULL);

	/* Special cases where inputs are invalid. */
	rc = zsl_fus_cal_rot_mtx(&v2, &m, &w);
	zassert_true(rc == -EINVAL, NULL);
	rc = zsl_fus_cal_rot_mtx(&v, &m2, &w);
	zassert_true(rc == -EINVAL, NULL);
	rc = zsl_fus_cal_rot_mtx(&v, &m3, &w);
	zassert_true(rc == -EINVAL, NULL);
	rc = zsl_fus_cal_rot_mtx(&v, &m, &w2);
	zassert_true(rc == -EINVAL, NULL);
}

void test_fus_cal_rot_axis_angle(void)
{
	int rc = 0;

	ZSL_VECTOR_DEF(v, 3);
	ZSL_VECTOR_DEF(v2, 4);
	ZSL_VECTOR_DEF(w, 3);
	ZSL_VECTOR_DEF(w2, 4);
	ZSL_VECTOR_DEF(a, 3);
	ZSL_VECTOR_DEF(a2, 4);

	zsl_real_t b = 1.3;

	zsl_real_t c[3] = { 1.0, 3.0, -2.0 };
	zsl_real_t d[3] = { -1.0, 3.1, 12.8 };

	/* Assign arrays to vectors and matrices. */
	rc = zsl_vec_from_arr(&v, c);
	zassert_true(rc == 0, NULL);
	rc = zsl_vec_from_arr(&a, d);
	zassert_true(rc == 0, NULL);

	/* Rotate the vector v using the axis a and angle b. */
	rc = zsl_fus_cal_rot_axis_angle(&v, &a, &b, &w);
	zassert_true(rc == 0, NULL);
	zassert_true(val_is_equal(w.data[0], -2.913558, 1E-6), NULL);
	zassert_true(val_is_equal(w.data[1], 1.365200, 1E-6), NULL);
	zassert_true(val_is_equal(w.data[2], -1.909819, 1E-6), NULL);

	/* Special cases where inputs are invalid. */
	rc = zsl_fus_cal_rot_axis_angle(&v2, &a, &b, &w);
	zassert_true(rc == -EINVAL, NULL);
	rc = zsl_fus_cal_rot_axis_angle(&v, &a2, &b, &w);
	zassert_true(rc == -EINVAL, NULL);
	rc = zsl_fus_cal_rot_axis_angle(&v, &a, &b, &w2);
	zassert_true(rc == -EINVAL, NULL);
}

#ifndef CONFIG_ZSL_SINGLE_PRECISION
void test_fus_cal_magn(void)
{
	int rc = 0;

	ZSL_MATRIX_DEF(m, 12, 3);
	ZSL_MATRIX_DEF(m2, 12, 4);
	ZSL_MATRIX_DEF(K, 3, 3);
	ZSL_MATRIX_DEF(K2, 3, 7);
	ZSL_MATRIX_DEF(K3, 1, 3);
	ZSL_VECTOR_DEF(b, 3);
	ZSL_VECTOR_DEF(b2, 12);

	zsl_real_t l = 1.0;
	zsl_real_t mu = 10.0, mu2 = 0.25;

	zsl_real_t a[36] = {
		2.0,  4.0, -5.0,
		1.1,  8.3,  9.9,
		-0.4, -6.6,  3.4,
		1.5, -6.9,  0.1,
		0.0, -2.5, -9.8,
		1.2,  3.8, -0.9,
		6.1, -4.3,  8.8,
		-7.6, -0.9,  2.9,
		5.0,  7.1,  1.0,
		0.0, -4.7,  0.2,
		4.3,  0.0,  5.7,
		-9.0, -2.8,  7.3
	};

	/* Assign arrays to matrices. */
	rc = zsl_mtx_from_arr(&m, a);
	zassert_true(rc == 0, NULL);

	/* Compute the ellipsoid fitting. */
	rc = zsl_fus_cal_magn(&m, &l, &mu, &K, &b);
	zassert_true(rc == 0, NULL);
	zassert_true(val_is_equal(K.data[0], 0.600621, 1E-6), NULL);
	zassert_true(val_is_equal(K.data[1], -0.610451, 1E-6), NULL);
	zassert_true(val_is_equal(K.data[2], -0.318351, 1E-6), NULL);
	zassert_true(val_is_equal(K.data[3], -0.610451, 1E-6), NULL);
	zassert_true(val_is_equal(K.data[4], 1.968980, 1E-6), NULL);
	zassert_true(val_is_equal(K.data[5], 0.152699, 1E-6), NULL);
	zassert_true(val_is_equal(K.data[6], -0.318351, 1E-6), NULL);
	zassert_true(val_is_equal(K.data[7], 0.152699, 1E-6), NULL);
	zassert_true(val_is_equal(K.data[8], 2.868776, 1E-6), NULL);

	zassert_true(val_is_equal(b.data[0], -1.211677, 1E-6), NULL);
	zassert_true(val_is_equal(b.data[1], -1.842987, 1E-6), NULL);
	zassert_true(val_is_equal(b.data[2], 0.087542, 1E-6), NULL);

	/* Special cases where inputs are invalid. */
	rc = zsl_fus_cal_magn(&m2, &l, &mu, &K, &b);
	zassert_true(rc == -EINVAL, NULL);
	rc = zsl_fus_cal_magn(&m, &l, &mu2, &K, &b);
	zassert_true(rc == -EINVAL, NULL);
	rc = zsl_fus_cal_magn(&m, &l, &mu, &K2, &b);
	zassert_true(rc == -EINVAL, NULL);
	rc = zsl_fus_cal_magn(&m, &l, &mu, &K3, &b);
	zassert_true(rc == -EINVAL, NULL);
	rc = zsl_fus_cal_magn(&m, &l, &mu, &K, &b2);
	zassert_true(rc == -EINVAL, NULL);
}
#endif

#ifndef CONFIG_ZSL_SINGLE_PRECISION
void test_fus_cal_magn_fast(void)
{
	int rc = 0;

	ZSL_MATRIX_DEF(m, 12, 3);
	ZSL_MATRIX_DEF(m2, 12, 4);
	ZSL_MATRIX_DEF(K, 3, 3);
	ZSL_MATRIX_DEF(K2, 3, 7);
	ZSL_MATRIX_DEF(K3, 1, 3);
	ZSL_VECTOR_DEF(b, 3);
	ZSL_VECTOR_DEF(b2, 12);

	zsl_real_t me = 44.3867, me2 = -7.0;

	zsl_real_t a[36] = {
		2.0,  4.0, -5.0,
		1.1,  8.3,  9.9,
		-0.4, -6.6,  3.4,
		1.5, -6.9,  0.1,
		0.0, -2.5, -9.8,
		1.2,  3.8, -0.9,
		6.1, -4.3,  8.8,
		-7.6, -0.9,  2.9,
		5.0,  7.1,  1.0,
		0.0, -4.7,  0.2,
		4.3,  0.0,  5.7,
		-9.0, -2.8,  7.3
	};

	/* Assign arrays to matrices. */
	rc = zsl_mtx_from_arr(&m, a);
	zassert_true(rc == 0, NULL);

	/* Compute the magnetometer data fitting. */
	rc = zsl_fus_cal_magn_fast(&m, &me, &K, &b);
	zassert_true(rc == 0, NULL);
	zassert_true(val_is_equal(K.data[0], 5.685746, 1E-6), NULL);
	zassert_true(val_is_equal(K.data[1], 0.091864, 1E-6), NULL);
	zassert_true(val_is_equal(K.data[2], 0.870620, 1E-6), NULL);
	zassert_true(val_is_equal(K.data[3], 0.000000, 1E-6), NULL);
	zassert_true(val_is_equal(K.data[4], 6.375517, 1E-6), NULL);
	zassert_true(val_is_equal(K.data[5], -0.588939, 1E-6), NULL);
	zassert_true(val_is_equal(K.data[6], 0.000000, 1E-6), NULL);
	zassert_true(val_is_equal(K.data[7], 0.000000, 1E-6), NULL);
	zassert_true(val_is_equal(K.data[8], 2.783505, 1E-6), NULL);

	zassert_true(val_is_equal(b.data[0], 1.088338, 1E-6), NULL);
	zassert_true(val_is_equal(b.data[1], -0.900774, 1E-6), NULL);
	zassert_true(val_is_equal(b.data[2], -7.088266, 1E-6), NULL);

	/* Special cases where inputs are invalid. */
	rc = zsl_fus_cal_magn_fast(&m2, &me, &K, &b);
	zassert_true(rc == -EINVAL, NULL);
	rc = zsl_fus_cal_magn_fast(&m, &me2, &K, &b);
	zassert_true(rc == -EINVAL, NULL);
	rc = zsl_fus_cal_magn_fast(&m, &me, &K2, &b);
	zassert_true(rc == -EINVAL, NULL);
	rc = zsl_fus_cal_magn_fast(&m, &me, &K3, &b);
	zassert_true(rc == -EINVAL, NULL);
	rc = zsl_fus_cal_magn_fast(&m, &me, &K, &b2);
	zassert_true(rc == -EINVAL, NULL);
}
#endif

void test_fus_cal_corr_scalar(void)
{
	int rc = 0;

	zsl_real_t d, k, b, d_out;

	d = 3.5;
	k = 4.2;
	b = -2.1;

	/* Apply the correction. */
	rc = zsl_fus_cal_corr_scalar(&d, &k, &b, &d_out);
	zassert_true(val_is_equal(d_out, 5.88, 1E-6), NULL);
}

void test_fus_cal_corr_vec(void)
{
	int rc = 0;

	ZSL_MATRIX_DEF(K, 3, 3);
	ZSL_MATRIX_DEF(K2, 3, 7);
	ZSL_MATRIX_DEF(K3, 1, 3);
	ZSL_VECTOR_DEF(b, 3);
	ZSL_VECTOR_DEF(b2, 6);
	ZSL_VECTOR_DEF(v, 3);
	ZSL_VECTOR_DEF(v2, 1);
	ZSL_VECTOR_DEF(v_out, 3);
	ZSL_VECTOR_DEF(v_out2, 2);

	zsl_real_t a[9] = {
		0.99, 0.12, 0.01,
		0.12, 0.87, 0.09,
		0.01, 0.09, 0.92
	};

	zsl_real_t c[3] = { 1.2, -4.9, 5.7 };
	zsl_real_t d[3] = { 0.8, 1.2, 5.4 };

	/* Assign arrays to vectors and matrices. */
	rc = zsl_mtx_from_arr(&K, a);
	zassert_true(rc == 0, NULL);
	rc = zsl_vec_from_arr(&b, c);
	zassert_true(rc == 0, NULL);
	rc = zsl_vec_from_arr(&v, d);
	zassert_true(rc == 0, NULL);

	/* Correct the magnetometer data. */
	rc = zsl_fus_cal_corr_vec(&v, &K, &b, &v_out);
	zassert_true(rc == 0, NULL);
	zassert_true(val_is_equal(v_out.data[0], 1.647000, 1E-6), NULL);
	zassert_true(val_is_equal(v_out.data[1], -1.980000, 1E-6), NULL);
	zassert_true(val_is_equal(v_out.data[2], 9.899000, 1E-6), NULL);

	/* Special cases where inputs are invalid. */
	rc = zsl_fus_cal_corr_vec(&v2, &K, &b, &v_out);
	zassert_true(rc == -EINVAL, NULL);
	rc = zsl_fus_cal_corr_vec(&v, &K2, &b, &v_out);
	zassert_true(rc == -EINVAL, NULL);
	rc = zsl_fus_cal_corr_vec(&v, &K3, &b, &v_out);
	zassert_true(rc == -EINVAL, NULL);
	rc = zsl_fus_cal_corr_vec(&v, &K, &b2, &v_out);
	zassert_true(rc == -EINVAL, NULL);
	rc = zsl_fus_cal_corr_vec(&v, &K, &b, &v_out2);
	zassert_true(rc == -EINVAL, NULL);
}

void test_fus_cal_madg(void)
{
	int rc = 0;

	ZSL_MATRIX_DEF(g, 12, 3);
	ZSL_MATRIX_DEF(g2, 12, 7);
	ZSL_MATRIX_DEF(g3, 14, 3);
	ZSL_MATRIX_DEF(a, 12, 3);
	ZSL_MATRIX_DEF(a2, 12, 1);
	ZSL_MATRIX_DEF(a3, 3, 3);
	ZSL_MATRIX_DEF(m, 12, 3);
	ZSL_MATRIX_DEF(m2, 12, 9);
	ZSL_MATRIX_DEF(m3, 20, 3);

	zsl_real_t beta;

	zsl_real_t datg[36] = {
		-0.060000,  0.130000, -0.060000,
		-0.190000, -0.130000,  0.060000,
		-0.060000,  0.130000,  0.060000,
		-0.060000,  0.190000,  0.130000,
		0.000000,  0.000000,  0.130000,
		0.000000,  0.130000,  0.130000,
		-0.190000,  0.130000,  0.130000,
		-0.060000,  0.130000,  0.060000,
		-0.130000,  0.250000,  0.000000,
		-0.060000,  0.000000,  0.130000,
		0.060000,  0.190000,  0.130000,
		-0.190000, -0.060000,  0.130000
	};

	zsl_real_t data[36] = {
		-38.690000, 5.120000, -59.190000,
		-39.380000, 5.870000, -59.190000,
		-37.940000, 5.870000, -59.190000,
		-39.380000, 5.870000, -60.380000,
		-36.810000, 5.500000, -59.190000,
		-40.500000, 5.870000, -59.560000,
		-38.310000, 5.870000, -59.940000,
		-36.810000, 6.620000, -60.750000,
		-38.690000, 7.000000, -60.000000,
		-38.690000, 7.000000, -58.440000,
		-37.560000, 6.620000, -59.190000,
		-37.940000, 7.000000, -58.000000
	};

	zsl_real_t datm[36] = {
		-0.200000, 0.050000, 10.090000,
		-0.170000, 0.030000, 10.090000,
		-0.190000, 0.010000, 10.120000,
		-0.190000, 0.060000, 10.080000,
		-0.210000, 0.080000, 10.080000,
		-0.190000, 0.040000, 10.080000,
		-0.190000, 0.040000, 10.130000,
		-0.180000, 0.050000, 10.110000,
		-0.190000, 0.050000, 10.100000,
		-0.200000, 0.030000, 10.070000,
		-0.190000, 0.060000, 10.080000,
		-0.180000, 0.030000, 10.100000
	};

	/* Assign arrays to matrices. */
	rc = zsl_mtx_from_arr(&g, datg);
	zassert_true(rc == 0, NULL);
	rc = zsl_mtx_from_arr(&a, data);
	zassert_true(rc == 0, NULL);
	rc = zsl_mtx_from_arr(&m, datm);
	zassert_true(rc == 0, NULL);

	/* Calculate the value of beta. */
	rc = zsl_fus_cal_madg(&g, &a, &m, 100.0, NULL, &beta);
	zassert_true(rc == 0, NULL);
	zassert_true(val_is_equal(beta, 0.999, 1E-6), NULL);

	/* Special cases where inputs are invalid. */
	rc = zsl_fus_cal_madg(&g, &a, &m, -100.0, NULL, &beta);
	zassert_true(rc == -EINVAL, NULL);
	rc = zsl_fus_cal_madg(&g2, &a, &m, 100.0, NULL, &beta);
	zassert_true(rc == -EINVAL, NULL);
	rc = zsl_fus_cal_madg(&g, &a2, &m, 100.0, NULL, &beta);
	zassert_true(rc == -EINVAL, NULL);
	rc = zsl_fus_cal_madg(&g, &a, &m2, 100.0, NULL, &beta);
	zassert_true(rc == -EINVAL, NULL);
	rc = zsl_fus_cal_madg(&g3, &a, &m, 100.0, NULL, &beta);
	zassert_true(rc == -EINVAL, NULL);
	rc = zsl_fus_cal_madg(&g, &a3, &m, 100.0, NULL, &beta);
	zassert_true(rc == -EINVAL, NULL);
	rc = zsl_fus_cal_madg(&g, &a, &m3, 100.0, NULL, &beta);
	zassert_true(rc == -EINVAL, NULL);
}

void test_fus_cal_mahn(void)
{
	int rc = 0;

	ZSL_MATRIX_DEF(g, 12, 3);
	ZSL_MATRIX_DEF(g2, 12, 7);
	ZSL_MATRIX_DEF(g3, 14, 3);
	ZSL_MATRIX_DEF(a, 12, 3);
	ZSL_MATRIX_DEF(a2, 12, 1);
	ZSL_MATRIX_DEF(a3, 3, 3);
	ZSL_MATRIX_DEF(m, 12, 3);
	ZSL_MATRIX_DEF(m2, 12, 9);
	ZSL_MATRIX_DEF(m3, 20, 3);

	zsl_real_t kp;

	zsl_real_t datg[36] = {
		-0.060000,  0.130000, -0.060000,
		-0.190000, -0.130000,  0.060000,
		-0.060000,  0.130000,  0.060000,
		-0.060000,  0.190000,  0.130000,
		0.000000,  0.000000,  0.130000,
		0.000000,  0.130000,  0.130000,
		-0.190000,  0.130000,  0.130000,
		-0.060000,  0.130000,  0.060000,
		-0.130000,  0.250000,  0.000000,
		-0.060000,  0.000000,  0.130000,
		0.060000,  0.190000,  0.130000,
		-0.190000, -0.060000,  0.130000
	};

	zsl_real_t data[36] = {
		-38.690000, 5.120000, -59.190000,
		-39.380000, 5.870000, -59.190000,
		-37.940000, 5.870000, -59.190000,
		-39.380000, 5.870000, -60.380000,
		-36.810000, 5.500000, -59.190000,
		-40.500000, 5.870000, -59.560000,
		-38.310000, 5.870000, -59.940000,
		-36.810000, 6.620000, -60.750000,
		-38.690000, 7.000000, -60.000000,
		-38.690000, 7.000000, -58.440000,
		-37.560000, 6.620000, -59.190000,
		-37.940000, 7.000000, -58.000000
	};

	zsl_real_t datm[36] = {
		-0.200000, 0.050000, 10.090000,
		-0.170000, 0.030000, 10.090000,
		-0.190000, 0.010000, 10.120000,
		-0.190000, 0.060000, 10.080000,
		-0.210000, 0.080000, 10.080000,
		-0.190000, 0.040000, 10.080000,
		-0.190000, 0.040000, 10.130000,
		-0.180000, 0.050000, 10.110000,
		-0.190000, 0.050000, 10.100000,
		-0.200000, 0.030000, 10.070000,
		-0.190000, 0.060000, 10.080000,
		-0.180000, 0.030000, 10.100000
	};

	/* Assign arrays to matrices. */
	rc = zsl_mtx_from_arr(&g, datg);
	zassert_true(rc == 0, NULL);
	rc = zsl_mtx_from_arr(&a, data);
	zassert_true(rc == 0, NULL);
	rc = zsl_mtx_from_arr(&m, datm);
	zassert_true(rc == 0, NULL);

	/* Calculate the value of kp. */
	rc = zsl_fus_cal_mahn(&g, &a, &m, 100.0, NULL, &kp);
	zassert_true(rc == 0, NULL);
	zassert_true(val_is_equal(kp, 0.999, 1E-6), NULL);

	/* Special cases where inputs are invalid. */
	rc = zsl_fus_cal_mahn(&g, &a, &m, -100.0, NULL, &kp);
	zassert_true(rc == -EINVAL, NULL);
	rc = zsl_fus_cal_mahn(&g2, &a, &m, 100.0, NULL, &kp);
	zassert_true(rc == -EINVAL, NULL);
	rc = zsl_fus_cal_mahn(&g, &a2, &m, 100.0, NULL, &kp);
	zassert_true(rc == -EINVAL, NULL);
	rc = zsl_fus_cal_mahn(&g, &a, &m2, 100.0, NULL, &kp);
	zassert_true(rc == -EINVAL, NULL);
	rc = zsl_fus_cal_mahn(&g3, &a, &m, 100.0, NULL, &kp);
	zassert_true(rc == -EINVAL, NULL);
	rc = zsl_fus_cal_mahn(&g, &a3, &m, 100.0, NULL, &kp);
	zassert_true(rc == -EINVAL, NULL);
	rc = zsl_fus_cal_mahn(&g, &a, &m3, 100.0, NULL, &kp);
	zassert_true(rc == -EINVAL, NULL);
}
```

## src/clr_conv.c
```c
/*
 * Copyright (c) 2019-2020 Kevin Townsend (KTOWN)
 *
 * SPDX-License-Identifier: Apache-2.0
 */

#include <ztest.h>
#include <sys/printk.h>
#include <zsl/colorimetry.h>
#include "floatcheck.h"
#include "data.h"

void
test_conv_spd_xyz(void)
{
	int rc;
	struct zsl_clr_xyz xyz;

	rc = zsl_clr_conv_spd_xyz(&zsl_clr_test_spd_5983k, ZSL_CLR_OBS_2_DEG, &xyz);
	zassert_true(rc == 0, NULL);
	zassert_true(val_is_equal(xyz.xyz_x, 0.9516492, 1E-5), NULL);
	zassert_true(val_is_equal(xyz.xyz_y, 1.0, 1E-5), NULL);
	zassert_true(val_is_equal(xyz.xyz_z, 1.0056107, 1E-5), NULL);
	zassert_true(xyz.observer == ZSL_CLR_OBS_2_DEG, NULL);
	zassert_false(xyz.x_invalid, NULL);
	zassert_false(xyz.y_invalid, NULL);
	zassert_false(xyz.z_invalid, NULL);
}

void
test_conv_ct_xyz(void)
{
	int rc;
	struct zsl_clr_xyz xyz;

	memset(&xyz, 0, sizeof xyz);

	rc = zsl_clr_conv_ct_xyz(5600.0, ZSL_CLR_OBS_2_DEG, &xyz);
	zassert_true(rc == 0, NULL);
	zassert_true(val_is_equal(xyz.xyz_x, 0.9738203, 1E-6), NULL);
	zassert_true(val_is_equal(xyz.xyz_y, 1.0, 1E-6), NULL);
	zassert_true(val_is_equal(xyz.xyz_z, 0.9751908, 1E-6), NULL);
	zassert_true(xyz.observer == ZSL_CLR_OBS_2_DEG, NULL);
	zassert_false(xyz.x_invalid, NULL);
	zassert_false(xyz.y_invalid, NULL);
	zassert_false(xyz.z_invalid, NULL);
}

void
test_conv_ct_rgb8(void)
{
	int rc;
	struct zsl_clr_rgb8 rgb;
	struct zsl_mtx *srgb_ccm;

	/* Get sRGB D65 correlation matrix for testing. */
	zsl_clr_rgbccm_get(ZSL_CLR_RGB_CCM_SRGB_D65, &srgb_ccm);

	memset(&rgb, 0, sizeof rgb);

	rc = zsl_clr_conv_ct_rgb8(5600.0, ZSL_CLR_OBS_2_DEG, srgb_ccm, &rgb);
	zassert_true(rc == 0, NULL);
	zassert_true(rgb.r == 255, NULL);
	zassert_true(rgb.g == 248, NULL);
	zassert_true(rgb.b == 224, NULL);
	zassert_true(rgb.a == 255, NULL);
	zassert_true(rgb.r_invalid, NULL);  /* R is out of gamut! */
	zassert_false(rgb.g_invalid, NULL);
	zassert_false(rgb.b_invalid, NULL);
	zassert_false(rgb.a_invalid, NULL);
}

void
test_conv_cct_xyy(void)
{
	int rc;
	struct zsl_clr_cct cct;
	struct zsl_clr_xyy xyy;

	memset(&cct, 0, sizeof cct);
	memset(&xyy, 0, sizeof xyy);

	/* Test 1: Set the test CCT to 2900K (Duv 0.0) */
	cct.cct = 2900.0;
	cct.duv = 0.0;

	rc = zsl_clr_conv_cct_xyy(&cct, ZSL_CLR_OBS_2_DEG, &xyy);
	zassert_true(rc == 0, NULL);

	/* Check the xyY output to the sixth decimal place. */
	/* 2900 CCT = xyY (0.4442166, 0.4064293, 1.000000) w/5 nm lookup. */
	zassert_true(val_is_equal(xyy.xyy_x, 0.4442166, 1E-6), NULL);
	zassert_true(val_is_equal(xyy.xyy_y, 0.4064293, 1E-6), NULL);
	zassert_true(xyy.xyy_Y == 1.0, NULL);
	zassert_true(xyy.observer == ZSL_CLR_OBS_2_DEG, NULL);
	zassert_false(xyy.x_invalid, NULL);
	zassert_false(xyy.y_invalid, NULL);
	zassert_false(xyy.Y_invalid, NULL);

	/* Test 2: Set the test CCT to 2938K with a Duv of -0.00082 */
	cct.cct = 2938.0;
	cct.duv = -0.00082;

	rc = zsl_clr_conv_cct_xyy(&cct, ZSL_CLR_OBS_2_DEG, &xyy);
	zassert_true(rc == 0, NULL);

	/* Check the xyY output to the third or sixth decimal place.
	 *
	 * With a precision lookup (calculated externally) we get:
	 *
	 *     xyY (0.4401769103, 0.4030829267, 1.000000)
	 */
#if CONFIG_ZSL_SINGLE_PRECISION
	zassert_true(val_is_equal(xyy.xyy_x, 0.4399290, 1E-3), NULL);
	zassert_true(val_is_equal(xyy.xyy_y, 0.4030270, 1E-3), NULL);
#else
	zassert_true(val_is_equal(xyy.xyy_x, 0.4401715, 1E-6), NULL);
	zassert_true(val_is_equal(xyy.xyy_y, 0.4030739, 1E-6), NULL);
#endif
	zassert_true(xyy.xyy_Y == 1.0, NULL);
	zassert_true(xyy.observer == ZSL_CLR_OBS_2_DEG, NULL);
	zassert_false(xyy.x_invalid, NULL);
	zassert_false(xyy.y_invalid, NULL);
	zassert_false(xyy.Y_invalid, NULL);
}

void
test_conv_cct_xyz(void)
{
	int rc;
	struct zsl_clr_cct cct;
	struct zsl_clr_xyz xyz;

	memset(&cct, 0, sizeof cct);
	memset(&xyz, 0, sizeof xyz);

	/* Test 1: Set the test CCT to 2900K (Duv 0.0) */
	cct.cct = 2900.0;
	cct.duv = 0.0;

	rc = zsl_clr_conv_cct_xyz(&cct, ZSL_CLR_OBS_2_DEG, &xyz);
	zassert_true(rc == 0, NULL);

	/* Check the XYZ output to the sixth decimal place. */
	/* 2900K CCT = XYZ (1.0929741, 1.0, 0.3674785) w/5nm lookup. */
	zassert_true(val_is_equal(xyz.xyz_x, 1.0929741, 1E-6), NULL);
	zassert_true(val_is_equal(xyz.xyz_y, 1.00000000, 1E-6), NULL);
	zassert_true(val_is_equal(xyz.xyz_z, 0.3674785, 1E-6), NULL);
	zassert_true(xyz.observer == ZSL_CLR_OBS_2_DEG, NULL);
	zassert_false(xyz.x_invalid, NULL);
	zassert_false(xyz.y_invalid, NULL);
	zassert_false(xyz.z_invalid, NULL);

	/* Test 2: Set the test CCT to 2938K with a Duv of -0.00082 */
	cct.cct = 2938.0;
	cct.duv = -0.00082;

	rc = zsl_clr_conv_cct_xyz(&cct, ZSL_CLR_OBS_2_DEG, &xyz);
	zassert_true(rc == 0, NULL);

	/* Check the XYZ output to the third or fourth decimal place.
	 *
	 * With a precision lookup (calculated externally) we get:
	 *
	 *     XYZ (1.092025687995, 1.0, 0.388853391245)
	 */
#if CONFIG_ZSL_SINGLE_PRECISION
	zassert_true(val_is_equal(xyz.xyz_x, 1.092025687995, 1E-3), NULL);
	zassert_true(val_is_equal(xyz.xyz_y, 1.00000000, 1E-3), NULL);
	zassert_true(val_is_equal(xyz.xyz_z, 0.388853391245, 1E-3), NULL);
#else
	/* TODO: Figure out why only accurate to four places? :( */
	zassert_true(val_is_equal(xyz.xyz_x, 1.092025687995, 1E-4), NULL);
	zassert_true(val_is_equal(xyz.xyz_y, 1.00000000, 1E-4), NULL);
	zassert_true(val_is_equal(xyz.xyz_z, 0.388853391245, 1E-4), NULL);
#endif
	zassert_true(xyz.observer == ZSL_CLR_OBS_2_DEG, NULL);
	zassert_false(xyz.x_invalid, NULL);
	zassert_false(xyz.y_invalid, NULL);
	zassert_false(xyz.z_invalid, NULL);
}

void
test_conv_uv60_cct_ohno2011(void)
{
	int rc;
	struct zsl_clr_uv60 uv;
	struct zsl_clr_cct cct;
	zsl_real_t eps_duv;
	zsl_real_t eps_cct;

	/* Set the test tolerances. */
	eps_duv = 0.001;
	eps_cct = 5.0;

	/* 2011K in uv. */
	memset(&cct, 0, sizeof cct);
	memset(&uv, 0, sizeof uv);
	uv.uv60_u = 0.30412;
	uv.uv60_v = 0.35898;
	rc = zsl_clr_conv_uv60_cct(ZSL_CLR_UV_CCT_METHOD_OHNO2011, &uv, &cct);
	zassert_true(rc == 0, NULL);
	zassert_true(val_is_equal(cct.duv, 0.0, eps_duv), NULL);
	zassert_true(val_is_equal(cct.cct, 2011.0, eps_cct), NULL);

	/* 2900K + Duv 0.02 in uv. */
	memset(&cct, 0, sizeof cct);
	uv.uv60_u = 0.247629;
	uv.uv60_v = 0.367808;
	rc = zsl_clr_conv_uv60_cct(ZSL_CLR_UV_CCT_METHOD_OHNO2011, &uv, &cct);
	zassert_true(rc == 0, NULL);
	zassert_true(val_is_equal(cct.duv, 0.02, eps_duv), NULL);
	zassert_true(val_is_equal(cct.cct, 2900.0, eps_cct), NULL);

	/* 7057.7 in uv. */
	memset(&cct, 0, sizeof cct);
	uv.uv60_u = 0.197888;
	uv.uv60_v = 0.306665;
	rc = zsl_clr_conv_uv60_cct(ZSL_CLR_UV_CCT_METHOD_OHNO2011, &uv, &cct);
	zassert_true(rc == 0, NULL);
	zassert_true(val_is_equal(cct.duv, 0.0, eps_duv), NULL);
	zassert_true(val_is_equal(cct.cct, 7057.7, eps_cct), NULL);
}

void
test_conv_uv60_cct_ohno2014(void)
{
	int rc;
	struct zsl_clr_uv60 uv;
	struct zsl_clr_cct cct;
	zsl_real_t eps_duv;
	zsl_real_t eps_cct;

	/* Set the test tolerances. */
	eps_duv = 0.0001;
	eps_cct = 10.0;

	/* Test 1: 2938 K with a Duv of -0.00082 */
	memset(&cct, 0, sizeof cct);
	memset(&uv, 0, sizeof uv);
	uv.uv60_u = 0.25309737;
	uv.uv60_v = 0.34765305;
	rc = zsl_clr_conv_uv60_cct(ZSL_CLR_UV_CCT_METHOD_OHNO2014, &uv, &cct);
	zassert_true(rc == 0, NULL);
	printk("%d %d\n", (int)cct.cct, (int)(cct.duv * 1000000000));
	zassert_true(val_is_equal(cct.duv, -0.00082, eps_duv), NULL);
	zassert_true(val_is_equal(cct.cct, 2938.0, eps_cct), NULL);

	/* Test 2: 7243.94 K with a Duv of 0.0. */
	memset(&cct, 0, sizeof cct);
	memset(&uv, 0, sizeof uv);
	uv.uv60_u = 0.197153338321965;
	uv.uv60_v = 0.305540116604965;
	rc = zsl_clr_conv_uv60_cct(ZSL_CLR_UV_CCT_METHOD_OHNO2014, &uv, &cct);
	zassert_true(rc == 0, NULL);
	zassert_true(val_is_equal(cct.duv, 0.0, eps_duv), NULL);
	zassert_true(val_is_equal(cct.cct, 7243.94, eps_cct), NULL);

	/* TODO: Add further tests! */
}
```

## src/compass_tests.c
```c
/*
 * Copyright (c) 2021 Kevin Townsend
 *
 * SPDX-License-Identifier: Apache-2.0
 */

#include <ztest.h>
#include <zsl/zsl.h>
#include <zsl/orientation/compass.h>
#include "floatcheck.h"

void test_comp_dms_to_dd(void)
{
	int rc = 0;

	zsl_real_t dd;

	/* Convert the minutes and seconds to degrees. */
	rc = zsl_comp_dms_to_dd(2.0, 29.5, 30.0, &dd);
	zassert_true(rc == 0, NULL);
	zassert_true(val_is_equal(dd, 2.5, 1E-6), NULL);
	rc = zsl_comp_dms_to_dd(-2.0, 29.5, 30.0, &dd);
	zassert_true(rc == 0, NULL);
	zassert_true(val_is_equal(dd, -2.5, 1E-6), NULL);

	/* Special cases where the inputs are invalid. */
	rc = zsl_comp_dms_to_dd(-190.0, 29.5, 30.0, &dd);
	zassert_true(rc == -EINVAL, NULL);
	rc = zsl_comp_dms_to_dd(200.0, 29.5, 30.0, &dd);
	zassert_true(rc == -EINVAL, NULL);
	rc = zsl_comp_dms_to_dd(2.0, 67.5, 30.0, &dd);
	zassert_true(rc == -EINVAL, NULL);
	rc = zsl_comp_dms_to_dd(2.0, -5.0, 30.0, &dd);
	zassert_true(rc == -EINVAL, NULL);
	rc = zsl_comp_dms_to_dd(2.0, 29.5, 100.0, &dd);
	zassert_true(rc == -EINVAL, NULL);
	rc = zsl_comp_dms_to_dd(2.0, 29.5, -25.0, &dd);
	zassert_true(rc == -EINVAL, NULL);
}

void test_comp_magn_north(void)
{
	int rc = 0;

	ZSL_VECTOR_DEF(m, 3);
	ZSL_VECTOR_DEF(m2, 4);

	m.data[0] = 1.3;
	m.data[1] = 0.0;
	m.data[2] = 3.0;

	zsl_real_t d;

	/* Calculate the magnetic North. */
	rc = zsl_comp_magn_north(&m, &d);
	zassert_true(rc == 0, NULL);
	zassert_true(val_is_equal(d, 0.0, 1E-6), NULL);

	m.data[0] = -1.3;
	m.data[1] = 0.0;
	m.data[2] = 3.0;
	rc = zsl_comp_magn_north(&m, &d);
	zassert_true(rc == 0, NULL);
	zassert_true(val_is_equal(d, 180.0, 1E-6), NULL);

	m.data[0] = 1.3;
	m.data[1] = 1.3;
	m.data[2] = 3.0;
	rc = zsl_comp_magn_north(&m, &d);
	zassert_true(rc == 0, NULL);
	zassert_true(val_is_equal(d, 45.0, 1E-6), NULL);

	m.data[0] = -1.3;
	m.data[1] = -1.3;
	m.data[2] = 3.0;
	rc = zsl_comp_magn_north(&m, &d);
	zassert_true(rc == 0, NULL);
	zassert_true(val_is_equal(d, 225.0, 1E-6), NULL);

	/* Special case where the input is invalid. */
	rc = zsl_comp_magn_north(&m2, &d);
	zassert_true(rc == -EINVAL, NULL);
}

void test_comp_geo_north(void)
{
	int rc = 0;

	ZSL_VECTOR_DEF(m, 3);
	ZSL_VECTOR_DEF(m2, 4);

	m.data[0] = 1.3;
	m.data[1] = 0.0;
	m.data[2] = 3.0;

	zsl_real_t d;

	/* Calculate the geographic North. */
	rc = zsl_comp_geo_north(&m, 10.0, &d);
	zassert_true(rc == 0, NULL);
	zassert_true(val_is_equal(d, 10.0, 1E-6), NULL);

	m.data[0] = -1.3;
	m.data[1] = 0.0;
	m.data[2] = 3.0;
	rc = zsl_comp_geo_north(&m, 10.0, &d);
	zassert_true(rc == 0, NULL);
	zassert_true(val_is_equal(d, 190.0, 1E-6), NULL);

	m.data[0] = 1.3;
	m.data[1] = 1.3;
	m.data[2] = 3.0;
	rc = zsl_comp_geo_north(&m, 10.0, &d);
	zassert_true(rc == 0, NULL);
	zassert_true(val_is_equal(d, 55.0, 1E-6), NULL);

	m.data[0] = -1.3;
	m.data[1] = -1.3;
	m.data[2] = 3.0;
	rc = zsl_comp_geo_north(&m, 10.0, &d);
	zassert_true(rc == 0, NULL);
	zassert_true(val_is_equal(d, 235.0, 1E-6), NULL);

	/* Special case where the input is invalid. */
	rc = zsl_comp_geo_north(&m2, 10.0, &d);
	zassert_true(rc == -EINVAL, NULL);
}
```

## src/complex_tests.c
```c
/*
 * Copyright (c) 2019 Kevin Townsend (KTOWN)
 *
 * SPDX-License-Identifier: Apache-2.0
 */

#include <complex.h>    /* C99 complex number support. */
#include <ztest.h>
#include <zsl/zsl.h>
#include "floatcheck.h"

/**
 * For details on complex number support in C99 andd C11 see;
 * https://en.wikichip.org/wiki/c/complex.h
 */

#ifdef __STDC_NO_COMPLEX__
#error "C99 Complex number support not available."
#endif

void test_complex_add(void)
{
	/* NOTE: zsl_real_t typedef can't be used with C99 complex numbers. */
#if CONFIG_ZSL_SINGLE_PRECISION
	double complex a = 1.0 + 0.4 * I;
	double complex b = 1.0 + 0.5 * I;
	double complex c = 0.0;
#else
	float complex a = 1.0 + 0.4 * I;
	float complex b = 1.0 + 0.5 * I;
	float complex c = 0.0;
#endif

	c = a + b;
	zassert_true(val_is_equal(creal(c), creal(a) + creal(b), 1E-5), NULL);
	zassert_true(val_is_equal(cimag(c), cimag(a) + cimag(b), 1E-5), NULL);
}
```

## src/data.c
```c
/*
 * Copyright (c) 2019-2020 Kevin Townsend (KTOWN)
 *
 * SPDX-License-Identifier: Apache-2.0
 */

#include <ztest.h>
#include <zsl/colorimetry.h>

/**
 * Spectral power distribution (aka spectral density) array based on natural
 * daylight at 5983K, 0.0033 Duv and 288 lux sampled on a spectrometer.
 *
 * 5983.00 K and 0.0033 Duv as CIE 1931 XYZ tristimulus =
 *
 *   o X: 0.9516492
 *   o Y: 1.0000000
 *   o Z: 1.0056107
 */
const struct zsl_clr_spd zsl_clr_test_spd_5983k = {
	.size = 21,
	.comps = {
		{ .nm = 380, .value = 0.290 },
		{ .nm = 400, .value = 0.471 },
		{ .nm = 420, .value = 0.719 },
		{ .nm = 440, .value = 0.826 },
		{ .nm = 460, .value = 1.006 },
		{ .nm = 480, .value = 0.989 },
		{ .nm = 500, .value = 0.955 },
		{ .nm = 520, .value = 0.910 },
		{ .nm = 540, .value = 0.950 },
		{ .nm = 560, .value = 0.912 },
		{ .nm = 580, .value = 0.848 },
		{ .nm = 600, .value = 0.814 },
		{ .nm = 620, .value = 0.827 },
		{ .nm = 640, .value = 0.771 },
		{ .nm = 660, .value = 0.749 },
		{ .nm = 680, .value = 0.766 },
		{ .nm = 700, .value = 0.705 },
		{ .nm = 720, .value = 0.599 },
		{ .nm = 740, .value = 0.850 },
		{ .nm = 760, .value = 0.699 },
		{ .nm = 780, .value = 0.898 }
	}
};
```

## src/data.h
```c
/*
 * Copyright (c) 2019-2020 Kevin Townsend (KTOWN)
 *
 * SPDX-License-Identifier: Apache-2.0
 */

#ifndef ZEPHYR_INCLUDE_ZSL_CLR_TEST_DATA_H_
#define ZEPHYR_INCLUDE_ZSL_CLR_TEST_DATA_H_

#ifdef __cplusplus
extern "C" {
#endif

extern const struct zsl_clr_spd zsl_clr_test_spd_5983k;

#ifdef __cplusplus
}
#endif

#endif /* ZEPHYR_INCLUDE_ZSL_CLR_TEST_DATA_H_ */
```

## src/floatcheck.c
```c
/*
 * Copyright (c) 2019-2020 Kevin Townsend (KTOWN)
 *
 * SPDX-License-Identifier: Apache-2.0
 */

#include <ctype.h>
#include "floatcheck.h"

bool
val_is_equal(zsl_real_t a, zsl_real_t b, zsl_real_t epsilon)
{
	zsl_real_t c;

	c = a - b;

	if (c < epsilon && -c < epsilon) {
		return 1;
	} else {
		return 0;
	}
}

bool
val_is_at_least(zsl_real_t a, zsl_real_t b)
{
	return a >= b ? 1 : 0;
}

bool
val_is_less_than(zsl_real_t a, zsl_real_t b)
{
	return a < b ? 1 : 0;
}

bool
val_is_greater_than(zsl_real_t a, zsl_real_t b)
{
	return a > b ? 1 : 0;
}

bool
val_is_within(zsl_real_t a, zsl_real_t upper, zsl_real_t lower)
{
	if ((a <= upper) && (a >= lower)) {
		return 1;
	} else {
		return 0;
	}
}
```

## src/floatcheck.h
```c
/*
 * Copyright (c) 2019-2020 Kevin Townsend (KTOWN)
 *
 * SPDX-License-Identifier: Apache-2.0
 */

/**
 * @file
 * @brief Helper functions to test floating point values.
 *
 * This file contains helpers to test floating point values.
 */

#ifndef ZEPHYR_INCLUDE_ZSL_FLOATCHECK_H_
#define ZEPHYR_INCLUDE_ZSL_FLOATCHECK_H_

#include <zephyr.h>
#include <stdint.h>
#include <zsl/zsl.h>

#ifdef __cplusplus
extern "C" {
#endif

/**
 * Checks if a zsl_real_t is equal to the specified value, with a +/- margin of
 * 'epsilon'.
 *
 * @param a         The value to check
 * @param b         The value to compare against
 * @param epsilon   The +/- margin for equality
 *
 * @return  True if value 'a' is equal to 'b', otherwise false.
 */
bool val_is_equal(zsl_real_t a, zsl_real_t b, zsl_real_t epsilon);

/**
 * Checks if a zsl_real_t is equal to or greater than the specified value.
 *
 * @param a         The value to check
 * @param b         The value to compare against
 *
 * @return  True if value 'a' is greater than or equal to 'b', otherwise false.
 */
bool val_is_at_least(zsl_real_t a, zsl_real_t b);

/**
 * Checks if a zsl_real_t is less than the specified value.
 *
 * @param a         The value to check
 * @param b         The value to compare against
 *
 * @return  True if value 'a' is less than 'b', otherwise false.
 */
bool val_is_less_than(zsl_real_t a, zsl_real_t b);

/**
 * Checks if a zsl_real_t is greater than the specified value.
 *
 * @param a         The value to check
 * @param b         The value to compare against
 *
 * @return  True if value 'a' is greater than 'b', otherwise false.
 */
bool val_is_greater_than(zsl_real_t a, zsl_real_t b);

/**
 * Checks if a zsl_real_t is within the range of 'upper' and 'lower'.
 *
 * @param a         The value to check
 * @param upper     The upper value to compare against (inclusive)
 * @param lower     The lower value to compare against (inclusive)
 *
 * @return  True if value 'a' is <= 'upper' and >='lower', otherwise false.
 */
bool val_is_within(zsl_real_t a, zsl_real_t upper, zsl_real_t lower);

#ifdef __cplusplus
}
#endif

#endif /* _MB_FLOATCHECK_H_ */
```

## src/interp_tests.c
```c
/*
 * Copyright (c) 2019 Kevin Townsend (KTOWN)
 *
 * SPDX-License-Identifier: Apache-2.0
 */

#include <ztest.h>
#include <zsl/zsl.h>
#include <zsl/interp.h>
#include "floatcheck.h"

void test_interp_lerp(void)
{
	int rc;
	zsl_real_t v0, v1, v;
	zsl_real_t t;

	v0 = 0.1f;
	v1 = 0.2f;
	t = 0.5f;

	/* Test 1: Normal conversion. */
	rc = zsl_interp_lerp(v0, v1, t, &v);
	zassert_equal(rc, 0, NULL);
	zassert_true(val_is_equal(v, 0.15, 1E-4), NULL);

	/* Test 2: t = 0. */
	t = 0.0f;
	rc = zsl_interp_lerp(v0, v1, t, &v);
	zassert_equal(rc, 0, NULL);
	zassert_true(val_is_equal(v, v0, 1E-4), NULL);

	/* Test 3: t = 1.0. */
	t = 1.0f;
	rc = zsl_interp_lerp(v0, v1, t, &v);
	zassert_equal(rc, 0, NULL);
	zassert_true(val_is_equal(v, v1, 1E-4), NULL);

	/* Test 4: t = -0.01 (invalid value). */
	t = -0.01f;
	rc = zsl_interp_lerp(v0, v1, t, &v);
	zassert_equal(rc, -EINVAL, NULL);

	/* Test 5: t = 1.01 (invalid value). */
	t = 1.01f;
	rc = zsl_interp_lerp(v0, v1, t, &v);
	zassert_equal(rc, -EINVAL, NULL);

}

void test_interp_find_x_asc(void)
{
	int rc;
	int idx;
	unsigned int n;
	zsl_real_t x;
	struct zsl_interp_xy xy[6];

	/* (x:-1, y:-3.0) */
	xy[0].x = -1;
	xy[0].y = -3.0f;

	/* (x:0, y:-2.0) */
	xy[1].x = 0;
	xy[1].y = -2.0f;

	/* (x:1, y:-1.0) */
	xy[2].x = 1;
	xy[2].y = -1.0f;

	/* (x:2, y:0) */
	xy[3].x = 2;
	xy[3].y = 0.0f;

	/* (x:3, y:1.0) */
	xy[4].x = 3;
	xy[4].y = 1.0f;

	/* (x:4, y:2.0) */
	xy[5].x = 4;
	xy[5].y = 2.0f;

	/* Calculate the number of entries in xy. */
	n = sizeof xy / sizeof xy[0];

	/* Test 1: Try to find x = -0.25 (valid range) */
	x = -0.25f;
	rc = zsl_interp_find_x(xy, n, x, &idx);
	zassert_equal(rc, 0, NULL);
	zassert_equal(idx, 0, NULL);

	/* Test 2: Try to find x = 3.5 (valid range) */
	x = 3.5f;
	rc = zsl_interp_find_x(xy, n, x, &idx);
	zassert_equal(rc, 0, NULL);
	zassert_equal(idx, 4, NULL);

	/* Test 3: Try to find x = -1.25 (invalid range on the low end). */
	x = -1.25f;
	rc = zsl_interp_find_x(xy, n, x, &idx);
	zassert_equal(rc, -EINVAL, NULL);
	zassert_equal(idx, -1, NULL);

	/* Test 4: Try to find x = 4.25 (invalid range on the high end). */
	x = 4.25f;
	rc = zsl_interp_find_x(xy, n, x, &idx);
	zassert_equal(rc, -EINVAL, NULL);
	zassert_equal(idx, n, NULL);

	/* Test 5: Try to find x = upper limit. */
	x = xy[n - 1].x;
	rc = zsl_interp_find_x(xy, n, x, &idx);
	zassert_equal(rc, 0, NULL);
	zassert_equal(idx, n - 2, NULL);

	/* Test 6: Try to find x = lower limit. */
	x = xy[0].x;
	rc = zsl_interp_find_x(xy, n, x, &idx);
	zassert_equal(rc, 0, NULL);
	zassert_equal(idx, 0, NULL);

	/* Test 7: Try to find x = upper limit + 0.1 */
	x = xy[n - 1].x + 0.1f;
	rc = zsl_interp_find_x(xy, n, x, &idx);
	zassert_equal(rc, -EINVAL, NULL);
	zassert_equal(idx, n, NULL);

	/* Test 8: Try to find x = lower limit - 0.1 */
	x = xy[0].x - 0.1f;
	rc = zsl_interp_find_x(xy, n, x, &idx);
	zassert_equal(rc, -EINVAL, NULL);
	zassert_equal(idx, -1, NULL);
}

void test_interp_find_x_desc(void)
{
	int rc;
	int idx;
	unsigned int n;
	zsl_real_t x;
	struct zsl_interp_xy xy[6];

	/* (x:4, y:2.0) */
	xy[0].x = 4;
	xy[0].y = 2.0f;

	/* (x:3, y:1.0) */
	xy[1].x = 3;
	xy[1].y = 1.0f;

	/* (x:2, y:0) */
	xy[2].x = 2;
	xy[2].y = 0.0f;

	/* (x:1, y:-1.0) */
	xy[3].x = 1;
	xy[3].y = -1.0f;

	/* (x:0, y:-2.0) */
	xy[4].x = 0;
	xy[4].y = -2.0f;

	/* (x:-1, y:-3.0) */
	xy[5].x = -1;
	xy[5].y = -3.0f;

	/* Calculate the number of entries in xy. */
	n = sizeof xy / sizeof xy[0];

	/* Test 1: Try to find x = -0.25 (valid range) */
	x = -0.25f;
	rc = zsl_interp_find_x(xy, n, x, &idx);
	zassert_equal(rc, 0, NULL);
	zassert_equal(idx, 4, NULL);

	/* Test 2: Try to find x = 3.5 (valid range) */
	x = 3.5f;
	rc = zsl_interp_find_x(xy, n, x, &idx);
	zassert_equal(rc, 0, NULL);
	zassert_equal(idx, 0, NULL);

	/* Test 3: Try to find x = 1.75 (valid range) */
	x = 1.75f;
	rc = zsl_interp_find_x(xy, n, x, &idx);
	zassert_equal(rc, 0, NULL);
	zassert_equal(idx, 2, NULL);

	/* Test 4: Try to find x = -1.25 (invalid range on the high end). */
	x = -1.25f;
	rc = zsl_interp_find_x(xy, n, x, &idx);
	zassert_equal(rc, -EINVAL, NULL);
	zassert_equal(idx, n, NULL);

	/* Test 5: Try to find x = 4.25 (invalid range on the low end). */
	x = 4.25f;
	rc = zsl_interp_find_x(xy, n, x, &idx);
	zassert_equal(rc, -EINVAL, NULL);
	zassert_equal(idx, -1, NULL);

	/* Test 6: Try to find x = upper limit. */
	x = xy[n - 1].x;
	rc = zsl_interp_find_x(xy, n, x, &idx);
	zassert_equal(rc, 0, NULL);
	zassert_equal(idx, n - 2, NULL);

	/* Test 7: Try to find x = lower limit. */
	x = xy[0].x;
	rc = zsl_interp_find_x(xy, n, x, &idx);
	zassert_equal(rc, 0, NULL);
	zassert_equal(idx, 0, NULL);

	/* Test 8: Try to find x = upper limit - 0.1 */
	x = xy[n - 1].x - 0.1f;
	rc = zsl_interp_find_x(xy, n, x, &idx);
	zassert_equal(rc, -EINVAL, NULL);
	zassert_equal(idx, n, NULL);

	/* Test 9: Try to find x = lower limit + 0.1 */
	x = xy[0].x + 0.1f;
	rc = zsl_interp_find_x(xy, n, x, &idx);
	zassert_equal(rc, -EINVAL, NULL);
	zassert_equal(idx, -1, NULL);
}

void test_interp_nn(void)
{
	int rc;
	struct zsl_interp_xy xy1;
	struct zsl_interp_xy xy3;
	zsl_real_t y2;

	xy1.x = 10.0f;
	xy1.y = 0.20f;
	xy3.x = 20.0f;
	xy3.y = 0.22f;

	/* Test 1: Interpolate y at x = 13.6 */
	rc = zsl_interp_nn(&xy1, &xy3, 13.6f, &y2);
	zassert_equal(rc, 0, NULL);
	zassert_true(val_is_equal(y2, xy1.y, 1E-4F), NULL);

	/* Test 2: Interpolate y at x = 15.6 */
	rc = zsl_interp_nn(&xy1, &xy3, 15.6f, &y2);
	zassert_equal(rc, 0, NULL);
	zassert_true(val_is_equal(y2, xy3.y, 1E-4F), NULL);

	/* Test 3: Interpolate y at x = 15.0 */
	rc = zsl_interp_nn(&xy1, &xy3, 15.0f, &y2);
	zassert_equal(rc, 0, NULL);
	zassert_true(val_is_equal(y2, xy3.y, 1E-4F), NULL);

	/* Test 4: Check for delta 0.0 on x. */
	xy3.x = xy1.x;
	rc = zsl_interp_nn(&xy1, &xy3, xy1.x, &y2);
	zassert_equal(rc, -EINVAL, NULL);
	xy3.x = 20.0f;

	/* Test 5: Negative values. */
	xy1.x = -4.5f;
	xy3.x = 10.0f;
	rc = zsl_interp_nn(&xy1, &xy3, 2.75f, &y2);
	zassert_equal(rc, 0, NULL);
	zassert_true(val_is_equal(y2, xy3.y, 1E-4F), NULL);
	xy1.x = 10.0f;
	xy3.x = 20.0f;

	/* Test 6: x2 == x1. */
	rc = zsl_interp_nn(&xy1, &xy3, xy1.x, &y2);
	zassert_equal(rc, 0, NULL);
	zassert_true(val_is_equal(y2, xy1.y, 1E-4F), NULL);

	/* Test 7: x2 == x3. */
	rc = zsl_interp_nn(&xy1, &xy3, xy3.x, &y2);
	zassert_equal(rc, 0, NULL);
	zassert_true(val_is_equal(y2, xy3.y, 1E-4F), NULL);
}

void test_interp_nn_arr(void)
{
	int rc;
	unsigned int n;
	zsl_real_t x;
	zsl_real_t y;
	struct zsl_interp_xy xy[6];

	/* (x:-1, y:-3.0) */
	xy[0].x = -1;
	xy[0].y = -3.0f;

	/* (x:0, y:-2.0) */
	xy[1].x = 0;
	xy[1].y = -2.0f;

	/* (x:1, y:-1.0) */
	xy[2].x = 1;
	xy[2].y = -1.0f;

	/* (x:2, y:0) */
	xy[3].x = 2;
	xy[3].y = 0.0f;

	/* (x:3, y:1.0) */
	xy[4].x = 3;
	xy[4].y = 1.0f;

	/* (x:4, y:2.0) */
	xy[5].x = 4;
	xy[5].y = 2.0f;

	/* Calculate the number of entries in xy. */
	n = sizeof xy / sizeof xy[0];

	/* Test 1: Try to find x = -0.25 (valid range) */
	x = -0.25f;
	rc = zsl_interp_nn_arr(xy, n, x, &y);
	zassert_equal(rc, 0, NULL);
	zassert_true(val_is_equal(y, xy[1].y, 1E-4F), NULL);
}

void test_interp_lin_y(void)
{
	int rc;
	struct zsl_interp_xy xy1;
	struct zsl_interp_xy xy3;
	zsl_real_t y2;

	xy1.x = 10.0f;
	xy1.y = 0.20f;
	xy3.x = 20.0f;
	xy3.y = 0.22f;

	/* Test 1: Interpolate y at x = 13.6 */
	rc = zsl_interp_lin_y(&xy1, &xy3, 13.6f, &y2);
	zassert_equal(rc, 0, NULL);
	zassert_true(val_is_equal(y2, 0.2072f, 1E-4F), NULL);

	/* Test 2: Check for x too low. */
	rc = zsl_interp_lin_y(&xy1, &xy3, xy1.x - 0.01f, &y2);
	zassert_equal(rc, -EINVAL, NULL);

	/* Test 3: Check for x too high. */
	rc = zsl_interp_lin_y(&xy1, &xy3, xy3.x + 0.01f, &y2);
	zassert_equal(rc, -EINVAL, NULL);

	/* Test 4: Check for delta 0.0 on x. */
	xy3.x = xy1.x;
	rc = zsl_interp_lin_y(&xy1, &xy3, xy1.x, &y2);
	zassert_equal(rc, -EINVAL, NULL);
	xy3.x = 20.0f;

	/* Test 5: Negative values. */
	xy1.x = -4.5f;
	xy3.x = 10.0f;
	rc = zsl_interp_lin_y(&xy1, &xy3, 2.75f, &y2);
	zassert_equal(rc, 0, NULL);
	zassert_true(val_is_equal(y2, 0.21f, 1E-4F), NULL);
	xy1.x = 10.0f;
	xy3.x = 20.0f;

	/* Test 6: x2 == x1. */
	rc = zsl_interp_lin_y(&xy1, &xy3, xy1.x, &y2);
	zassert_equal(rc, 0, NULL);
	zassert_true(val_is_equal(y2, xy1.y, 1E-4F), NULL);

	/* Test 7: x2 == x3. */
	rc = zsl_interp_lin_y(&xy1, &xy3, xy3.x, &y2);
	zassert_equal(rc, 0, NULL);
	zassert_true(val_is_equal(y2, xy3.y, 1E-4F), NULL);
}

void test_interp_lin_y_arr(void)
{
	int rc;
	unsigned int n;
	zsl_real_t x;
	zsl_real_t y;
	struct zsl_interp_xy xy[6];

	/* (x:-1, y:-3.0) */
	xy[0].x = -1;
	xy[0].y = -3.0f;

	/* (x:0, y:-2.0) */
	xy[1].x = 0;
	xy[1].y = -2.0f;

	/* (x:1, y:-1.0) */
	xy[2].x = 1;
	xy[2].y = -1.0f;

	/* (x:2, y:0) */
	xy[3].x = 2;
	xy[3].y = 0.0f;

	/* (x:3, y:1.0) */
	xy[4].x = 3;
	xy[4].y = 1.0f;

	/* (x:4, y:2.0) */
	xy[5].x = 4;
	xy[5].y = 2.0f;

	/* Calculate the number of entries in xy. */
	n = sizeof xy / sizeof xy[0];

	/* Test 1: Try to find x = -0.25 (valid range) */
	x = -0.25f;
	rc = zsl_interp_lin_y_arr(xy, n, x, &y);
	zassert_equal(rc, 0, NULL);
	zassert_true(val_is_equal(y, -2.25f, 1E-4F), NULL);
}

void test_interp_lin_x(void)
{
	int rc;
	struct zsl_interp_xy xy1;
	struct zsl_interp_xy xy3;
	zsl_real_t x2;

	xy1.x = 10.0f;
	xy1.y = 0.20f;
	xy3.x = 20.0f;
	xy3.y = 0.22f;

	/* Test 1: Interpolate x for x = 0.2072f */
	rc = zsl_interp_lin_x(&xy1, &xy3, 0.2072f, &x2);
	zassert_equal(rc, 0, NULL);
	zassert_true(val_is_equal(x2, 13.6f, 1E-4F), NULL);

	/* Test 2: Check for y too low. */
	rc = zsl_interp_lin_y(&xy1, &xy3, xy1.y - 0.01f, &x2);
	zassert_equal(rc, -EINVAL, NULL);

	/* Test 3: Check for y too high. */
	rc = zsl_interp_lin_y(&xy1, &xy3, xy3.y + 0.01f, &x2);
	zassert_equal(rc, -EINVAL, NULL);

	/* Test 4: Check for delta 0.0 on x. */
	xy3.x = xy1.x;
	rc = zsl_interp_lin_x(&xy1, &xy3, xy1.y, &x2);
	zassert_equal(rc, -EINVAL, NULL);
	xy3.x = 20.0f;

	/* Test 5: Negative values. */
	xy1.y = -0.20f;
	xy3.y = 0.20f;
	rc = zsl_interp_lin_x(&xy1, &xy3, -0.1f, &x2);
	zassert_equal(rc, 0, NULL);
	zassert_true(val_is_equal(x2, 12.5f, 1E-4F), NULL);
	xy1.y = 0.20f;
	xy3.y = 0.22f;

	/* Test 6: y2 == y1. */
	rc = zsl_interp_lin_x(&xy1, &xy3, xy1.y, &x2);
	zassert_equal(rc, 0, NULL);
	zassert_true(val_is_equal(x2, xy1.x, 1E-4F), NULL);

	/* Test 7: y2 == y3. */
	rc = zsl_interp_lin_x(&xy1, &xy3, xy3.y, &x2);
	zassert_equal(rc, 0, NULL);
	zassert_true(val_is_equal(x2, xy3.x, 1E-4F), NULL);
}

void test_interp_cubic_arr(void)
{
	int rc;
	unsigned int n;
	zsl_real_t x;
	zsl_real_t y;
	struct zsl_interp_xyc xyc[7];

	/* Make sure all Y2 values are set to 0 by default. */
	memset(xyc, 0, sizeof xyc);

	xyc[0].x = -3;
	xyc[0].y = 0.0f;
	xyc[1].x = -2;
	xyc[1].y = 1.0f;
	xyc[2].x = -1;
	xyc[2].y = 2.0f;
	xyc[3].x = 0;
	xyc[3].y = .75f;
	xyc[4].x = 1;
	xyc[4].y = 0.0f;
	xyc[5].x = 2;
	xyc[5].y = 2.5f;
	xyc[6].x = 3;
	xyc[6].y = -1.25f;

	/* Calculate the number of entries in xy. */
	n = sizeof xyc / sizeof xyc[0];

	/* Calculate y2 values for xyc. */
	rc = zsl_interp_cubic_calc(xyc, n, 1e30, 1e30);
	zassert_equal(rc, 0, NULL);

	/* Test 1: Try to find x = -1.25 (valid range) */
	x = -1.25f;
	rc = zsl_interp_cubic_arr(xyc, n, x, &y);
	zassert_equal(rc, 0, NULL);
	zassert_true(val_is_equal(y, 1.907918f, 1E-4F), NULL);

	/* Test 2: Not enough samples. */
	x = 0.7f;
	rc = zsl_interp_cubic_arr(xyc, 2, x, &y);
	zassert_equal(rc, -EINVAL, NULL);
}
```
