## CMakeLists.txt
```
#
# Copyright (c) 2020 Nordic Semiconductor
#
# SPDX-License-Identifier: LicenseRef-Nordic-5-Clause
#

cmake_minimum_required(VERSION 3.20.0)

find_package(Zephyr REQUIRED HINTS $ENV{ZEPHYR_BASE})
project(NONE)

# Application sources
target_sources_ifdef(CONFIG_FEM app
			PRIVATE ../../bluetooth/direct_test_mode/src/fem/fem.c)
target_sources_ifdef(CONFIG_NRF21540_FEM app
			PRIVATE ../../bluetooth/direct_test_mode/src/fem/nrf21540.c)
target_sources_ifdef(CONFIG_GENERIC_FEM app
			PRIVATE ../../bluetooth/direct_test_mode/src/fem/generic_fem.c)
zephyr_include_directories(../../bluetooth/direct_test_mode/src/fem/)

FILE(GLOB app_sources src/*.c)
# NORDIC SDK APP START
target_sources(app PRIVATE
	${app_sources}
)
# NORDIC SDK APP END
```

## Kconfig
```
#
# Copyright (c) 2020 Nordic Semiconductor
#
# SPDX-License-Identifier: LicenseRef-Nordic-5-Clause
#

source "Kconfig.zephyr"

menu "Nordic Radio test sample"
rsource "../../bluetooth/direct_test_mode/src/fem/Kconfig"
endmenu
```

## sample.yaml
```
sample:
  name: Radio Test
  description: Radio Test sample
tests:
  samples.peripheral.radio_test:
    build_only: true
    platform_allow: nrf52dk_nrf52832 nrf52840dk_nrf52840 nrf5340dk_nrf5340_cpunet
    integration_platforms:
      - nrf52dk_nrf52832
      - nrf52840dk_nrf52840
      - nrf5340dk_nrf5340_cpunet
    tags: ci_build
```

## prj.conf
```kconfig
#
# Copyright (c) 2020 Nordic Semiconductor
#
# SPDX-License-Identifier: LicenseRef-Nordic-5-Clause
#

CONFIG_CONSOLE_HANDLER=y
CONFIG_SHELL=y
CONFIG_FLASH_SHELL=y

CONFIG_DYNAMIC_INTERRUPTS=y

CONFIG_NRFX_TIMER0=y
```

## boards/nrf21540dk_nrf52840.overlay
```dts
/ {
     aliases {
             nrf21540-spi = &spi0;
     };
};

&spi0 {
	compatible = "nordic,nrf-spim";
	status = "okay";
	sck-pin = <47>;
	mosi-pin = <45>;
	miso-pin = <46>;
	clock-frequency = <8000000>;
	cs-gpios = <&gpio0 21 GPIO_ACTIVE_LOW>;
};
```

## boards/nrf5340dk_nrf5340_cpunet.overlay
```dts
&spi0 {
	status = "disabled";
};
```

## src/main.c
```c
/*
 * Copyright (c) 2020 Nordic Semiconductor ASA
 *
 * SPDX-License-Identifier: LicenseRef-Nordic-5-Clause
 */

#include <sys/printk.h>
#include <drivers/clock_control.h>
#include <drivers/clock_control/nrf_clock_control.h>

static void clock_init(void)
{
	int err;
	int res;
	struct onoff_manager *clk_mgr;
	struct onoff_client clk_cli;

	clk_mgr = z_nrf_clock_control_get_onoff(CLOCK_CONTROL_NRF_SUBSYS_HF);
	if (!clk_mgr) {
		printk("Unable to get the Clock manager\n");
		return;
	}

	sys_notify_init_spinwait(&clk_cli.notify);

	err = onoff_request(clk_mgr, &clk_cli);
	if (err < 0) {
		printk("Clock request failed: %d\n", err);
		return;
	}

	do {
		err = sys_notify_fetch_result(&clk_cli.notify, &res);
		if (!err && res) {
			printk("Clock could not be started: %d\n", res);
			return;
		}
	} while (err);

	printk("Clock has started\n");
}

void main(void)
{
	printk("Starting Radio Test example\n");

	clock_init();
}
```

## src/radio_test.c
```c
/*
 * Copyright (c) 2020 Nordic Semiconductor ASA
 *
 * SPDX-License-Identifier: LicenseRef-Nordic-5-Clause
 */

#include "radio_test.h"

#include <string.h>
#include <hal/nrf_nvmc.h>
#include <hal/nrf_power.h>
#include <hal/nrf_rng.h>
#include <nrfx_timer.h>
#include <zephyr.h>

#if CONFIG_FEM
#include "fem.h"
#endif

/* IEEE 802.15.4 default frequency. */
#define IEEE_DEFAULT_FREQ         (5)
/* Length on air of the LENGTH field. */
#define RADIO_LENGTH_LENGTH_FIELD (8UL)

/* Frequency calculation for a given channel in the IEEE 802.15.4 radio
 * mode.
 */
#define IEEE_FREQ_CALC(_channel) (IEEE_DEFAULT_FREQ + \
				 (IEEE_DEFAULT_FREQ * \
				 ((_channel) - IEEE_MIN_CHANNEL)))
/* Frequency calculation for a given channel. */
#define CHAN_TO_FREQ(_channel) (2400 + _channel)

/* Buffer for the radio TX packet */
static uint8_t tx_packet[RADIO_MAX_PAYLOAD_LEN];
/* Buffer for the radio RX packet. */
static uint8_t rx_packet[RADIO_MAX_PAYLOAD_LEN];
/* Number of transmitted packets. */
static uint32_t tx_packet_cnt;
/* Number of received packets with valid CRC. */
static uint32_t rx_packet_cnt;

/* Radio current channel (frequency). */
static uint8_t current_channel;

/* Timer used for channel sweeps and tx with duty cycle. */
static const nrfx_timer_t timer = NRFX_TIMER_INSTANCE(0);

static bool sweep_proccesing;


#if CONFIG_FEM
static struct radio_test_fem fem;

static int fem_configure(bool rx, nrf_radio_mode_t mode,
			 struct radio_test_fem *fem)
{
	int err;

	/* FEM is kept powered during sweeping */
	if (!sweep_proccesing) {
		err = fem_power_up();
		if (err) {
			return err;
		}
	}

	if (fem->active_delay == 0) {
		fem->active_delay =
			fem_default_active_delay_calculate(false, mode);
	}

	if (rx) {
		return fem_rx_configure(FEM_EXECUTE_NOW,
					nrf_radio_event_address_get(
						NRF_RADIO,
						NRF_RADIO_EVENT_DISABLED),
					fem->active_delay);
	}

	/* Sweeping is done from the interrupt context do not trigger SPI
	 * transfer in the interrupt.
	 */
	if ((fem->gain != FEM_USE_DEFAULT_GAIN) &&
	    !sweep_proccesing) {
		err = fem_tx_gain_set(fem->gain);
		if (err) {
			printk("%d: out of range FEM gain value or setting gain is not supported\n",
				fem->gain);
			return err;
		}
	}

	return fem_tx_configure(FEM_EXECUTE_NOW,
				nrf_radio_event_address_get(NRF_RADIO,
					NRF_RADIO_EVENT_DISABLED),
				fem->active_delay);
}
#endif /* CONFIG_FEM */

static uint8_t rnd8(void)
{
	nrf_rng_event_clear(NRF_RNG, NRF_RNG_EVENT_VALRDY);

	while (!nrf_rng_event_check(NRF_RNG, NRF_RNG_EVENT_VALRDY)) {
		/* Do nothing. */
	}
	return nrf_rng_random_value_get(NRF_RNG);
}

static void radio_channel_set(nrf_radio_mode_t mode, uint8_t channel)
{
#if CONFIG_HAS_HW_NRF_RADIO_IEEE802154
	if (mode == NRF_RADIO_MODE_IEEE802154_250KBIT) {
		if ((channel >= IEEE_MIN_CHANNEL) &&
			(channel <= IEEE_MAX_CHANNEL)) {
			nrf_radio_frequency_set(
				NRF_RADIO,
				CHAN_TO_FREQ(IEEE_FREQ_CALC(channel)));
		} else {
			nrf_radio_frequency_set(
				NRF_RADIO,
				CHAN_TO_FREQ(IEEE_DEFAULT_FREQ));
		}
	} else {
		nrf_radio_frequency_set(NRF_RADIO, CHAN_TO_FREQ(channel));
	}
#else
	nrf_radio_frequency_set(NRF_RADIO, CHAN_TO_FREQ(channel));
#endif /* CONFIG_HAS_HW_NRF_RADIO_IEEE802154 */
}

static void radio_config(nrf_radio_mode_t mode, enum transmit_pattern pattern)
{
	nrf_radio_packet_conf_t packet_conf;

	/* Reset Radio ramp-up time. */
	nrf_radio_modecnf0_set(NRF_RADIO, false, RADIO_MODECNF0_DTX_Center);
	nrf_radio_crc_configure(NRF_RADIO, RADIO_CRCCNF_LEN_Disabled,
				NRF_RADIO_CRC_ADDR_INCLUDE, 0);

	/* Set the device address 0 to use when transmitting. */
	nrf_radio_txaddress_set(NRF_RADIO, 0);
	/* Enable the device address 0 to use to select which addresses to
	 * receive
	 */
	nrf_radio_rxaddresses_set(NRF_RADIO, 1);

	/* Set the address according to the transmission pattern. */
	switch (pattern) {
	case TRANSMIT_PATTERN_RANDOM:
		nrf_radio_prefix0_set(NRF_RADIO, 0xAB);
		nrf_radio_base0_set(NRF_RADIO, 0xABABABAB);
		break;

	case TRANSMIT_PATTERN_11001100:
		nrf_radio_prefix0_set(NRF_RADIO, 0xCC);
		nrf_radio_base0_set(NRF_RADIO, 0xCCCCCCCC);
		break;

	case TRANSMIT_PATTERN_11110000:
		nrf_radio_prefix0_set(NRF_RADIO, 0x6A);
		nrf_radio_base0_set(NRF_RADIO, 0x58FE811B);
		break;

	default:
		return;
	}

	/* Packet configuration:
	 * payload length size = 8 bits,
	 * 0-byte static length, max 255-byte payload,
	 * 4-byte base address length (5-byte full address length),
	 * Bit 24: 1 Big endian,
	 * Bit 25: 1 Whitening enabled.
	 */
	memset(&packet_conf, 0, sizeof(packet_conf));
	packet_conf.lflen = RADIO_LENGTH_LENGTH_FIELD;
	packet_conf.maxlen = (sizeof(tx_packet) - 1);
	packet_conf.statlen = 0;
	packet_conf.balen = 4;
	packet_conf.big_endian = true;
	packet_conf.whiteen = true;

	switch (mode) {
#if CONFIG_HAS_HW_NRF_RADIO_IEEE802154
	case NRF_RADIO_MODE_IEEE802154_250KBIT:
		/* Packet configuration:
		 * S1 size = 0 bits,
		 * S0 size = 0 bytes,
		 * 32-bit preamble.
		 */
		packet_conf.plen = NRF_RADIO_PREAMBLE_LENGTH_32BIT_ZERO;
		packet_conf.maxlen = IEEE_MAX_PAYLOAD_LEN;
		packet_conf.balen = 0;
		packet_conf.big_endian = false;
		packet_conf.whiteen = false;

		/* Set fast ramp-up time. */
		nrf_radio_modecnf0_set(NRF_RADIO, true,
				       RADIO_MODECNF0_DTX_Center);
		break;
#endif /* CONFIG_HAS_HW_NRF_RADIO_IEEE802154 */

#if CONFIG_HAS_HW_NRF_RADIO_BLE_CODED
	case NRF_RADIO_MODE_BLE_LR500KBIT:
	case NRF_RADIO_MODE_BLE_LR125KBIT:
		/* Packet configuration:
		 * S1 size = 0 bits,
		 * S0 size = 0 bytes,
		 * 10-bit preamble.
		 */
		packet_conf.plen = NRF_RADIO_PREAMBLE_LENGTH_LONG_RANGE;
		packet_conf.maxlen = IEEE_MAX_PAYLOAD_LEN;
		packet_conf.cilen = 2;
		packet_conf.termlen = 3;
		packet_conf.big_endian = false;
		packet_conf.balen = 3;

		/* Set fast ramp-up time. */
		nrf_radio_modecnf0_set(NRF_RADIO, true,
				       RADIO_MODECNF0_DTX_Center);

		/* Set CRC length; CRC calculation does not include the address
		 * field.
		 */
		nrf_radio_crc_configure(NRF_RADIO, RADIO_CRCCNF_LEN_Three,
					NRF_RADIO_CRC_ADDR_SKIP, 0);
		break;

#endif /* CONFIG_HAS_HW_NRF_RADIO_BLE_CODED */

	case NRF_RADIO_MODE_BLE_2MBIT:
		/* Packet configuration:
		 * S1 size = 0 bits,
		 * S0 size = 0 bytes,
		 * 16-bit preamble.
		 */
		packet_conf.plen = NRF_RADIO_PREAMBLE_LENGTH_16BIT;
		break;

	default:
		/* Packet configuration:
		 * S1 size = 0 bits,
		 * S0 size = 0 bytes,
		 * 8-bit preamble.
		 */
		packet_conf.plen = NRF_RADIO_PREAMBLE_LENGTH_8BIT;
		break;
	}

	nrf_radio_packet_configure(NRF_RADIO, &packet_conf);
}

static void generate_modulated_rf_packet(uint8_t mode,
					 enum transmit_pattern pattern)
{
	radio_config(mode, pattern);

	/* One byte used for size, actual size is SIZE-1 */
#if CONFIG_HAS_HW_NRF_RADIO_IEEE802154
	if (mode == NRF_RADIO_MODE_IEEE802154_250KBIT) {
		tx_packet[0] = IEEE_MAX_PAYLOAD_LEN - 1;
	} else {
		tx_packet[0] = sizeof(tx_packet) - 1;
	}
#else
	tx_packet[0] = sizeof(tx_packet) - 1;
#endif /* CONFIG_HAS_HW_NRF_RADIO_IEEE802154 */

	/* Fill payload with random data. */
	for (uint8_t i = 0; i < sizeof(tx_packet) - 1; i++) {
		if (pattern == TRANSMIT_PATTERN_RANDOM) {
			tx_packet[i + 1] = rnd8();
		} else if (pattern == TRANSMIT_PATTERN_11001100) {
			tx_packet[i + 1] = 0xCC;
		} else if (pattern == TRANSMIT_PATTERN_11110000) {
			tx_packet[i + 1] = 0xF0;
		} else {
			/* Do nothing. */
		}
	}
	nrf_radio_packetptr_set(NRF_RADIO, tx_packet);
}

static void radio_disable(void)
{
	nrf_radio_shorts_set(NRF_RADIO, 0);
	nrf_radio_int_disable(NRF_RADIO, ~0);
	nrf_radio_event_clear(NRF_RADIO, NRF_RADIO_EVENT_DISABLED);

	nrf_radio_task_trigger(NRF_RADIO, NRF_RADIO_TASK_DISABLE);
	while (!nrf_radio_event_check(NRF_RADIO, NRF_RADIO_EVENT_DISABLED)) {
		/* Do nothing */
	}
	nrf_radio_event_clear(NRF_RADIO, NRF_RADIO_EVENT_DISABLED);

#if CONFIG_FEM
	(void) fem_txrx_configuration_clear();
	(void) fem_txrx_stop();

	/* Do not powerdown front-end module (FEM) during sweeping. */
	if (!sweep_proccesing) {
		(void) fem_power_down();
	}
#endif /* CONFIG_FEM */
}

static void radio_unmodulated_tx_carrier(uint8_t mode, uint8_t txpower, uint8_t channel)
{
	radio_disable();

	nrf_radio_mode_set(NRF_RADIO, mode);
	nrf_radio_shorts_enable(NRF_RADIO, NRF_RADIO_SHORT_READY_START_MASK);
	nrf_radio_txpower_set(NRF_RADIO, txpower);

	radio_channel_set(mode, channel);

#if CONFIG_FEM
	(void) fem_configure(false, mode, &fem);
#else
	nrf_radio_task_trigger(NRF_RADIO, NRF_RADIO_TASK_TXEN);
#endif /* CONFIG_FEM */
}

static void radio_modulated_tx_carrier(uint8_t mode, uint8_t txpower, uint8_t channel,
				       enum transmit_pattern pattern)
{
	radio_disable();
	generate_modulated_rf_packet(mode, pattern);

	switch (mode) {
#if CONFIG_HAS_HW_NRF_RADIO_IEEE802154 || CONFIG_HAS_HW_NRF_RADIO_BLE_CODED
	case NRF_RADIO_MODE_IEEE802154_250KBIT:
	case NRF_RADIO_MODE_BLE_LR125KBIT:
	case NRF_RADIO_MODE_BLE_LR500KBIT:
		nrf_radio_shorts_enable(NRF_RADIO,
					NRF_RADIO_SHORT_READY_START_MASK |
					NRF_RADIO_SHORT_PHYEND_START_MASK);
		break;

#endif /* CONFIG_HAS_HW_NRF_RADIO_IEEE802154 || CONFIG_HAS_HW_NRF_RADIO_BLE_CODED */

	case NRF_RADIO_MODE_BLE_1MBIT:
	case NRF_RADIO_MODE_BLE_2MBIT:
	case NRF_RADIO_MODE_NRF_1MBIT:
	case NRF_RADIO_MODE_NRF_2MBIT:
	default:
#if defined(RADIO_MODE_MODE_Nrf_250Kbit)
	case NRF_RADIO_MODE_NRF_250KBIT:
#endif /* defined(RADIO_MODE_MODE_Nrf_250Kbit) */
		nrf_radio_shorts_enable(NRF_RADIO,
					NRF_RADIO_SHORT_READY_START_MASK |
					NRF_RADIO_SHORT_END_START_MASK);
		break;
	}

	nrf_radio_mode_set(NRF_RADIO, mode);
	nrf_radio_txpower_set(NRF_RADIO, txpower);

	radio_channel_set(mode, channel);

	tx_packet_cnt = 0;

	nrf_radio_event_clear(NRF_RADIO, NRF_RADIO_EVENT_END);
	nrf_radio_int_enable(NRF_RADIO, NRF_RADIO_INT_END_MASK);

#if CONFIG_FEM
	(void) fem_configure(false, mode, &fem);
#else
	nrf_radio_task_trigger(NRF_RADIO, NRF_RADIO_TASK_TXEN);
#endif /* CONFIG_FEM */
	while (!nrf_radio_event_check(NRF_RADIO, NRF_RADIO_EVENT_END)) {
		/* Do nothing */
	}
}

static void radio_rx(uint8_t mode, uint8_t channel, enum transmit_pattern pattern)
{
	radio_disable();

	nrf_radio_mode_set(NRF_RADIO, mode);
	nrf_radio_shorts_enable(NRF_RADIO,
				NRF_RADIO_SHORT_READY_START_MASK |
				NRF_RADIO_SHORT_END_START_MASK);
	nrf_radio_packetptr_set(NRF_RADIO, rx_packet);

	radio_config(mode, pattern);
	radio_channel_set(mode, channel);

	rx_packet_cnt = 0;

	nrf_radio_int_enable(NRF_RADIO, NRF_RADIO_INT_CRCOK_MASK);

#if CONFIG_FEM
	(void) fem_configure(true, mode, &fem);
#else
	nrf_radio_task_trigger(NRF_RADIO, NRF_RADIO_TASK_RXEN);
#endif
}

static void radio_sweep_start(uint8_t channel, uint32_t delay_ms)
{
	current_channel = channel;

#if CONFIG_FEM
	(void) fem_power_up();

	if (fem.gain != FEM_USE_DEFAULT_GAIN) {
		(void) fem_tx_gain_set(fem.gain);
	}
#endif

	nrfx_timer_disable(&timer);
	nrf_timer_shorts_disable(timer.p_reg, ~0);
	nrf_timer_int_disable(timer.p_reg, ~0);

	nrfx_timer_extended_compare(&timer,
		NRF_TIMER_CC_CHANNEL0,
		nrfx_timer_ms_to_ticks(&timer, delay_ms),
		NRF_TIMER_SHORT_COMPARE0_CLEAR_MASK,
		true);

	nrfx_timer_clear(&timer);
	nrfx_timer_enable(&timer);
}

static void radio_modulated_tx_carrier_duty_cycle(uint8_t mode, uint8_t txpower,
						  uint8_t channel,
						  enum transmit_pattern pattern,
						  uint32_t duty_cycle)
{
	/* Lookup table with time per byte in each radio MODE
	 * Mapped per NRF_RADIO->MODE available on nRF5-series devices
	 */
	static const uint8_t time_in_us_per_byte[16] = {
		8, 4, 32, 8, 4, 64, 16, 0, 0, 0, 0, 0, 0, 0, 0, 32
	};

	/* 1 byte preamble, 5 byte address (BALEN + PREFIX),
	 * and sizeof(payload), no CRC
	 */
	const uint32_t total_payload_size     = 1 + 5 + sizeof(tx_packet);
	const uint32_t total_time_per_payload =
		time_in_us_per_byte[mode] * total_payload_size;

	/* Duty cycle = 100 * Time_on / (time_on + time_off),
	 * we need to calculate "time_off" for delay.
	 * In addition, the timer includes the "total_time_per_payload",
	 * so we need to add this to the total timer cycle.
	 */
	uint32_t delay_time = total_time_per_payload +
			   ((100 * total_time_per_payload -
			   (total_time_per_payload * duty_cycle)) /
			   duty_cycle);

	radio_disable();
	generate_modulated_rf_packet(mode, pattern);

	nrf_radio_mode_set(NRF_RADIO, mode);
	nrf_radio_shorts_enable(NRF_RADIO,
				NRF_RADIO_SHORT_READY_START_MASK |
				NRF_RADIO_SHORT_END_DISABLE_MASK);
	nrf_radio_txpower_set(NRF_RADIO, txpower);
	radio_channel_set(mode, channel);

#if CONFIG_FEM
	(void) fem_power_up();

	if (fem.gain != FEM_USE_DEFAULT_GAIN) {
		(void) fem_tx_gain_set(fem.gain);
	}

	if (fem.active_delay == 0) {
		fem.active_delay =
			fem_default_active_delay_calculate(false, mode);
	}

#endif /* CONFIG_FEM */

	/* We let the TIMER start the radio transmission again. */
	nrfx_timer_disable(&timer);
	nrf_timer_shorts_disable(timer.p_reg, ~0);
	nrf_timer_int_disable(timer.p_reg, ~0);

	nrfx_timer_extended_compare(&timer,
		NRF_TIMER_CC_CHANNEL1,
		nrfx_timer_us_to_ticks(&timer, delay_time),
		NRF_TIMER_SHORT_COMPARE1_CLEAR_MASK,
		true);

	nrfx_timer_clear(&timer);
	nrfx_timer_enable(&timer);
}

void radio_test_start(const struct radio_test_config *config)
{
#if CONFIG_FEM
	fem.active_delay = config->fem.active_delay;
	fem.gain = config->fem.gain;
#endif

	switch (config->type) {
	case UNMODULATED_TX:
		radio_unmodulated_tx_carrier(config->mode,
			config->params.unmodulated_tx.txpower,
			config->params.unmodulated_tx.channel);
		break;
	case MODULATED_TX:
		radio_modulated_tx_carrier(config->mode,
			config->params.modulated_tx.txpower,
			config->params.modulated_tx.channel,
			config->params.modulated_tx.pattern);
		break;
	case RX:
		radio_rx(config->mode,
			config->params.rx.channel,
			config->params.rx.pattern);
		break;
	case TX_SWEEP:
		radio_sweep_start(config->params.tx_sweep.channel_start,
			config->params.tx_sweep.delay_ms);
		break;
	case RX_SWEEP:
		radio_sweep_start(config->params.rx_sweep.channel_start,
			config->params.rx_sweep.delay_ms);
		break;
	case MODULATED_TX_DUTY_CYCLE:
		radio_modulated_tx_carrier_duty_cycle(config->mode,
			config->params.modulated_tx_duty_cycle.txpower,
			config->params.modulated_tx_duty_cycle.channel,
			config->params.modulated_tx_duty_cycle.pattern,
			config->params.modulated_tx_duty_cycle.duty_cycle);
		break;
	}
}

void radio_test_cancel(void)
{
	nrfx_timer_disable(&timer);
	radio_disable();
}

void radio_rx_stats_get(struct radio_rx_stats *rx_stats)
{
	size_t size;

#if CONFIG_HAS_HW_NRF_RADIO_IEEE802154
	nrf_radio_mode_t radio_mode;

	radio_mode = nrf_radio_mode_get(NRF_RADIO);
	if (radio_mode == NRF_RADIO_MODE_IEEE802154_250KBIT) {
		size = IEEE_MAX_PAYLOAD_LEN;
	} else {
		size = sizeof(rx_packet);
	}
#else
	size = sizeof(rx_packet);
#endif /* CONFIG_HAS_HW_NRF_RADIO_IEEE802154 */

	rx_stats->last_packet.buf = rx_packet;
	rx_stats->last_packet.len = size;
	rx_stats->packet_cnt = rx_packet_cnt;
}

#if NRF_POWER_HAS_DCDCEN_VDDH || NRF_POWER_HAS_DCDCEN
void toggle_dcdc_state(uint8_t dcdc_state)
{
	bool is_enabled;

#if NRF_POWER_HAS_DCDCEN_VDDH
	if (dcdc_state == 0) {
		is_enabled = nrf_power_dcdcen_vddh_get(NRF_POWER);
		nrf_power_dcdcen_vddh_set(NRF_POWER, !is_enabled);
		return;
	}
#endif /* NRF_POWER_HAS_DCDCEN_VDDH */

#if NRF_POWER_HAS_DCDCEN
	if (dcdc_state <= 1) {
		is_enabled = nrf_power_dcdcen_get(NRF_POWER);
		nrf_power_dcdcen_set(NRF_POWER, !is_enabled);
		return;
	}
#endif /* NRF_POWER_HAS_DCDCEN */
}
#endif /* NRF_POWER_HAS_DCDCEN_VDDH || NRF_POWER_HAS_DCDCEN */

static void timer_handler(nrf_timer_event_t event_type, void *context)
{
	const struct radio_test_config *config =
		(const struct radio_test_config *) context;

	if (event_type == NRF_TIMER_EVENT_COMPARE0) {
		uint8_t channel_start;
		uint8_t channel_end;

		if (config->type == TX_SWEEP) {
			sweep_proccesing = true;
			radio_unmodulated_tx_carrier(config->mode,
				config->params.tx_sweep.txpower,
				current_channel);

			channel_start = config->params.tx_sweep.channel_start;
			channel_end = config->params.tx_sweep.channel_end;
		} else if (config->type == RX_SWEEP) {
			sweep_proccesing = true;
			radio_rx(config->mode,
				current_channel,
				config->params.rx.pattern);

			channel_start = config->params.rx_sweep.channel_start;
			channel_end = config->params.rx_sweep.channel_end;
		} else {
			printk("Unexpected test type: %d\n", config->type);
			return;
		}

		sweep_proccesing = false;

		current_channel++;
		if (current_channel > channel_end) {
			current_channel = channel_start;
		}
	}

	if (event_type == NRF_TIMER_EVENT_COMPARE1) {
#if CONFIG_FEM
		(void) fem_txrx_configuration_clear();
		(void) fem_txrx_stop();
		(void) fem_tx_configure(FEM_EXECUTE_NOW,
					nrf_radio_event_address_get(NRF_RADIO,
								    NRF_RADIO_EVENT_DISABLED),
					fem.active_delay);
#else
		nrf_radio_task_trigger(NRF_RADIO, NRF_RADIO_TASK_TXEN);
#endif /* CONFIG_FEM */
	}
}

static void timer_init(const struct radio_test_config *config)
{
	nrfx_err_t          err;
	nrfx_timer_config_t timer_cfg = {
		.frequency = NRF_TIMER_FREQ_1MHz,
		.mode      = NRF_TIMER_MODE_TIMER,
		.bit_width = NRF_TIMER_BIT_WIDTH_24,
		.p_context = (void *) config,
	};

	err = nrfx_timer_init(&timer, &timer_cfg, timer_handler);
	if (err != NRFX_SUCCESS) {
		printk("nrfx_timer_init failed with: %d\n", err);
	}
}

void radio_handler(const void *context)
{
	const struct radio_test_config *config =
		(const struct radio_test_config *) context;

	if (nrf_radio_event_check(NRF_RADIO, NRF_RADIO_EVENT_CRCOK)) {
		nrf_radio_event_clear(NRF_RADIO, NRF_RADIO_EVENT_CRCOK);
		rx_packet_cnt++;
	}

	if (nrf_radio_event_check(NRF_RADIO, NRF_RADIO_EVENT_END)) {
		nrf_radio_event_clear(NRF_RADIO, NRF_RADIO_EVENT_END);

		tx_packet_cnt++;
		if (tx_packet_cnt == config->params.modulated_tx.packets_num) {
			radio_disable();
			config->params.modulated_tx.cb();
		}
	}
}

int radio_test_init(struct radio_test_config *config)
{
	nrf_rng_task_trigger(NRF_RNG, NRF_RNG_TASK_START);

	timer_init(config);
	IRQ_CONNECT(TIMER0_IRQn, IRQ_PRIO_LOWEST,
		nrfx_timer_0_irq_handler, NULL, 0);

	irq_connect_dynamic(RADIO_IRQn, IRQ_PRIO_LOWEST, radio_handler, config, 0);
	irq_enable(RADIO_IRQn);

	return 0;
}
```

## src/radio_test.h
```c
/*
 * Copyright (c) 2020 Nordic Semiconductor ASA
 *
 * SPDX-License-Identifier: LicenseRef-Nordic-5-Clause
 */

#ifndef RADIO_TEST_H_
#define RADIO_TEST_H_

#include <zephyr/types.h>
#include <hal/nrf_radio.h>

/** Maximum radio RX or TX payload. */
#define RADIO_MAX_PAYLOAD_LEN	256
/** IEEE 802.15.4 maximum payload length. */
#define IEEE_MAX_PAYLOAD_LEN	127
/** IEEE 802.15.4 minimum channel. */
#define IEEE_MIN_CHANNEL	11
/** IEEE 802.15.4 maximum channel. */
#define IEEE_MAX_CHANNEL	26

#define FEM_USE_DEFAULT_GAIN 0xFF

/**@brief Radio transmit and address pattern. */
enum transmit_pattern {
	/** Random pattern generated by RNG. */
	TRANSMIT_PATTERN_RANDOM,

	/** Pattern 11110000(F0). */
	TRANSMIT_PATTERN_11110000,

	/** Pattern 11001100(CC). */
	TRANSMIT_PATTERN_11001100,
};

/**@brief Radio test mode. */
enum radio_test_mode {
	/** TX carrier. */
	UNMODULATED_TX,

	/** Modulated TX carrier. */
	MODULATED_TX,

	/** RX carrier. */
	RX,

	/** TX carrier sweep. */
	TX_SWEEP,

	/** RX carrier sweep. */
	RX_SWEEP,

	/** Duty-cycled modulated TX carrier. */
	MODULATED_TX_DUTY_CYCLE,
};

/**@brief Radio test front-end module (FEM) configuration */
struct radio_test_fem {
	/* Front-end module activation delay. */
	uint32_t active_delay;

	/* Front-end module TX gain. */
	uint8_t gain;
};

/**@brief Radio test configuration. */
struct radio_test_config {
	/** Radio test type. */
	enum radio_test_mode type;

	/** Radio mode. Data rate and modulation. */
	nrf_radio_mode_t mode;

	union {
		struct {
			/** Radio output power. */
			uint8_t txpower;

			/** Radio channel. */
			uint8_t channel;
		} unmodulated_tx;

		struct {
			/** Radio output power. */
			uint8_t txpower;

			/** Radio transmission pattern. */
			enum transmit_pattern pattern;

			/** Radio channel. */
			uint8_t channel;

			/**
			 * Number of pacets to transmit.
			 * Set to zero for continuous TX.
			 */
			uint32_t packets_num;

			/** Callback to indicate that TX is finished. */
			void (*cb)(void);
		} modulated_tx;

		struct {
			/** Radio transmission pattern. */
			enum transmit_pattern pattern;

			/** Radio channel. */
			uint8_t channel;
		} rx;

		struct {
			/** Radio output power. */
			uint8_t txpower;

			/** Radio start channel (frequency). */
			uint8_t channel_start;

			/** Radio end channel (frequency). */
			uint8_t channel_end;

			/** Delay time in milliseconds. */
			uint32_t delay_ms;
		} tx_sweep;

		struct {
			/** Radio start channel (frequency). */
			uint8_t channel_start;

			/** Radio end channel (frequency). */
			uint8_t channel_end;

			/** Delay time in milliseconds. */
			uint32_t delay_ms;
		} rx_sweep;

		struct {
			/** Radio output power. */
			uint8_t txpower;

			/** Radio transmission pattern. */
			enum transmit_pattern pattern;

			/** Radio channel. */
			uint8_t channel;

			/** Duty cycle. */
			uint32_t duty_cycle;
		} modulated_tx_duty_cycle;
	} params;

#if CONFIG_FEM
	/* Front-end module (FEM) configuration. */
	struct radio_test_fem fem;
#endif /* CONFIG_FEM */
};

/**@brief Radio RX statistics. */
struct radio_rx_stats {
	/** Content of the last packet. */
	struct {
		/** Content of the last packet. */
		uint8_t *buf;

		/** Length of the last packet. */
		size_t len;
	} last_packet;

	/** Number of received packets with valid CRC. */
	uint32_t packet_cnt;
};

/**
 * @brief Function for initializing the Radio Test module.
 *
 * @param[in] config  Radio test configuration.
 *
 * @retval 0 If the operation was successful.
 *           Otherwise, a (negative) error code is returned.
 */
int radio_test_init(struct radio_test_config *config);

/**
 * @brief Function for starting radio test.
 *
 * @param[in] config  Radio test configuration.
 */
void radio_test_start(const struct radio_test_config *config);

/**
 * @brief Function for stopping ongoing test (Radio and Timer operations).
 */
void radio_test_cancel(void);

/**
 * @brief Function for get RX statistics.
 *
 * @param[out] rx_stats RX statistics.
 */
void radio_rx_stats_get(struct radio_rx_stats *rx_stats);

/**
 * @brief Function for toggling the DC/DC converter state.
 *
 * @param[in] dcdc_state  DC/DC converter state.
 */
void toggle_dcdc_state(uint8_t dcdc_state);

#endif /* RADIO_TEST_H_ */
```
