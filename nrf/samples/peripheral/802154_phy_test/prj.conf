## CMakeLists.txt
```
#
# Copyright (c) 2021 Nordic Semiconductor
#
# SPDX-License-Identifier: LicenseRef-Nordic-5-Clause
#

cmake_minimum_required(VERSION 3.20.0)

find_package(Zephyr REQUIRED HINTS $ENV{ZEPHYR_BASE})
project(phy_tt LANGUAGES NONE)

target_include_directories(app PRIVATE
    include
    include/internal
    include/internal/ctrl
    include/internal/rf)

target_sources(app PRIVATE
    src/main.c
    src/comm_proc.c
    src/uart_proc.c
    src/rf_proc.c
    src/ptt_conf.c
    src/periph_proc.c
    src/timer_proc.c
    src/ctrl/ptt_ctrl.c
    src/ctrl/ptt_events.c
    src/ctrl/ptt_mode_manager.c
    src/ctrl/ptt_parser.c
    src/ctrl/ptt_proto.c
    src/ctrl/ptt_rf_proc.c
    src/ctrl/ptt_timers.c
    src/ctrl/ptt_uart_proc.c
    src/ctrl/ptt_zb_perf_cmd_mode_ota.c
    src/ctrl/ptt_zb_perf_cmd_mode_response.c
    src/ctrl/ptt_zb_perf_cmd_mode_uart.c
    src/ctrl/ptt_zb_perf_cmd_mode.c
    src/ctrl/ptt_zb_perf_dut_mode.c
    src/rf/ptt_rf.c)
```

## Kconfig
```
#
# Copyright (c) 2021 Nordic Semiconductor
#
# SPDX-License-Identifier: LicenseRef-Nordic-5-Clause
#

source "Kconfig.zephyr"

menu "PHY Test Tool configuration"

choice
	prompt "Device Mode"
	default PTT_BOTH
	help
	  Select the device mode

config PTT_DUT_MODE
	bool "Configure device as a DUT"
	help
	  DUT (Device Under Test) - serial communication is not initialized

config PTT_CMD_MODE
	bool "Configure device as a CMD"
	help
	  CMD - serial communication is available with 115200 8N1 settings

config PTT_BOTH
	bool "Supports both CMD and DUT modes"
	help
	  Device can be switched between modes using "custom changemode 0/1" command.

endchoice

config PTT_POWER
	int "Transmit Power (dBm)"
	default 0
	range -20 8

config PTT_CHANNEL_MASK
	hex "Channel page and channel number mask"
	default 0x00000800

config PTT_SW_VERSION
	int "Software Version"
	default 1
	range 0 255

config PTT_HW_VERSION
	int "Hardware Version"
	default 1
	range 0 255

config PTT_ANTENNA_DIVERSITY
	depends on !SOC_SERIES_NRF53X
	bool "Enable Antenna Diversity [EXPERIMENTAL]"
	select EXPERIMENTAL

if PTT_ANTENNA_DIVERSITY

choice
	prompt "Antenna Mode"
	default PTT_ANT_MODE_AUTO
	help
	  Select the antenna diversity mode

config PTT_ANT_MODE_AUTO
	bool "Automatic"

config PTT_ANT_MODE_MANUAL
	bool "Manual"

endchoice

config PTT_ANTENNA_NUMBER
	int "Antenna Number"
	range 0 1
	default 0

config PTT_ANT_PIN
	int "Antenna Selection Pin"
	default 20
	help
	  Choose which GPIO Pin is responsible for antenna selection

config PTT_ANT_TOGGLE_TIME
	int "Antenna Toggle Time"
	default 40
	help
	  Time in microseconds between antenna switches in Auto Mode

endif #PTT_ANTENNA_DIVERSITY

endmenu
```

## sample.yaml
```
sample:
  name: IEEE 802.15.4 PHY Test Tool
  description: IEEE 802.15.4 PHY Test Tool sample
tests:
  samples.peripheral.802154_phy_test:
    build_only: true
    platform_allow: nrf52840dk_nrf52840 nrf21540dk_nrf52840 nrf5340dk_nrf5340_cpunet
    integration_platforms:
      - nrf52840dk_nrf52840
      - nrf21540dk_nrf52840
      - nrf5340dk_nrf5340_cpunet
    tags: ci_build
```

## prj.conf
```kconfig
# Enabling assert
CONFIG_ASSERT=y

# Logger configuration
CONFIG_LOG=y
CONFIG_LOG_DEFAULT_LEVEL=3
CONFIG_USE_SEGGER_RTT=y
CONFIG_LOG_BACKEND_RTT=y
CONFIG_LOG_BACKEND_UART=n
CONFIG_LOG_STRDUP_BUF_COUNT=10

# Enable UART
CONFIG_UART_INTERRUPT_DRIVEN=y
CONFIG_NRFX_UARTE=y
CONFIG_NRFX_UARTE0=y
CONFIG_UART_0_NRF_TX_BUFFER_SIZE=3072

# Enable temperature sensor
CONFIG_NRFX_TEMP=y

# Enable DC/DC Support
CONFIG_NRFX_POWER=y

# Enable RNG
CONFIG_NRFX_RNG=y
# Use XOROSHIRO PRNG
CONFIG_XOROSHIRO_RANDOM_GENERATOR=y

# Enable Timer
CONFIG_NRFX_TIMER2=y

# Enabling radio driver
CONFIG_NRF_802154_RADIO_DRIVER=y

# Allow sharing the RTC between IEEE 802.15.4 and Zephyr
CONFIG_NRF_RTC_TIMER_USER_CHAN_COUNT=2

# Workaround for a bug in the MPSL Glue Layer (not required for nRF52840)
CONFIG_BT=y

# Include empty image in the APP core (not used for nRF52840)
CONFIG_NCS_SAMPLE_EMPTY_APP_CORE_CHILD_IMAGE=y

# Enable ring buffers
CONFIG_RING_BUFFER=y

# Set temperature sensor update period in ms
CONFIG_NRF_802154_TEMPERATURE_UPDATE_PERIOD=10000

CONFIG_NRF_802154_ENCRYPTION=n
```

## src/main.c
```c
/*
 * Copyright (c) 2021 Nordic Semiconductor ASA
 *
 * SPDX-License-Identifier: LicenseRef-Nordic-5-Clause
 */
#include <init.h>
#include <zephyr.h>

#include "rf_proc.h"
#include "timer_proc.h"
#include "comm_proc.h"
#include "periph_proc.h"

#include <logging/log.h>
	LOG_MODULE_REGISTER(phy_tt);

/* size of stack area used by each thread */
#define RF_THREAD_STACKSIZE (1024u)
#define COMM_THREAD_STACKSIZE (1024u)

/* scheduling priority used by each thread */
#define RF_THREAD_PRIORITY (7u)
#define COMM_THREAD_PRIORITY (7u)

void ptt_do_reset_ext(void)
{
	NVIC_SystemReset();
}

static int rf_setup(const struct device *dev)
{
	LOG_INF("RF setup started");

	ARG_UNUSED(dev);

	rf_init();

	return 0;
}

static int setup(const struct device *dev)
{
	LOG_INF("Setup started");

	ARG_UNUSED(dev);

	periph_init();

	comm_init();

	/* initialize ptt library */
	ptt_init(launch_ptt_process_timer, ptt_get_max_time());

	return 0;
}

SYS_INIT(rf_setup, POST_KERNEL, PTT_RF_INIT_PRIORITY);

SYS_INIT(setup, APPLICATION, CONFIG_APPLICATION_INIT_PRIORITY);

K_THREAD_DEFINE(rf_id, RF_THREAD_STACKSIZE, rf_thread, NULL, NULL, NULL, RF_THREAD_PRIORITY, 0, 0);

K_THREAD_DEFINE(comm_id, COMM_THREAD_STACKSIZE, comm_proc, NULL, NULL, NULL, COMM_THREAD_PRIORITY,
		0, 0);
```

## include/comm_proc.h
```c
/*
 * Copyright (c) 2021 Nordic Semiconductor ASA
 *
 * SPDX-License-Identifier: LicenseRef-Nordic-5-Clause
 */
/* Purpose: communication interfaces */

#ifndef COMM_PROC_H__
#define COMM_PROC_H__

#include <stdint.h>

#include <kernel.h>

/**< Maximum expected size of received packet */
#define COMM_MAX_TEXT_DATA_SIZE (320u)

/**< Time to wait for a mark of end of a packet (new line) */
#define COMM_PER_COMMAND_TIMEOUT (500u)

/**< Maximum size of transmitted packet */
#define COMM_TX_BUFFER_SIZE (320u)

/**< Additional symbols in the end of transmitted packet */
#define COMM_APPENDIX "\r\n"
#define COMM_APPENDIX_SIZE sizeof(COMM_APPENDIX)

/**< Stated of COMM packet parser */
enum input_state {
	INPUT_STATE_IDLE = 0, /**< Wait for the first symbol */
	INPUT_STATE_WAITING_FOR_NEWLINE, /**< Wait for new line symbol or timeout */
	INPUT_STATE_TEXT_PROCESSING, /**< Passes received string to the library */
};

struct text_proc_s {
	struct k_timer timer;
	struct k_work work;
	char buf[COMM_MAX_TEXT_DATA_SIZE];
	uint16_t len;
	enum input_state state;
};

void comm_init(void);

void comm_input_process(struct text_proc_s *text_proc, const uint8_t *buf, uint32_t len);

void comm_text_processor_fn(struct k_work *work);

void comm_proc(void);

void comm_input_timeout_handler(struct k_timer *timer);

#endif /* COMM_PROC_H__ */
```

## include/rf_proc.h
```c
/*
 * Copyright (c) 2021 Nordic Semiconductor ASA
 *
 * SPDX-License-Identifier: LicenseRef-Nordic-5-Clause
 */
/* Purpose: RF interfaces */

#ifndef RF_PROC_H__
#define RF_PROC_H__

#include <stdint.h>

#include "ptt_rf_api.h"

/**< Size of PHY header */
#define RF_PHR_SIZE (1u)

/**< Size of frame check sequence */
#define RF_FCS_SIZE (2u)

/**< Maximum size of PSDU */
#define RF_PSDU_MAX_SIZE (127u)

/**< Start of PSDU payload */
#define RF_PSDU_START (1u)

#define PTT_RF_INIT_PRIORITY CONFIG_SENSOR_INIT_PRIORITY

/** @brief NRF radio driver initialization
 *
 *  @param none
 *
 *  @return none
 */
void rf_init(void);

/** @brief NRF radio driver deinitialization
 *
 *  @param none
 *
 *  @return none
 */
void rf_uninit(void);

/** @brief Thread function for Radio handling
 *
 *  @param none
 *
 *  @return none
 *
 */
void rf_thread(void);

/**< element of received packets array */
struct rf_rx_pkt_s {
	uint8_t *rf_buf; /**< pointer to buffer inside radio driver with a received packet */
	uint8_t *data; /**< pointer to payload */
	ptt_pkt_len_t length; /**< size of payload of received packet */
	int8_t rssi; /**< RSSI */
	uint8_t lqi; /**< LQI */
};

#endif /* RF_PROC_H__ */
```

## include/uart_proc.h
```c
/*
 * Copyright (c) 2021 Nordic Semiconductor ASA
 *
 * SPDX-License-Identifier: LicenseRef-Nordic-5-Clause
 */
/* Purpose: uart interfaces */

#ifndef UART_PROC_H__
#define UART_PROC_H__

#include <stdint.h>

#include "ptt.h"

/**< Amount of bytes requested from driver */
#define UART_BYTES_TO_READ (1u)

/** @brief Initialize UARTE driver and UART module inside PTT library
 *
 *  @param none
 *
 *  @return none
 *
 */
void uart_init(void);

int32_t uart_send(const uint8_t *pkt, ptt_pkt_len_t len, bool add_crlf);

#endif /* UART_PROC_H__ */
```

## src/comm_proc.c
```c
/*
 * Copyright (c) 2021 Nordic Semiconductor ASA
 *
 * SPDX-License-Identifier: LicenseRef-Nordic-5-Clause
 */
/* Purpose: Communication interface for library */

#include <assert.h>
#include <stdint.h>

#include "uart_proc.h"
#ifdef USE_USB
#include "usb_proc.h"
#endif
#include "comm_proc.h"

#include <logging/log.h>
LOG_MODULE_REGISTER(comm);

#include "ptt_uart_api.h"

static int32_t comm_send_cb(const uint8_t *pkt, ptt_pkt_len_t len, bool add_crlf);

static void comm_symbols_process(struct text_proc_s *text_proc, const uint8_t *buf, uint32_t len);
static inline void text_process(struct text_proc_s *text_proc);
static inline void input_state_reset(struct text_proc_s *text_proc);

void comm_input_process(struct text_proc_s *text_proc, const uint8_t *buf, uint32_t len)
{
	switch (text_proc->state) {
	case INPUT_STATE_IDLE:
		if (text_proc->len != 0) {
			LOG_WRN("text_proc->len is not 0 when input state is idle");
			text_proc->len = 0;
		}

		/* start the timer after first received symbol */
		k_timer_start(&text_proc->timer, K_MSEC(COMM_PER_COMMAND_TIMEOUT), K_MSEC(0));

		text_proc->state = INPUT_STATE_WAITING_FOR_NEWLINE;

		comm_symbols_process(text_proc, buf, len);
		break;

	case INPUT_STATE_WAITING_FOR_NEWLINE:
		comm_symbols_process(text_proc, buf, len);
		break;

	case INPUT_STATE_TEXT_PROCESSING:
		LOG_WRN("received a command when processing previous one, discarded");
		break;

	default:
		LOG_ERR("incorrect input state");
		break;
	}
}

K_FIFO_DEFINE(text_processing_fifo);

void comm_text_processor_fn(struct k_work *work)
{
	LOG_DBG("Called work queue function");
	struct text_proc_s *text_proc = CONTAINER_OF(work, struct text_proc_s, work);

	/* force string termination for further processing */
	text_proc->buf[text_proc->len] = '\0';
	LOG_DBG("received packet to lib: len %d, %s", text_proc->len, log_strdup(text_proc->buf));
	text_process(text_proc);
}

void comm_input_timeout_handler(struct k_timer *timer)
{
	LOG_DBG("push packet to lib via timer");
	struct text_proc_s *text_proc = CONTAINER_OF(timer, struct text_proc_s, timer);

	k_work_submit(&text_proc->work);
}

static void comm_symbols_process(struct text_proc_s *text_proc, const uint8_t *buf, uint32_t len)
{
	for (uint32_t cnt = 0; cnt < len; cnt++) {
		if (('\n' != buf[cnt]) && ('\r' != buf[cnt])) {
			text_proc->buf[text_proc->len] = buf[cnt];
			++text_proc->len;

			if (text_proc->len >= COMM_MAX_TEXT_DATA_SIZE) {
				LOG_ERR("cannot parse %d bytes received, freeing input buffer",
					COMM_MAX_TEXT_DATA_SIZE);

				/* Stop the timeout timer */
				k_timer_stop(&text_proc->timer);
				input_state_reset(text_proc);
			}
		} else {
			LOG_DBG("push packet to lib via newline");
			/* Stop the timeout timer */
			k_timer_stop(&text_proc->timer);
			k_work_submit(&text_proc->work);

			text_proc->state = INPUT_STATE_TEXT_PROCESSING;
			break;
		}
	}
}

static inline void input_state_reset(struct text_proc_s *text_proc)
{
	text_proc->len = 0;
	text_proc->state = INPUT_STATE_IDLE;
}

static inline void text_process(struct text_proc_s *text_proc)
{
	ptt_uart_push_packet((uint8_t *)text_proc->buf, text_proc->len);
	input_state_reset(text_proc);
}

void comm_init(void)
{
	/* won't initialize UART if the device has DUT mode only */
#if CONFIG_PTT_DUT_MODE
	LOG_INF("Device is in DUT mode only.");
#else
	LOG_INF("Init");
	uart_init();
#ifdef USE_USB
	usb_init();
#endif
	ptt_uart_init(comm_send_cb);
#endif
}

static int32_t comm_send_cb(const uint8_t *pkt, ptt_pkt_len_t len, bool add_crlf)
{
	if ((add_crlf && (len >= (COMM_TX_BUFFER_SIZE - COMM_APPENDIX_SIZE))) ||
	    (!add_crlf && (len >= COMM_TX_BUFFER_SIZE))) {
		LOG_WRN("%s: not enough of tx buffer size", __func__);
		return -1;
	}

	uart_send(pkt, len, add_crlf);

#ifdef USE_USB
	usb_send(pkt, len, add_crlf);
#endif

	return len;
}

void comm_proc(void)
{
#ifdef USE_USB
	usb_task();
#endif
}
```

## src/periph_proc.c
```c
/*
 * Copyright (c) 2021 Nordic Semiconductor ASA
 *
 * SPDX-License-Identifier: LicenseRef-Nordic-5-Clause
 */
/* Purpose: Periphery configuring and processing */

#include <assert.h>
#include <stdint.h>

#include <random/rand32.h>

#include "periph_proc.h"

#include <nrfx_timer.h>
#include <helpers/nrfx_gppi.h>
#include <nrfx.h>
#include <nrfx_nvmc.h>
#include <nrfx_power.h>
#include <hal/nrf_gpio.h>
#include <nrfx_gpiote.h>
#include <platform/nrf_802154_temperature.h>

#include <devicetree.h>
#include <drivers/gpio.h>
#include <drivers/clock_control.h>
#include <drivers/clock_control/nrf_clock_control.h>

#if defined(DPPI_PRESENT)
#include <nrfx_dppi.h>
#else
#include <nrfx_ppi.h>
#endif

#include <logging/log.h>
LOG_MODULE_REGISTER(periph);

/* Timer instance used for HFCLK output */
#define PTT_CLK_TIMER 2

static struct onoff_client hfclk_cli;
static nrfx_timer_t clk_timer = NRFX_TIMER_INSTANCE(PTT_CLK_TIMER);

/* The devicetree node identifier for the "led0" alias. */
#define LED0_NODE DT_ALIAS(led0)

#if DT_NODE_HAS_STATUS(LED0_NODE, okay)
#define LED0 DT_GPIO_LABEL(LED0_NODE, gpios)
#define PIN DT_GPIO_PIN(LED0_NODE, gpios)
#define FLAGS DT_GPIO_FLAGS(LED0_NODE, gpios)
#else
/* A build error here means your board isn't set up to blink an LED. */
#error "Unsupported board: led0 devicetree alias is not defined"
#define LED0 ""
#define PIN 0
#define FLAGS 0
#endif

#define CLOCK_NODE DT_INST(0, nordic_nrf_clock)

static const struct device *indication_led_dev;
static const struct device *gpio_port0_dev;

/* Check if the system has GPIO port 1 */
#if DT_NODE_HAS_STATUS(DT_NODELABEL(gpio1), okay)
static const struct device *gpio_port1_dev;

#endif

#if defined(DPPI_PRESENT)
uint8_t ppi_channel;

#else
nrf_ppi_channel_t ppi_channel;

#endif

static void hfclk_on_callback(struct onoff_manager *mgr, struct onoff_client *cli, uint32_t state,
			      int res)
{
	/* do nothing */
}

static void clk_timer_handler(nrf_timer_event_t event_type, void *context)
{
	/* do nothing */
}

void periph_init(void)
{
	nrfx_err_t err_code;
	int ret;

	/* Enable HFCLK */
	struct onoff_manager *mgr = z_nrf_clock_control_get_onoff(CLOCK_CONTROL_NRF_SUBSYS_HF);

	__ASSERT_NO_MSG(mgr != NULL);

	sys_notify_init_callback(&hfclk_cli.notify, hfclk_on_callback);

	ret = onoff_request(mgr, &hfclk_cli);
	__ASSERT_NO_MSG(ret >= 0);

	nrfx_timer_config_t clk_timer_cfg = NRFX_TIMER_DEFAULT_CONFIG;

	err_code = nrfx_timer_init(&clk_timer, &clk_timer_cfg, clk_timer_handler);
	NRFX_ASSERT(err_code);

	err_code = nrfx_gpiote_init(0);
	NRFX_ASSERT(err_code);

	indication_led_dev = device_get_binding(LED0);
	assert(indication_led_dev);

	ret = gpio_pin_configure(indication_led_dev, PIN, GPIO_OUTPUT_ACTIVE | FLAGS);

	assert(ret == 0);
	gpio_pin_set(indication_led_dev, PIN, false);

	gpio_port0_dev = device_get_binding(DT_LABEL(DT_NODELABEL(gpio0)));
	assert(gpio_port0_dev);

#if DT_NODE_HAS_STATUS(DT_NODELABEL(gpio1), okay)
	gpio_port1_dev = device_get_binding(DT_LABEL(DT_NODELABEL(gpio1)));
	assert(gpio_port1_dev);
#endif
}

uint32_t ptt_random_get_ext(void)
{
	return sys_rand32_get();
}

bool ptt_clk_out_ext(uint8_t pin, bool mode)
{
	uint32_t compare_evt_addr;
	nrfx_err_t err;

	if (!nrf_gpio_pin_present_check(pin)) {
		return false;
	}

	if (mode) {
		nrfx_timer_extended_compare(&clk_timer, (nrf_timer_cc_channel_t)0, 1,
					    NRF_TIMER_SHORT_COMPARE0_CLEAR_MASK, false);

		nrfx_gpiote_out_config_t const out_config = {
			.action = NRF_GPIOTE_POLARITY_TOGGLE,
			.init_state = 0,
			.task_pin = true,
		};

		/* Initialize output pin. SET task will turn the LED on,
		 * CLR will turn it off and OUT will toggle it.
		 */
		err = nrfx_gpiote_out_init(pin, &out_config);
		if (err != NRFX_SUCCESS) {
			LOG_ERR("nrfx_gpiote_out_init error: %08x", err);
			return false;
		}

		compare_evt_addr =
			nrfx_timer_event_address_get(&clk_timer, NRF_TIMER_EVENT_COMPARE0);

		nrfx_gpiote_out_task_enable(pin);

		/* Allocate a (D)PPI channel. */
#if defined(DPPI_PRESENT)
		err = nrfx_dppi_channel_alloc(&ppi_channel);
#else
		err = nrfx_ppi_channel_alloc(&ppi_channel);
#endif
		if (err != NRFX_SUCCESS) {
			LOG_ERR("(D)PPI channel allocation error: %08x", err);
			return false;
		}

		nrfx_gppi_channel_endpoints_setup(
			ppi_channel, compare_evt_addr,
			nrf_gpiote_task_address_get(NRF_GPIOTE, nrfx_gpiote_in_event_get(pin)));

		/* Enable (D)PPI channel. */
#if defined(DPPI_PRESENT)
		err = nrfx_dppi_channel_enable(ppi_channel);
#else
		err = nrfx_ppi_channel_enable(ppi_channel);
#endif
		if (err != NRFX_SUCCESS) {
			LOG_ERR("Failed to enable (D)PPI channel, error: %08x", err);
			return false;
		}

		nrfx_timer_enable(&clk_timer);
	} else {
		nrfx_timer_disable(&clk_timer);
		nrfx_gpiote_out_task_disable(pin);
#if defined(DPPI_PRESENT)
		err = nrfx_dppi_channel_free(ppi_channel);
#else
		err = nrfx_ppi_channel_free(ppi_channel);
#endif
		if (err != NRFX_SUCCESS) {
			LOG_ERR("Failed to disable (D)PPI channel, error: %08x", err);
			return false;
		}
		nrfx_gpiote_out_uninit(pin);
	}

	return true;
}

static const struct device *get_pin_port(uint32_t *pin)
{
	switch (nrf_gpio_pin_port_number_extract(pin)) {
	case 0:
		return gpio_port0_dev;

#if DT_NODE_HAS_STATUS(DT_NODELABEL(gpio1), okay)
	case 1:
		return gpio_port1_dev;

#endif
	default:
		return NULL;
	}
}

bool ptt_set_gpio_ext(uint8_t pin, uint8_t value)
{
	int ret;
	const struct device *port;
	uint32_t pin_nr = pin;

	if (nrf_gpio_pin_present_check(pin_nr)) {
		port = get_pin_port(&pin_nr);
		if (port == NULL) {
			return false;
		}

		ret = gpio_pin_configure(port, pin_nr, GPIO_OUTPUT);

		if (ret == 0) {
			ret = gpio_pin_set(port, pin_nr, value);
			if (ret == 0) {
				return true;
			}
		}
	}

	return false;
}

bool ptt_get_gpio_ext(uint8_t pin, uint8_t *value)
{
	int ret;
	const struct device *port;
	uint32_t pin_nr = pin;

	if (nrf_gpio_pin_present_check(pin_nr)) {
		port = get_pin_port(&pin_nr);
		if (port == NULL) {
			return false;
		}

		ret = gpio_pin_configure(port, pin_nr, GPIO_INPUT);

		if (ret == 0) {
			*value = gpio_pin_get(port, pin_nr);
			return true;
		}
	}

	return false;
}

void ptt_set_dcdc_ext(bool enable)
{
#if NRF_POWER_HAS_DCDCEN
	nrf_power_dcdcen_set(NRF_POWER, enable);
#endif

#if NRF_POWER_HAS_DCDCEN_VDDH
	nrf_power_dcdcen_vddh_set(NRF_POWER, enable);
#endif

#if !NRF_POWER_HAS_DCDCEN && !NRF_POWER_HAS_DCDCEN_VDDH
#pragma message "DC-DC related commands have no effect!"
#endif
}

bool ptt_get_dcdc_ext(void)
{
#if NRF_POWER_HAS_DCDCEN && NRF_POWER_HAS_DCDCEN_VDDH
	return (nrf_power_dcdcen_get(NRF_POWER) || nrf_power_dcdcen_vddh_get(NRF_POWER));
#elif NRF_POWER_HAS_DCDCEN
	return nrf_power_dcdcen_get(NRF_POWER);
#elif NRF_POWER_HAS_DCDCEN_VDDH
	return nrf_power_dcdcen_vddh_get(NRF_POWER);
#else
	return false;
#endif
}

void ptt_set_icache_ext(bool enable)
{
#if defined(NVMC_FEATURE_CACHE_PRESENT)
	if (enable) {
		nrfx_nvmc_icache_enable();
	} else {
		nrfx_nvmc_icache_disable();
	}
#else
#pragma message "ICACHE related command have no effect"
#endif
}

bool ptt_get_icache_ext(void)
{
#if defined(NVMC_FEATURE_CACHE_PRESENT)
	return nrf_nvmc_icache_enable_check(NRF_NVMC);
#else
	return false;
#endif
}

bool ptt_get_temp_ext(int32_t *temp)
{
	if (temp == NULL) {
		return false;
	}

	*temp = nrf_802154_temperature_get();

	return true;
}

void ptt_ctrl_led_indication_on_ext(void)
{
	gpio_pin_set(indication_led_dev, PIN, true);
}

void ptt_ctrl_led_indication_off_ext(void)
{
	gpio_pin_set(indication_led_dev, PIN, false);
}
```

## src/rf_proc.c
```c
/*
 * Copyright (c) 2021 Nordic Semiconductor ASA
 *
 * SPDX-License-Identifier: LicenseRef-Nordic-5-Clause
 */
/* Purpose: Adaptation layer for RF configuring and processing */

#include <assert.h>
#include <stdbool.h>
#include <stdint.h>
#include <kernel.h>
#include <nrfx_gpiote.h>
#include <nrfx.h>

#if defined(DPPI_PRESENT)
#include <nrfx_dppi.h>
#else
#include <nrfx_ppi.h>
#endif

#include "nrf_802154.h"
#include "nrf_802154_sl_ant_div.h"

#include "rf_proc.h"

#include "ptt.h"

#include <logging/log.h>
LOG_MODULE_REGISTER(rf_proc);

/**< Maximum size of RF pool of received packets */
#define RF_RX_POOL_N 16u

static struct rf_rx_pkt_s rf_rx_pool[RF_RX_POOL_N];
static struct rf_rx_pkt_s ack_packet;
static uint8_t temp_tx_pkt[RF_PSDU_MAX_SIZE];

static inline void rf_rx_pool_init(void);
static void rf_rx_pool_clear(void);

static void rf_tx_finished_fn(struct k_work *work)
{
	ptt_rf_tx_finished();
}

K_WORK_DEFINE(rf_tx_finished_wq, rf_tx_finished_fn);

static void rf_tx_ack_received_fn(struct k_work *work)
{
	ptt_rf_push_packet(ack_packet.data, ack_packet.length, ack_packet.rssi, ack_packet.lqi);
	nrf_802154_buffer_free_raw(ack_packet.rf_buf);
}

K_WORK_DEFINE(rf_tx_ack_received_wq, rf_tx_ack_received_fn);

static void rf_cca_failed_fn(struct k_work *work)
{
	ptt_rf_cca_failed();
}

K_WORK_DEFINE(rf_cca_failed_wq, rf_cca_failed_fn);

static void rf_ed_failed_fn(struct k_work *work)
{
	ptt_rf_ed_failed();
}

K_WORK_DEFINE(rf_ed_failed_wq, rf_ed_failed_fn);

struct rf_rx_failed_info {
	struct k_work work;
	ptt_rf_tx_error_t rx_error;
} rf_rx_failed_info;
static void rf_rx_failed_fn(struct k_work *work)
{
	ptt_rf_rx_failed(rf_rx_failed_info.rx_error);
}

struct rf_tx_failed_info {
	struct k_work work;
	ptt_rf_tx_error_t tx_error;
} rf_tx_failed_info;
static void rf_tx_failed_fn(struct k_work *work)
{
	ptt_rf_tx_failed(rf_tx_failed_info.tx_error);
}

struct rf_cca_done_info {
	struct k_work work;
	bool channel_free;
} rf_cca_done_info;
static void rf_cca_done_fn(struct k_work *work)
{
	ptt_rf_cca_done((bool)rf_cca_done_info.channel_free);
}

struct rf_ed_detected_info {
	struct k_work work;
	uint8_t result;
} rf_ed_detected_info;
static void rf_ed_detected_fn(struct k_work *work)
{
	ptt_rf_ed_detected((ptt_ed_t)rf_ed_detected_info.result);
}

#if CONFIG_PTT_ANTENNA_DIVERSITY
static void configure_antenna_diversity(void);

#endif /* CONFIG_PTT_ANTENNA_DIVERSITY */

void rf_init(void)
{
	k_work_init(&rf_rx_failed_info.work, rf_rx_failed_fn);
	k_work_init(&rf_tx_failed_info.work, rf_tx_failed_fn);
	k_work_init(&rf_cca_done_info.work, rf_cca_done_fn);
	k_work_init(&rf_ed_detected_info.work, rf_ed_detected_fn);

	/* clear a pool for received packets */
	rf_rx_pool_init();
	ack_packet = (struct rf_rx_pkt_s){ 0 };

	/* nrf radio driver initialization */
	nrf_802154_init();

#if CONFIG_PTT_ANTENNA_DIVERSITY
	configure_antenna_diversity();
#endif
}

void rf_uninit(void)
{
	/* free packets and marks them as free */
	rf_rx_pool_clear();
	ack_packet = (struct rf_rx_pkt_s){ 0 };
	nrf_802154_deinit();
}

#if CONFIG_PTT_ANTENNA_DIVERSITY
static void configure_antenna_diversity(void)
{
	nrf_ppi_channel_t ppi_channel;
	uint8_t gpiote_channel;
	NRF_TIMER_Type *ad_timer = NRF_TIMER3;

	nrf_802154_sl_ant_div_cfg_t cfg = {
		.ant_sel_pin = CONFIG_PTT_ANT_PIN,
		.toggle_time = CONFIG_PTT_ANT_TOGGLE_TIME,
		.p_timer = ad_timer
	};

	nrfx_ppi_channel_alloc(&ppi_channel);
	cfg.ppi_ch = (uint8_t)ppi_channel;
	nrfx_gpiote_channel_alloc(&gpiote_channel);
	cfg.gpiote_ch = gpiote_channel;
	nrf_802154_sl_ant_div_mode_t ant_div_auto = 0x02;

	nrf_802154_antenna_diversity_config_set(&cfg);
	nrf_802154_antenna_diversity_init();
	nrf_802154_antenna_diversity_rx_mode_set(ant_div_auto);
	nrf_802154_antenna_diversity_tx_mode_set(ant_div_auto);
}

#endif /* CONFIG_PTT_ANTENNA_DIVERSITY */

static void rf_process_rx_packets(void)
{
	struct rf_rx_pkt_s *rx_pkt = NULL;

	for (uint8_t i = 0; i < RF_RX_POOL_N; i++) {
		rx_pkt = &rf_rx_pool[i];
		if (rx_pkt->data != NULL) {
			ptt_rf_push_packet(rx_pkt->data, rx_pkt->length, rx_pkt->rssi, rx_pkt->lqi);
			nrf_802154_buffer_free_raw(rx_pkt->rf_buf);
			rx_pkt->data = NULL;
		}
	}
}

void rf_thread(void)
{
	while (1) {
		rf_process_rx_packets();
		k_sleep(K_MSEC(1));
	}
}

void nrf_802154_received_raw(uint8_t *data, int8_t power, uint8_t lqi)
{
	struct rf_rx_pkt_s *rx_pkt = NULL;
	bool pkt_placed = false;

	assert(data != NULL);

	for (uint8_t i = 0; i < RF_RX_POOL_N; i++) {
		if (rf_rx_pool[i].data == NULL) {
			rx_pkt = &rf_rx_pool[i];
			rx_pkt->rf_buf = data;
			rx_pkt->data = &data[1];
			rx_pkt->length = data[0] - RF_FCS_SIZE;
			rx_pkt->rssi = power;
			rx_pkt->lqi = lqi;
			pkt_placed = true;
			break;
		}
	}
	if (false == pkt_placed) {
		LOG_ERR("Not enough space to store packet. Will drop it.");
		nrf_802154_buffer_free_raw(data);
	}
}

void nrf_802154_receive_failed(nrf_802154_rx_error_t error, uint32_t id)
{
	LOG_INF("rx failed error %d!", error);

	/* mapping nrf_802154 errors into PTT RF errors */
	/* actually only invalid ACK FCS matters at the moment */
	if (error == NRF_802154_RX_ERROR_INVALID_FCS) {
		rf_rx_failed_info.rx_error = PTT_RF_RX_ERROR_INVALID_FCS;
	} else {
		rf_rx_failed_info.rx_error = PTT_RF_RX_ERROR_OPERATION_FAILED;
	}

	k_work_submit(&rf_rx_failed_info.work);
}

void nrf_802154_transmitted_raw(uint8_t *frame,
	const nrf_802154_transmit_done_metadata_t *metadata)
{
	ARG_UNUSED(frame);

	if (metadata->data.transmitted.p_ack != NULL) {
		ack_packet = (struct rf_rx_pkt_s){ 0 };

		ack_packet.data = metadata->data.transmitted.p_ack;
		ack_packet.length = metadata->data.transmitted.length;
		ack_packet.rssi = metadata->data.transmitted.power;
		ack_packet.lqi = metadata->data.transmitted.lqi;
		ack_packet.rf_buf = metadata->data.transmitted.p_ack;

		k_work_submit(&rf_tx_ack_received_wq);
	}

	k_work_submit(&rf_tx_finished_wq);
}

void nrf_802154_transmit_failed(uint8_t *frame, nrf_802154_tx_error_t error,
	const nrf_802154_transmit_done_metadata_t *p_metadata)
{
	ARG_UNUSED(frame);

	LOG_INF("tx failed error %d!", error);

	/* mapping nrf_802154 errors into PTT RF errors */
	if (error == NRF_802154_TX_ERROR_INVALID_ACK) {
		rf_tx_failed_info.tx_error = PTT_RF_TX_ERROR_INVALID_ACK_FCS;
	} else if (error == NRF_802154_TX_ERROR_NO_ACK) {
		rf_tx_failed_info.tx_error = PTT_RF_TX_ERROR_NO_ACK;
	} else {
		rf_tx_failed_info.tx_error = PTT_RF_TX_ERROR_OPERATION_FAILED;
	}

	k_work_submit(&rf_tx_failed_info.work);
}

void nrf_802154_cca_done(bool channel_free)
{
	LOG_INF("CCA finished with result %d", channel_free);

	rf_cca_done_info.channel_free = channel_free;
	k_work_submit(&rf_cca_done_info.work);
}

void nrf_802154_cca_failed(nrf_802154_cca_error_t error)
{
	ARG_UNUSED(error);

	LOG_INF("CCA failed error %d!", error);

	k_work_submit(&rf_cca_failed_wq);
}

void nrf_802154_energy_detected(uint8_t result)
{
	LOG_INF("ED finished with result %d", result);

	rf_ed_detected_info.result = result;
	k_work_submit(&rf_ed_detected_info.work);
}

void nrf_802154_energy_detection_failed(nrf_802154_ed_error_t error)
{
	ARG_UNUSED(error);

	LOG_INF("ED failed error %d!", error);

	k_work_submit(&rf_ed_failed_wq);
}

void ptt_rf_set_channel_ext(uint8_t channel)
{
	nrf_802154_channel_set(channel);
}

void ptt_rf_set_power_ext(int8_t power)
{
	nrf_802154_tx_power_set(power);
}

int8_t ptt_rf_get_power_ext(void)
{
	return nrf_802154_tx_power_get();
}

void ptt_rf_set_antenna_ext(uint8_t antenna)
{
#if CONFIG_PTT_ANTENNA_DIVERSITY
	nrf_802154_sl_ant_div_antenna_t ant = antenna;

	nrf_802154_antenna_diversity_rx_antenna_set(ant);
	nrf_802154_antenna_diversity_tx_antenna_set(ant);
#endif
}

void ptt_rf_set_tx_antenna_ext(uint8_t antenna)
{
#if CONFIG_PTT_ANTENNA_DIVERSITY
	nrf_802154_sl_ant_div_antenna_t ant = antenna;

	nrf_802154_antenna_diversity_tx_antenna_set(ant);
#endif
}

void ptt_rf_set_rx_antenna_ext(uint8_t antenna)
{
#if CONFIG_PTT_ANTENNA_DIVERSITY
	nrf_802154_sl_ant_div_antenna_t ant = antenna;

	nrf_802154_antenna_diversity_rx_antenna_set(ant);
#endif
}

uint8_t ptt_rf_get_rx_antenna_ext(void)
{
#if CONFIG_PTT_ANTENNA_DIVERSITY
	return nrf_802154_antenna_diversity_rx_antenna_get();
#else
	return 0;
#endif
}

uint8_t ptt_rf_get_tx_antenna_ext(void)
{
#if CONFIG_PTT_ANTENNA_DIVERSITY
	return nrf_802154_antenna_diversity_tx_antenna_get();
#else
	return 0;
#endif
}

uint8_t ptt_rf_get_lat_rx_best_antenna_ext(void)
{
#if CONFIG_PTT_ANTENNA_DIVERSITY
	return nrf_802154_antenna_diversity_last_rx_best_antenna_get();
#else
	return 0;
#endif
}

void ptt_rf_promiscuous_set_ext(bool value)
{
	nrf_802154_promiscuous_set(value);
}

bool ptt_rf_receive_ext(void)
{
	return nrf_802154_receive();
}

void ptt_rf_set_pan_id_ext(const uint8_t *pan_id)
{
	nrf_802154_pan_id_set(pan_id);
}

void ptt_rf_set_extended_address_ext(const uint8_t *extended_address)
{
	nrf_802154_extended_address_set(extended_address);
}

void ptt_rf_set_short_address_ext(const uint8_t *short_address)
{
	nrf_802154_short_address_set(short_address);
}

bool ptt_rf_cca_ext(uint8_t mode)
{
	bool ret = false;

	if ((mode >= NRF_RADIO_CCA_MODE_CARRIER) && (mode <= NRF_RADIO_CCA_MODE_CARRIER_OR_ED)) {
		nrf_802154_cca_cfg_t cca_cfg;

		nrf_802154_cca_cfg_get(&cca_cfg);

		cca_cfg.mode = mode;

		nrf_802154_cca_cfg_set(&cca_cfg);

		ret = nrf_802154_cca();
	} else {
		ret = false;
	}

	return ret;
}

bool ptt_rf_ed_ext(uint32_t time_us)
{
	return nrf_802154_energy_detection(time_us);
}

bool ptt_rf_rssi_measure_begin_ext(void)
{
	return nrf_802154_rssi_measure_begin();
}

int8_t ptt_rf_rssi_last_get_ext(void)
{
	return nrf_802154_rssi_last_get();
}

bool ptt_rf_send_packet_ext(const uint8_t *pkt, ptt_pkt_len_t len, bool cca)
{
	bool ret = false;

	if ((pkt == NULL) || (len > RF_PSDU_MAX_SIZE - RF_FCS_SIZE)) {
		ret = false;
	} else {
		/* temp_tx_pkt is protected inside ptt rf by locking mechanism */
		temp_tx_pkt[0] = len + RF_FCS_SIZE;
		memcpy(&temp_tx_pkt[RF_PSDU_START], pkt, len);
		const nrf_802154_transmit_metadata_t metadata = {
			.frame_props = NRF_802154_TRANSMITTED_FRAME_PROPS_DEFAULT_INIT,
			.cca = cca
		};
		ret = nrf_802154_transmit_raw(temp_tx_pkt, &metadata);
	}

	return ret;
}

bool ptt_rf_modulated_stream_ext(const uint8_t *pkt, ptt_pkt_len_t len)
{
	bool ret = false;

	if ((pkt == NULL) || (len > RF_PSDU_MAX_SIZE - RF_FCS_SIZE)) {
		ret = false;
	} else {
		/* temp_tx_pkt is protected inside ptt rf by locking mechanism */
		temp_tx_pkt[0] = len + RF_FCS_SIZE;
		memcpy(&temp_tx_pkt[RF_PSDU_START], pkt, len);

		ret = nrf_802154_modulated_carrier(temp_tx_pkt);
	}

	return ret;
}

bool ptt_rf_sleep_ext(void)
{
	return nrf_802154_sleep();
}

bool ptt_rf_continuous_carrier_ext(void)
{
	return nrf_802154_continuous_carrier();
}

static inline void rf_rx_pool_init(void)
{
	for (uint8_t i = 0; i < RF_RX_POOL_N; i++) {
		rf_rx_pool[i] = (struct rf_rx_pkt_s){ 0 };
	}
}

static void rf_rx_pool_clear(void)
{
	struct rf_rx_pkt_s *rx_pkt = NULL;

	for (uint8_t i = 0; i < RF_RX_POOL_N; i++) {
		rx_pkt = &rf_rx_pool[i];
		if (rx_pkt->data != NULL) {
			nrf_802154_buffer_free_raw(rx_pkt->rf_buf);
			rx_pkt->data = NULL;
		}
	}
}
```

## src/timer_proc.c
```c
/*
 * Copyright (c) 2021 Nordic Semiconductor ASA
 *
 * SPDX-License-Identifier: LicenseRef-Nordic-5-Clause
 */
/* Purpose: timer configuring and processing */

#include <kernel.h>

#include "timer_proc.h"

#include "ptt.h"

#include <logging/log.h>
LOG_MODULE_REGISTER(timer);

static void ptt_process_timer_handler(struct k_timer *timer);
static void schedule_ptt_process(struct k_work *work);

K_TIMER_DEFINE(app_timer, ptt_process_timer_handler, NULL);

K_WORK_DEFINE(schedule_ptt_processor, schedule_ptt_process);

static void ptt_process_timer_handler(struct k_timer *timer)
{
	k_work_submit(&schedule_ptt_processor);
}

ptt_time_t ptt_get_current_time(void)
{
	return k_uptime_get_32();
}

ptt_time_t ptt_get_max_time(void)
{
	/* The maximum possible time is the maximum for a uint32_t */
	return UINT32_MAX;
}

void launch_ptt_process_timer(ptt_time_t timeout)
{
	if (timeout == 0) {
		/* schedule immediately */
		k_work_submit(&schedule_ptt_processor);
	} else {
		/* Schedule a single shot timer to trigger after the timeout */
		k_timer_start(&app_timer, K_MSEC(timeout), K_MSEC(0));
	}
}

/* scheduler context */
static void schedule_ptt_process(struct k_work *work)
{
	ptt_process(ptt_get_current_time());
}
```

## src/uart_proc.c
```c
/*
 * Copyright (c) 2021 Nordic Semiconductor ASA
 *
 * SPDX-License-Identifier: LicenseRef-Nordic-5-Clause
 */
/* Purpose: UART configuring and processing */

/* UART handler waits for a string with new line symbol in the end. The handler reads a packet
 * from UARTE driver per a byte and looks for a new line symbol or waits until a timer is expired
 * to process received sequence without new line symbol. Then the packet is pushed to the library.
 */

#include <assert.h>
#include <stdint.h>

#include <drivers/uart.h>
#include <sys/ring_buffer.h>

#include "comm_proc.h"
#include "uart_proc.h"

#include <logging/log.h>
LOG_MODULE_REGISTER(uart);

static struct text_proc_s text_proc_uart;
static struct k_timer uart_timer;
static const struct device *uart_dev;

RING_BUF_DECLARE(uart_rb, 10240);

static void uart_irq_handler(const struct device *dev, void *context)
{
	uint8_t *data_tx = NULL;

	uart_irq_update(dev);
	if (uart_irq_tx_ready(dev)) {
		int nr_bytes_read =
			ring_buf_get_claim(&uart_rb, &data_tx, CONFIG_UART_0_NRF_TX_BUFFER_SIZE);
		int sent = uart_fifo_fill(dev, data_tx, nr_bytes_read);

		ring_buf_get_finish(&uart_rb, sent);
		if (ring_buf_is_empty(&uart_rb)) {
			uart_irq_tx_disable(dev);
		}
	}

	if (uart_irq_rx_ready(dev)) {
		uint8_t buf[10] = {0};
		int len = uart_fifo_read(dev, buf, sizeof(buf));

		if (len) {
			/* Call this */
			comm_input_process(&text_proc_uart, buf, UART_BYTES_TO_READ);
		}
	}
}

void uart_init(void)
{
	LOG_INF("Init");

	uart_dev = device_get_binding("UART_0");
	__ASSERT(uart_dev, "Failed to get the device");
	uart_irq_callback_user_data_set(uart_dev, uart_irq_handler, NULL);
	uart_irq_rx_enable(uart_dev);

	text_proc_uart = (struct text_proc_s){ 0 };
	text_proc_uart.timer = uart_timer;
	k_timer_init(&text_proc_uart.timer, comm_input_timeout_handler, NULL);
	k_work_init(&text_proc_uart.work, comm_text_processor_fn);
}

int32_t uart_send(const uint8_t *pkt, ptt_pkt_len_t len, bool add_crlf)
{
	while (ring_buf_space_get(&uart_rb) < len) {
		LOG_WRN("queue full, waiting for free space");
		k_sleep(K_MSEC(1));
	}

	uart_irq_tx_disable(uart_dev);
	ring_buf_put(&uart_rb, pkt, len);
	if (add_crlf) {
		ring_buf_put(&uart_rb, COMM_APPENDIX, COMM_APPENDIX_SIZE);
	}
	uart_irq_tx_enable(uart_dev);

	return len;
}
```
