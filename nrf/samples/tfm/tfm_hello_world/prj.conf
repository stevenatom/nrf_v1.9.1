## CMakeLists.txt
```
#
# Copyright (c) 2020 Nordic Semiconductor ASA
#
# SPDX-License-Identifier: LicenseRef-Nordic-5-Clause
#

# Building TFM requires Cmake 3.15.
cmake_minimum_required(VERSION 3.20.0)

find_package(Zephyr REQUIRED HINTS $ENV{ZEPHYR_BASE})

project(tfm_hello_world)

# NORDIC SDK APP START
target_sources(app PRIVATE src/main.c)
# NORDIC SDK APP END
```

## sample.yaml
```
sample:
  description: Hello World sample, the simplest Zephyr
    application, with TF-M enabled
  name: hello world TFM
common:
    tags: tfm
    platform_allow: nrf5340dk_nrf5340_cpuapp_ns nrf9160dk_nrf9160_ns
    integration_platforms:
      - nrf5340dk_nrf5340_cpuapp_ns
      - nrf9160dk_nrf9160_ns
    harness: console
    harness_config:
      type: multi_line
      regex:
        - "Hello World! .*"
        - "Generating random number"
        - "0x[0-9a-f]{64}"
        - "Reading some secure memory that NS is allowed to read"
        - "FICR->INFO.PART: 0x[0-9a-f]{8}"
        - "FICR->INFO.VARIANT: 0x[0-9a-f]{8}"
        - "Hashing 'Hello World! .*'"
        - "SHA256 digest:"
        - "0x[0-9a-f]{64}"
        - "MCU selection .*"
tests:
  sample.tfm.helloworld:
    tags: tfm ci_build
```

## prj.conf
```kconfig
#
# Copyright (c) 2020 Nordic Semiconductor ASA
#
# SPDX-License-Identifier: LicenseRef-Nordic-5-Clause
#

CONFIG_BUILD_WITH_TFM=y
CONFIG_TFM_MINIMAL=y
CONFIG_TFM_BL2=n
```

## src/main.c
```c
/*
 * Copyright (c) 2020 Nordic Semiconductor ASA.
 *
 * SPDX-License-Identifier: LicenseRef-Nordic-5-Clause
 */

#include <zephyr.h>
#include <sys/printk.h>
#include <string.h>
#include <stdio.h>
#include <tfm_ns_interface.h>
#include "psa/crypto.h"
#include <tfm_ioctl_api.h>
#include <pm_config.h>
#include <hal/nrf_gpio.h>

#define HELLO_PATTERN "Hello World! %s"

#define PIN_XL1 0
#define PIN_XL2 1

/* Check if MCU selection is required */
#if defined(GPIO_PIN_CNF_MCUSEL_Msk)
static void gpio_pin_mcu_select(uint32_t pin_number, nrf_gpio_pin_mcusel_t mcu)
{
	uint32_t err;
	enum tfm_platform_err_t plt_err;

	plt_err = tfm_platform_gpio_pin_mcu_select(pin_number, mcu, &err);
	if (plt_err != TFM_PLATFORM_ERR_SUCCESS || err != 0) {
		printk("tfm_..._gpio_pin_mcu_select failed: plt_err: 0x%x, err: 0x%x\n",
			plt_err, err);
	}
}
#endif /* defined(GPIO_PIN_CNF_MCUSEL_Msk) */

static uint32_t secure_read_word(intptr_t ptr)
{
	uint32_t err = 0;
	uint32_t val;
	enum tfm_platform_err_t plt_err;

	plt_err = tfm_platform_mem_read(&val, ptr, 4, &err);
	if (plt_err != TFM_PLATFORM_ERR_SUCCESS || err != 0) {
		printk("tfm_..._mem_read failed: plt_err: 0x%x, err: 0x%x\n",
			plt_err, err);
		return -1;
	}

	return val;
}

static void print_hex_number(uint8_t *num, size_t len)
{
	printk("0x");
	for (int i = 0; i < len; i++) {
		printk("%02x", num[i]);
	}
	printk("\n");
}

void main(void)
{
	char hello_string[sizeof(HELLO_PATTERN) + sizeof(CONFIG_BOARD)];
	char hello_digest[32];
	uint8_t random_bytes[32];
	size_t len;
	psa_status_t status;

	len = snprintf(hello_string, sizeof(hello_string),
		HELLO_PATTERN, CONFIG_BOARD);

	printk("%s\n", hello_string);

	printk("Generating random number\n");
	status = psa_generate_random(random_bytes, sizeof(random_bytes));
	if (status != PSA_SUCCESS) {
		printk("psa_generate_random failed with status %d\n", status);
	} else {
		print_hex_number(random_bytes, sizeof(random_bytes));
	}

	printk("Reading some secure memory that NS is allowed to read\n");
	printk("FICR->INFO.PART: 0x%08x\n",
		secure_read_word((intptr_t)&NRF_FICR_S->INFO.PART));
	printk("FICR->INFO.VARIANT: 0x%08x\n",
		secure_read_word((intptr_t)&NRF_FICR_S->INFO.VARIANT));

	printk("Hashing '%s'\n", hello_string);
	status = psa_crypto_init();
	if (status != PSA_SUCCESS) {
		printk("psa_crypto_init failed with status %d\n", status);
	}
	status = psa_hash_compute(PSA_ALG_SHA_256, hello_string,
					strlen(hello_string), hello_digest,
					sizeof(hello_digest), &len);

	if (status != PSA_SUCCESS) {
		printk("psa_hash_compute failed with status %d\n", status);
	} else {
		printk("SHA256 digest:\n");
		print_hex_number(hello_digest, 32);
	}

#if defined(GPIO_PIN_CNF_MCUSEL_Msk)
	/* Configure properly the XL1 and XL2 pins so that the low-frequency crystal
	 * oscillator (LFXO) can be used.
	 * This configuration has already been done by TF-M so this is redundant.
	 */
	gpio_pin_mcu_select(PIN_XL1, NRF_GPIO_PIN_MCUSEL_PERIPHERAL);
	gpio_pin_mcu_select(PIN_XL2, NRF_GPIO_PIN_MCUSEL_PERIPHERAL);
	printk("MCU selection configured\n");
#else
	printk("MCU selection skipped\n");
#endif /* defined(GPIO_PIN_CNF_MCUSEL_Msk) */
}
```
