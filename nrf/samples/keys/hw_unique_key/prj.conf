## CMakeLists.txt
```
#
# Copyright (c) 2021 Nordic Semiconductor ASA
#
# SPDX-License-Identifier: LicenseRef-Nordic-5-Clause
#

# Building TFM requires Cmake 3.15.
cmake_minimum_required(VERSION 3.15)

find_package(Zephyr REQUIRED HINTS $ENV{ZEPHYR_BASE})

project(random_hw_unique_key)

# NORDIC SDK APP START
target_sources(app PRIVATE src/main.c)
if (DEFINED CONFIG_BUILD_WITH_TFM)
  target_sources(app PRIVATE src/derive_key_tfm.c)
else ()
  target_sources(app PRIVATE src/derive_key.c)
endif()
# NORDIC SDK APP END
```

## sample.yaml
```
sample:
  description: Generate and write random keys to the KMU.
  name: Random HW Unique Key
common:
    tags: hw_unique_key
    platform_allow: nrf5340dk_nrf5340_cpuapp nrf5340dk_nrf5340_cpuapp_ns nrf9160dk_nrf9160 nrf9160dk_nrf9160_ns nrf52840dk_nrf52840
    integration_platforms:
      - nrf5340dk_nrf5340_cpuapp
      - nrf5340dk_nrf5340_cpuapp_ns
      - nrf9160dk_nrf9160
      - nrf9160dk_nrf9160_ns
      - nrf52840dk_nrf52840
    harness: console
    harness_config:
      type: multi_line
      regex:
        - "Ciphertext \\(with authentication tag\\):"
tests:
  sample.keys.hw_unique_key:
    tags: hw_unique_key ci_build
```

## prj.conf
```kconfig
#
# Copyright (c) 2021 Nordic Semiconductor ASA
#
# SPDX-License-Identifier: LicenseRef-Nordic-5-Clause
#

CONFIG_PM_SINGLE_IMAGE=y
CONFIG_MPU_ALLOW_FLASH_WRITE=y
CONFIG_RESET_ON_FATAL_ERROR=n

CONFIG_NRF_SECURITY=y
```

## boards/nrf52840dk_nrf52840.conf
```kconfig
#
# Copyright (c) 2021 Nordic Semiconductor ASA
#
# SPDX-License-Identifier: LicenseRef-Nordic-5-Clause
#

CONFIG_SECURE_BOOT=y
CONFIG_REBOOT=y
CONFIG_MBEDTLS_PSA_CRYPTO_C=y
CONFIG_MAIN_STACK_SIZE=4096
CONFIG_MBEDTLS_ENABLE_HEAP=y
CONFIG_HW_UNIQUE_KEY=y
CONFIG_HW_UNIQUE_KEY_RANDOM=y
```

## boards/nrf9160dk_nrf9160.conf
```kconfig
#
# Copyright (c) 2021 Nordic Semiconductor ASA
#
# SPDX-License-Identifier: LicenseRef-Nordic-5-Clause
#

CONFIG_MBEDTLS_PSA_CRYPTO_C=y
CONFIG_MAIN_STACK_SIZE=4096
CONFIG_MBEDTLS_ENABLE_HEAP=y
CONFIG_HW_UNIQUE_KEY=y
CONFIG_HW_UNIQUE_KEY_RANDOM=y
```

## boards/nrf9160dk_nrf9160_ns.conf
```kconfig
#
# Copyright (c) 2021 Nordic Semiconductor ASA
#
# SPDX-License-Identifier: LicenseRef-Nordic-5-Clause
#

CONFIG_BUILD_WITH_TFM=y
```

## src/main.c
```c
/*
 * Copyright (c) 2021 Nordic Semiconductor ASA.
 *
 * SPDX-License-Identifier: LicenseRef-Nordic-5-Clause
 */

#include <zephyr.h>
#include <sys/printk.h>
#include <string.h>
#include <stdio.h>
#include <hw_unique_key.h>
#include <psa/crypto.h>
#include <autoconf.h>
#ifdef CONFIG_BUILD_WITH_TFM
#include <tfm_crypto_defs.h>
#else /* CONFIG_BUILD_WITH_TFM */
#include <nrf_cc3xx_platform.h>
#endif /* CONFIG_BUILD_WITH_TFM */
#if !defined(HUK_HAS_KMU)
#include <sys/reboot.h>
#endif /* !defined(HUK_HAS_KMU) */

#define IV_LEN 12
#define MAC_LEN 16


#ifdef HUK_HAS_CC310
#define ENCRYPT_ALG PSA_ALG_CCM
#else
#define ENCRYPT_ALG PSA_ALG_GCM
#endif

psa_key_id_t derive_key(psa_key_attributes_t *attributes, uint8_t *key_label,
			uint32_t label_size);

void hex_dump(uint8_t *buff, uint32_t len)
{
	for (int i = 0; i < len; i++) {
		printk("%s%02x", i && ((i % 32) == 0) ? "\n" : "", buff[i]);
	}
	printk("\n");
}

void main(void)
{
	psa_status_t status;
	psa_key_attributes_t attributes = PSA_KEY_ATTRIBUTES_INIT;
	uint8_t key_label[] = "HUK derivation sample label";
	psa_key_id_t key_id_out = 0;
	uint8_t plaintext[] = "Lorem ipsum dolor sit amet. This will be encrypted.";
	uint8_t ciphertext[sizeof(plaintext) + MAC_LEN];
	uint32_t ciphertext_out_len;
	uint8_t iv[IV_LEN];
	uint8_t additional_data[] = "This will be authenticated but not encrypted.";

	printk("Derive a key, then use it to encrypt a message.\n\n");

#if !defined(CONFIG_BUILD_WITH_TFM)
	int result = nrf_cc3xx_platform_init();

	if (result != NRF_CC3XX_PLATFORM_SUCCESS) {
		printk("nrf_cc3xx_platform_init returned error: %d\n", result);
		return;
	}

	if (!hw_unique_key_are_any_written()) {
		printk("Writing random keys to KMU\n");
		hw_unique_key_write_random();
		printk("Success!\n\n");

#if !defined(HUK_HAS_KMU)
		/* Reboot to allow the bootloader to load the key into CryptoCell. */
		sys_reboot(0);
#endif /* !defined(HUK_HAS_KMU) */
	}
#endif /* !defined(CONFIG_BUILD_WITH_TFM) */

	status = psa_crypto_init();
	if (status != PSA_SUCCESS) {
		printk("psa_crypto_init returned error: %d\n", status);
		return;
	}

	printk("Generating random IV\n");
	status = psa_generate_random(iv, IV_LEN);
	if (status != PSA_SUCCESS) {
		printk("psa_generate_random returned error: %d\n", status);
		return;
	}
	printk("IV:\n");
	hex_dump(iv, IV_LEN);
	printk("\n");
	printk("Deriving key\n");

	/* Set the key attributes for the storage key */
	psa_set_key_usage_flags(&attributes,
			(PSA_KEY_USAGE_ENCRYPT | PSA_KEY_USAGE_DECRYPT));
	psa_set_key_algorithm(&attributes, ENCRYPT_ALG);
	psa_set_key_type(&attributes, PSA_KEY_TYPE_AES);
	psa_set_key_bits(&attributes, PSA_BYTES_TO_BITS(HUK_SIZE_BYTES));

	key_id_out = derive_key(&attributes, key_label, sizeof(key_label) - 1);
	if (key_id_out == 0) {
		return;
	}

	printk("Key ID: 0x%x\n\n", key_id_out);
	printk("Encrypting\n");
	printk("Plaintext:\n\"%s\"\n", plaintext);
	hex_dump(plaintext, sizeof(plaintext) - 1);

	status = psa_aead_encrypt(key_id_out, ENCRYPT_ALG, iv, IV_LEN,
				additional_data, sizeof(additional_data) - 1,
				plaintext, sizeof(plaintext) - 1,
				ciphertext, sizeof(ciphertext), &ciphertext_out_len);
	if (status != PSA_SUCCESS) {
		printk("psa_aead_encrypt returned error: %d\n", status);
		return;
	}
	if (ciphertext_out_len != (sizeof(plaintext) - 1 + MAC_LEN)) {
		printk("ciphertext has wrong length: %d\n", ciphertext_out_len);
		return;
	}

	printk("Ciphertext (with authentication tag):\n");
	hex_dump(ciphertext, ciphertext_out_len);
}
```

## src/derive_key.c
```c
/*
 * Copyright (c) 2021 Nordic Semiconductor ASA.
 *
 * SPDX-License-Identifier: LicenseRef-Nordic-5-Clause
 */

#include <zephyr.h>
#include <sys/printk.h>
#include <psa/crypto.h>
#include <hw_unique_key.h>

#ifdef HUK_HAS_KMU
#define KEYSLOT HUK_KEYSLOT_MKEK
#else
#define KEYSLOT HUK_KEYSLOT_KDR
#endif


void hex_dump(uint8_t *buff, uint32_t len);

psa_key_id_t derive_key(psa_key_attributes_t *attributes, uint8_t *key_label,
			uint32_t label_size)
{
	uint8_t key_out[HUK_SIZE_BYTES];
	psa_key_id_t key_id_out = 0;
	psa_status_t status;

	int result = hw_unique_key_derive_key(KEYSLOT, NULL, 0,
		key_label, label_size, key_out, sizeof(key_out));
	if (result != 0) {
		printk("hw_unique_key_derive_key returned error: %d\n", result);
		return 0;
	}
	printk("Key:\n");
	hex_dump(key_out, sizeof(key_out));

	status = psa_import_key(attributes, key_out, sizeof(key_out), &key_id_out);
	if (status != PSA_SUCCESS) {
		printk("psa_import_key returned error: %d\n", status);
		return 0;
	}

	return key_id_out;
}
```

## src/derive_key_tfm.c
```c
/*
 * Copyright (c) 2021 Nordic Semiconductor ASA.
 *
 * SPDX-License-Identifier: LicenseRef-Nordic-5-Clause
 *
 * Adapted from ps_crypto_setkey() in ps_crypto_interface.c from the
 * Trusted Firmware-M project.
 */

#include <zephyr.h>
#include <sys/printk.h>
#include <psa/crypto.h>
#include <tfm_crypto_defs.h>


psa_key_id_t derive_key(psa_key_attributes_t *attributes, uint8_t *key_label,
			uint32_t label_size)
{
	psa_status_t status;
	psa_key_derivation_operation_t op = PSA_KEY_DERIVATION_OPERATION_INIT;
	psa_key_id_t key_id_out = 0;

	/* Set up a key derivation operation with HUK derivation as the alg */
	status = psa_key_derivation_setup(&op, TFM_CRYPTO_ALG_HUK_DERIVATION);
	if (status != PSA_SUCCESS) {
		printk("psa_key_derivation_setup returned error: %d\n", status);
		return 0;
	}

	/* Supply the key label as an input to the key derivation */
	status = psa_key_derivation_input_bytes(&op, PSA_KEY_DERIVATION_INPUT_LABEL,
						key_label, label_size);
	if (status != PSA_SUCCESS) {
		printk("psa_key_derivation_input_bytes returned error: %d\n", status);
		return 0;
	}

	/* Create the encryption key from the key derivation operation */
	status = psa_key_derivation_output_key(attributes, &op, &key_id_out);
	if (status != PSA_SUCCESS) {
		printk("psa_key_derivation_output_key returned error: %d\n", status);
		return 0;
	}
	printk("(Key resides internally in TF-M)\n");

	/* Free resources associated with the key derivation operation */
	status = psa_key_derivation_abort(&op);
	if (status != PSA_SUCCESS) {
		printk("psa_key_derivation_abort returned error: %d\n", status);
		return 0;
	}

	return key_id_out;
}
```
