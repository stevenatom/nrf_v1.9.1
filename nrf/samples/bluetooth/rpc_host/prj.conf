## sample.yaml
```
sample:
  name: nRF RPC host for BLE API
  description: nRF RPC host providing BLE API access
tests:
  samples.bluetooth.rpc_host:
    build_only: true
    platform_allow: nrf5340dk_nrf5340_cpunet
    integration_platforms:
      - nrf5340dk_nrf5340_cpunet
    tags: bluetooth ci_build
```

## prj.conf
```kconfig
#
# Copyright (c) 2021 Nordic Semiconductor
#
# SPDX-License-Identifier: LicenseRef-Nordic-5-Clause
#

CONFIG_BT=y
CONFIG_BT_RPC=y
CONFIG_BT_RPC_HOST=y

CONFIG_BT_PERIPHERAL=y
CONFIG_BT_MAX_CONN=1
CONFIG_BT_MAX_PAIRED=1
CONFIG_BT_SMP=y

# BT Device name must be the same as on the client side
CONFIG_BT_DEVICE_NAME="Nordic_UART_Service"
# Host side registers all GATT services using dynamic database
CONFIG_BT_GATT_DYNAMIC_DB=y

# Enable bonding
CONFIG_BT_SETTINGS=y
CONFIG_FLASH=y
CONFIG_FLASH_PAGE_LAYOUT=y
CONFIG_FLASH_MAP=y
CONFIG_NVS=y
CONFIG_SETTINGS=y

CONFIG_RPMSG_SERVICE_MODE_REMOTE=y

CONFIG_SYSTEM_WORKQUEUE_STACK_SIZE=4096
CONFIG_HEAP_MEM_POOL_SIZE=4096
CONFIG_NRF_RPC_THREAD_STACK_SIZE=4096
```

## src/main.c
```c
/*
 * Copyright (c) 2021 Nordic Semiconductor ASA
 *
 * SPDX-License-Identifier: LicenseRef-Nordic-5-Clause
 */

#include <sys/printk.h>

void main(void)
{
	printk("Starting nRF RPC bluetooth host\n");
}
```
