## CMakeLists.txt
```
#
# Copyright (c) 2020 Nordic Semiconductor
#
# SPDX-License-Identifier: LicenseRef-Nordic-5-Clause
#
cmake_minimum_required(VERSION 3.20.0)

find_package(Zephyr REQUIRED HINTS $ENV{ZEPHYR_BASE})
project(NONE)

# Application sources
add_subdirectory(src/fem)

# NORDIC SDK APP START
target_sources(app PRIVATE
  src/main.c
  src/dtm.c
  src/dtm_hw.c
)
# NORDIC SDK APP END
zephyr_library_include_directories(.)
```

## Kconfig
```
#
# Copyright (c) 2020 Nordic Semiconductor
#
# SPDX-License-Identifier: LicenseRef-Nordic-5-Clause
#

source "Kconfig.zephyr"

menu "Nordic DTM sample"

config DTM_RADIO_IRQ_PRIORITY
	int "Radio interrupt priority"
	range 0 5 if ZERO_LATENCY_IRQS
	range 0 6
	default 2
	help
	  Sets Radio interrupt priority.
	  Levels are from 0 (highest priority) to 6 (lowest priority)

config DTM_TIMER_IRQ_PRIORITY
	int "DTM timer interrupt priority"
	range 0 5 if ZERO_LATENCY_IRQS
	range 0 6
	default 3
	help
	  Sets DTM timer interrupt priority.
	  Levels are from 0 (highest priority) to 6 (lowest priority)

config ANOMALY_172_TIMER_IRQ_PRIORITY
	int "Anomaly 172 timer interrupt priority"
	depends on SOC_NRF52840
	range 0 5 if ZERO_LATENCY_IRQS
	range 0 6
	default 2
	help
	  Sets anomaly 172 timer interrupt priority.
	  Levels are from 0 (highest priority) to 6 (lowest priority)

rsource "src/fem/Kconfig"

endmenu
```

## sample.yaml
```
sample:
  name: Bluetooth LE Direct Test Mode
  description: Bluetooth Low Energy Direct Test Mode sample
tests:
  samples.bluetooth.direct_test_mode:
    build_only: true
    platform_allow: nrf5340dk_nrf5340_cpunet nrf21540dk_nrf52840
    integration_platforms:
      - nrf5340dk_nrf5340_cpunet
      - nrf21540dk_nrf52840
    tags: bluetooth ci_build
```

## prj.conf
```kconfig
#
# Copyright (c) 2020 Nordic Semiconductor
#
# SPDX-License-Identifier: LicenseRef-Nordic-5-Clause
#

# Configure assertions
CONFIG_ASSERT=y
CONFIG_ASSERT_NO_COND_INFO=y
CONFIG_ASSERT_NO_MSG_INFO=y

CONFIG_HW_STACK_PROTECTION=y

# Use RTT console
CONFIG_USE_SEGGER_RTT=y
CONFIG_RTT_CONSOLE=y
CONFIG_UART_CONSOLE=n

# Use necessary peripherals
CONFIG_NRFX_TIMER0=y
CONFIG_NRFX_TIMER1=y
CONFIG_NRFX_TIMER2=y
```

## boards/nrf5340dk_nrf5340_cpunet.conf
```kconfig
#
# Copyright (c) 2021 Nordic Semiconductor
#
# SPDX-License-Identifier: LicenseRef-Nordic-5-Clause
#
CONFIG_PM_DEVICE=y

# Build Empty APP Core sample for the application core
CONFIG_NCS_SAMPLE_EMPTY_APP_CORE_CHILD_IMAGE=y
```

## app.overlay
```dts
&uart0 {
	status = "okay";
	current-speed = <19200>;
};
```

## boards/nrf5340dk_nrf5340_cpunet.overlay
```dts
&uart0 {
	status = "okay";
	current-speed = <19200>;
};

&spi0 {
	status = "disabled";
};

/ {
     zephyr,user {
	     dtm_antenna_count = <12>;
	     dtm_antenna_1_pin = <32>;
	     dtm_antenna_2_pin = <33>;
	     dtm_antenna_3_pin = <34>;
	     dtm_antenna_4_pin = <35>;
	     dtm_antenna_5_pin = <36>;
	     dtm_antenna_6_pin = <37>;
	     dtm_antenna_7_pin = <38>;
	     dtm_antenna_8_pin = <39>;
     };
};
```

## src/main.c
```c
/*
 * Copyright (c) 2020 Nordic Semiconductor ASA
 *
 * SPDX-License-Identifier: LicenseRef-Nordic-5-Clause
 */

#include <errno.h>
#include <drivers/uart.h>
#include <zephyr.h>

#include "dtm.h"

void main(void)
{
	int err;
	const struct device *uart;
	bool is_msb_read = false;
	uint8_t rx_byte;
	uint16_t dtm_cmd;
	uint16_t dtm_evt;
	int64_t msb_time;

	printk("Starting Direct Test Mode example\n");

	uart = device_get_binding("UART_0");
	if (!uart) {
		printk("Error during UART device initialization\n");
	}

	err = dtm_init();
	if (err) {
		printk("Error during DTM initialization: %d\n", err);
	}

	for (;;) {
		dtm_wait();

		err = uart_poll_in(uart, &rx_byte);
		if (err) {
			if (err != -1) {
				printk("UART polling error: %d\n", err);
			}

			/* Nothing read from the UART. */
			continue;
		}

		if (!is_msb_read) {
			/* This is first byte of two-byte command. */
			is_msb_read = true;
			dtm_cmd = rx_byte << 8;
			msb_time = k_uptime_get();

			/* Go back and wait for 2nd byte of command word. */
			continue;
		}

		/* This is the second byte read; combine it with the first and
		 * process command.
		 */
		if ((k_uptime_get() - msb_time) >
		    DTM_UART_SECOND_BYTE_MAX_DELAY) {
			/* More than ~5mS after msb: Drop old byte, take the
			 * new byte as MSB. The variable is_msb_read will
			 * remain true.
			 */
			dtm_cmd = rx_byte << 8;
			msb_time = k_uptime_get();
			/* Go back and wait for 2nd byte of command word. */
			continue;
		}

		/* 2-byte UART command received. */
		is_msb_read = false;
		dtm_cmd |= rx_byte;

		printk("Sending 0x%04X DTM command\n", dtm_cmd);

		if (dtm_cmd_put(dtm_cmd) != DTM_SUCCESS) {
			/* Extended error handling may be put here.
			 * Default behavior is to return the event on the UART;
			 * the event report will reflect any lack of success.
			 */
		}

		/* Retrieve result of the operation. This implementation will
		 * busy-loop for the duration of the byte transmissions on the
		 * UART.
		 */
		if (dtm_event_get(&dtm_evt)) {
			printk("Received 0x%04X DTM event\n", dtm_evt);

			/* Report command status on the UART. */

			/* Transmit MSB of the result. */
			uart_poll_out(uart, (dtm_evt >> 8) & 0xFF);

			/* Transmit LSB of the result. */
			uart_poll_out(uart, dtm_evt & 0xFF);
		}
	}
}
```

## src/dtm.h
```c
/*
 * Copyright (c) 2020 Nordic Semiconductor ASA
 *
 * SPDX-License-Identifier: LicenseRef-Nordic-5-Clause
 */

#ifndef DTM_H_
#define DTM_H_

#include <stdbool.h>
#include <zephyr/types.h>
#include <devicetree.h>

#ifdef __cplusplus
extern "C" {
#endif

/* DTM command parameter: Upper bits mask. */
#define LE_UPPER_BITS_MASK 0x0C

/* DTM command parameter: Upper bits position. */
#define LE_UPPER_BITS_POS 0x04

/* Mask of the CTE type in the CTEInfo. */
#define LE_CTE_TYPE_MASK 0x03

/* Position of the CTE type in the CTEInfo. */
#define LE_CTE_TYPE_POS 0x06

/* Mask of the CTE Time in the CTEInfo. */
#define LE_CTE_CTETIME_MASK 0x1F

/* DTM command parameter: Mask of the Antenna Number. */
#define LE_ANTENNA_NUMBER_MASK 0x3F

/* DTM command parameter: Mask of the Antenna switch pattern. */
#define LE_ANTENNA_SWITCH_PATTERN_MASK 0x80

/* Position of power level in the DTM power level set response. */
#define LE_TRANSMIT_POWER_RESPONSE_LVL_POS (0x01)

/* Mask of the power level in the DTM power level set respose. */
#define LE_TRANSMIT_POWER_RESPONSE_LVL_MASK (0x1FE)

/* Maximum power level bit in the power level set response. */
#define LE_TRANSMIT_POWER_MAX_LVL_BIT BIT(0x0A)

/* Minimum power level bit in the power level set response. */
#define LE_TRANSMIT_POWER_MIN_LVL_BIT BIT(0x09)

/* DTM command codes */
enum dtm_cmd_code {
	/* Test Setup Command: Set PHY or modulation, configure upper two bits
	 * of length, request matrix of supported features or request max
	 * values of parameters.
	 */
	LE_TEST_SETUP = 0x0,

	/* Receive Command: Start receive test. */
	LE_RECEIVER_TEST = 0x1,

	/* Transmit Command: Start transmission test. */
	LE_TRANSMITTER_TEST = 0x2,

	/* Test End Command: End test and send packet report. */
	LE_TEST_END  = 0x3,
};

/* DTM Test Setup Control codes */
enum dtm_ctrl_code {
	/* Reset the packet length upper bits and set the PHY to 1Mbit. */
	LE_TEST_SETUP_RESET = 0x00,

	/* Set the upper two bits of the length field. */
	LE_TEST_SETUP_SET_UPPER = 0x01,

	/* Select the PHY to be used for packets. */
	LE_TEST_SETUP_SET_PHY = 0x02,

	/* Select standard or stable modulation index. Stable modulation index
	 * is not supported.
	 */
	LE_TEST_SETUP_SELECT_MODULATION = 0x03,

	/* Read the supported test case features. */
	LE_TEST_SETUP_READ_SUPPORTED = 0x04,

	/* Read the max supported time and length for packets. */
	LE_TEST_SETUP_READ_MAX = 0x05,

	/* Set the Constant Tone Extension info. */
	LE_TEST_SETUP_CONSTANT_TONE_EXTENSION = 0x06,

	/* Set the Constant Tone Extension slot. */
	LE_TEST_SETUP_CONSTANT_TONE_EXTENSION_SLOT = 0x07,

	/* Set the Antenna number and switch pattern. */
	LE_TEST_SETUP_ANTENNA_ARRAY = 0x08,

	/* Set the Transmit power. */
	LE_TEST_SETUP_TRANSMIT_POWER = 0x09
};

/* DTM Test Setup PHY codes */
enum dtm_phy_code {
	/* Set PHY for future packets to use 1MBit PHY.
	 * Minimum parameter value.
	 */
	LE_PHY_1M_MIN_RANGE = 0x04,

	/* Set PHY for future packets to use 1MBit PHY.
	 * Maximum parameter value.
	 */
	LE_PHY_1M_MAX_RANGE = 0x07,

	/* Set PHY for future packets to use 2MBit PHY.
	 * Minimum parameter value.
	 */
	LE_PHY_2M_MIN_RANGE = 0x08,

	/* Set PHY for future packets to use 2MBit PHY.
	 * Maximum parameter value.
	 */
	LE_PHY_2M_MAX_RANGE = 0x0B,

	/* Set PHY for future packets to use coded PHY with S=8.
	 * Minimum parameter value.
	 */
	LE_PHY_LE_CODED_S8_MIN_RANGE = 0x0C,

	/* Set PHY for future packets to use coded PHY with S=8.
	 * Maximum parameter value.
	 */
	LE_PHY_LE_CODED_S8_MAX_RANGE = 0x0F,

	/* Set PHY for future packets to use coded PHY with S=2.
	 * Minimum parameter value.
	 */
	LE_PHY_LE_CODED_S2_MIN_RANGE = 0x10,

	/* Set PHY for future packets to use coded PHY with S=2.
	 * Maximum parameter value.
	 */
	LE_PHY_LE_CODED_S2_MAX_RANGE = 0x13
};

/* DTM Test Setup Read supported parameters codes. */
enum dtm_read_supported_code {
	/* Read maximum supported Tx Octets. Minimum parameter value. */
	LE_TEST_SUPPORTED_TX_OCTETS_MIN_RANGE = 0x00,

	/* Read maximum supported Tx Octets. Maximum parameter value. */
	LE_TEST_SUPPORTED_TX_OCTETS_MAX_RANGE = 0x03,

	/* Read maximum supported Tx Time. Minimum parameter value. */
	LE_TEST_SUPPORTED_TX_TIME_MIN_RANGE = 0x04,

	/* Read maximum supported Tx Time. Maximum parameter value. */
	LE_TEST_SUPPORTED_TX_TIME_MAX_RANGE = 0x07,

	/* Read maximum supported Rx Octets. Minimum parameter value. */
	LE_TEST_SUPPORTED_RX_OCTETS_MIN_RANGE = 0x08,

	/* Read maximum supported Rx Octets. Maximum parameter value. */
	LE_TEST_SUPPORTED_RX_OCTETS_MAX_RANGE = 0x0B,

	/* Read maximum supported Rx Time. Minimum parameter value. */
	LE_TEST_SUPPORTED_RX_TIME_MIN_RANGE = 0x0C,

	/* Read maximum supported Rx Time. Maximum parameter value. */
	LE_TEST_SUPPORTED_RX_TIME_MAX_RANGE = 0x0F,

	/* Read maximum length of the Constant Tone Extension supported. */
	LE_TEST_SUPPORTED_CTE_LENGTH = 0x10
};

/* DTM Test Setup reset code. */
enum dtm_reset_code {
	/* Reset. Minimum parameter value. */
	LE_RESET_MIN_RANGE = 0x00,

	/* Reset. Maximum parameter value. */
	LE_RESET_MAX_RANGE = 0x03
};

/* DTM Test Setup upper bits code. */
enum dtm_set_upper_bits_code {
	/* Set upper bits. Minimum parameter value. */
	LE_SET_UPPER_BITS_MIN_RANGE = 0x00,

	/* Set upper bits. Maximum parameter value. */
	LE_SET_UPPER_BITS_MAX_RANGE = 0x0F
};

/* DTM Test Setup modulation code. */
enum dtm_modulation_code {
	/* Set Modulation index to standard. Minimum parameter value. */
	LE_MODULATION_INDEX_STANDARD_MIN_RANGE = 0x00,

	/* Set Modulation index to standard. Maximum parameter value. */
	LE_MODULATION_INDEX_STANDARD_MAX_RANGE = 0x03
};

/* DTM Test Setup feature read code. */
enum dtm_feature_read_code {
	/* Read test case supported feature. Minimum parameter value. */
	LE_TEST_FEATURE_READ_MIN_RANGE = 0x00,

	/* Read test case supported feature. Maximum parameter value. */
	LE_TEST_FEATURE_READ_MAX_RANGE = 0x03
};

/* DTM Test Setup CTE type code */
enum dtm_cte_type_code {
	/* CTE Type Angle of Arrival. */
	LE_CTE_TYPE_AOA = 0x00,

	/* CTE Type Angle of Departure with 1 us slot. */
	LE_CTE_TYPE_AOD_1US = 0x01,

	/* CTE Type Angle of Departure with 2 us slot.*/
	LE_CTE_TYPE_AOD_2US = 0x02
};

/* DTM Test Setup transmit power code. */
enum dtm_transmit_power_code {
	/* Minimum supported transmit power level. */
	LE_TRANSMIT_POWER_LVL_MIN = -127,

	/* Maximum supported transmit power level. */
	LE_TRANSMIT_POWER_LVL_MAX = 20,

	/* Set minimum transmit power level. */
	LE_TRANSMIT_POWER_LVL_SET_MIN = 0x7E,

	/* Set maximum transmit power level. */
	LE_TRANSMIT_POWER_LVL_SET_MAX = 0x7F
};

/* DTM Test Setup antenna number max values. */
enum dtm_antenna_number {
	/* Minimum antenna number. */
	LE_TEST_ANTENNA_NUMBER_MIN = 0x01,

	/* Maximum antenna number. */
	LE_TEST_ANTENNA_NUMBER_MAX = 0x4B
};

/* DTM Test Setup CTE Time max values. */
enum dtm_cte_time {
	/* Minimum supported CTE length in 8 us units. */
	LE_CTE_LENGTH_MIN = 0x02,

	/* Maximum supported CTE length in 8 us units. */
	LE_CTE_LENGTH_MAX = 0x14
};

/* Vendor Specific DTM subcommand for Transmitter Test command.
 * It replaces Frequency field and must be combined with DTM_PKT_0XFF_OR_VS
 * packet type.
 */
enum dtm_vs_subcmd {
	/* Length=0 indicates a constant, unmodulated carrier until LE_TEST_END
	 * or LE_RESET
	 */
	CARRIER_TEST = 0,

	/* nRFgo Studio uses value 1 in length field, to indicate a constant,
	 * unmodulated carrier until LE_TEST_END or LE_RESET
	 */
	CARRIER_TEST_STUDIO = 1,

	/* Set transmission power, value -40..+4 dBm in steps of 4 */
	SET_TX_POWER = 2,

	/* Switch front-end module (FEM) antenna. */
	FEM_ANTENNA_SELECT = 3,

	/* Set front-end module (FEM) gain value. */
	FEM_GAIN_SET = 4,

	/* Set front-end module (FEM) active delay set. */
	FEM_ACTIVE_DELAY_SET = 5,
};

/* DTM Packet Type field */
enum dtm_pkt_type {
	/* PRBS9 bit pattern */
	DTM_PKT_PRBS9 = 0x00,

	/* 11110000 bit pattern (LSB is the leftmost bit). */
	DTM_PKT_0X0F = 0x01,

	/* 10101010 bit pattern (LSB is the leftmost bit). */
	DTM_PKT_0X55 = 0x02,

	/* 11111111 bit pattern for Coded PHY.
	 * Vendor specific command for Non-Coded PHY.
	 */
	DTM_PKT_0XFF_OR_VS = 0x03,
};

/* DTM events */
enum dtm_evt {
	/* Status event, indicating success. */
	LE_TEST_STATUS_EVENT_SUCCESS = 0x0000,

	/* Status event, indicating an error. */
	LE_TEST_STATUS_EVENT_ERROR = 0x0001,

	/* Packet reporting event, returned by the device to the tester. */
	LE_PACKET_REPORTING_EVENT = 0x8000,
};

/* DTM error codes */
enum dtm_err_code {
	/* Indicate that the DTM function completed with success. */
	DTM_SUCCESS,

	/* Physical channel number must be in the range 0..39. */
	DTM_ERROR_ILLEGAL_CHANNEL,

	/* Sequencing error: Command is not valid now. */
	DTM_ERROR_INVALID_STATE,

	/* Payload size must be in the range 0..37. */
	DTM_ERROR_ILLEGAL_LENGTH,

	/* Parameter out of range (legal range is function dependent). */
	DTM_ERROR_ILLEGAL_CONFIGURATION,

	/* DTM module has not been initialized by the application. */
	DTM_ERROR_UNINITIALIZED,
};

/* The DTM maximum wait time for the UART command second byte. */
#define DTM_UART_SECOND_BYTE_MAX_DELAY 5

/**@brief Function for initializing DTM module.
 *
 *  @return 0 in case of success or negative value in case of error
 */
int dtm_init(void);

/**@brief Function for waiting between the UART poll cycles.
 */
void dtm_wait(void);

/**@brief Function for calling when a complete command has been prepared by the
 *        Tester.
 *
 * @param[in] cmd  2-byte DTM command
 *
 * @return DTM_SUCCESS or one of the DTM_ERROR_ values
 */
enum dtm_err_code dtm_cmd_put(uint16_t cmd);

/**@brief Function for reading the result of a DTM command.
 *
 * @param[out] dtm_event 16 bit event code according to DTM standard.
 *
 * @return true: new event
 *         false: no event since last call
 */
bool dtm_event_get(uint16_t *dtm_event);


#ifdef __cplusplus
}
#endif

#endif /* DTM_H_ */

/** @} */
```

## src/dtm_hw.c
```c
/*
 * Copyright (c) 2020 Nordic Semiconductor ASA
 *
 * SPDX-License-Identifier: LicenseRef-Nordic-5-Clause
 */

#include "nrf.h"

#include "dtm_hw.h"
#include "dtm_hw_config.h"

const uint32_t nrf_power_value[] = {
#if defined(RADIO_TXPOWER_TXPOWER_Neg40dBm)
	RADIO_TXPOWER_TXPOWER_Neg40dBm,
#endif /* RADIO_TXPOWER_TXPOWER_Neg40dBm */
	RADIO_TXPOWER_TXPOWER_Neg30dBm,
	RADIO_TXPOWER_TXPOWER_Neg20dBm,
	RADIO_TXPOWER_TXPOWER_Neg16dBm,
	RADIO_TXPOWER_TXPOWER_Neg12dBm,
	RADIO_TXPOWER_TXPOWER_Neg8dBm,
#if defined(RADIO_TXPOWER_TXPOWER_Neg7dBm)
	RADIO_TXPOWER_TXPOWER_Neg7dBm,
#endif /* defined(RADIO_TXPOWER_TXPOWER_Neg7dBm) */
#if defined(RADIO_TXPOWER_TXPOWER_Neg6dBm)
	RADIO_TXPOWER_TXPOWER_Neg6dBm,
#endif /* defined(RADIO_TXPOWER_TXPOWER_Neg6dBm) */
#if defined(RADIO_TXPOWER_TXPOWER_Neg5dBm)
	RADIO_TXPOWER_TXPOWER_Neg5dBm,
#endif /* defined(RADIO_TXPOWER_TXPOWER_Neg5dBm) */
	RADIO_TXPOWER_TXPOWER_Neg4dBm,
#if defined(RADIO_TXPOWER_TXPOWER_Neg3dBm)
	RADIO_TXPOWER_TXPOWER_Neg3dBm,
#endif /* defined (RADIO_TXPOWER_TXPOWER_Neg3dBm) */
#if defined(RADIO_TXPOWER_TXPOWER_Neg2dBm)
	RADIO_TXPOWER_TXPOWER_Neg2dBm,
#endif /* defined (RADIO_TXPOWER_TXPOWER_Neg2dBm) */
#if defined(RADIO_TXPOWER_TXPOWER_Neg1dBm)
	RADIO_TXPOWER_TXPOWER_Neg1dBm,
#endif /* defined (RADIO_TXPOWER_TXPOWER_Neg1dBm) */
	RADIO_TXPOWER_TXPOWER_0dBm,
#if defined(RADIO_TXPOWER_TXPOWER_Pos2dBm)
	RADIO_TXPOWER_TXPOWER_Pos2dBm,
#endif /* defined(RADIO_TXPOWER_TXPOWER_Pos2dBm) */
#if defined(RADIO_TXPOWER_TXPOWER_Pos3dBm)
	RADIO_TXPOWER_TXPOWER_Pos3dBm,
#endif /* defined(RADIO_TXPOWER_TXPOWER_Pos3dBm) */
#if defined(RADIO_TXPOWER_TXPOWER_Pos4dBm)
	RADIO_TXPOWER_TXPOWER_Pos4dBm,
#endif /* defined(RADIO_TXPOWER_TXPOWER_Pos4dBm) */
#if defined(RADIO_TXPOWER_TXPOWER_Pos5dBm)
	RADIO_TXPOWER_TXPOWER_Pos5dBm,
#endif /* defined(RADIO_TXPOWER_TXPOWER_Pos5dBm) */
#if defined(RADIO_TXPOWER_TXPOWER_Pos6dBm)
	RADIO_TXPOWER_TXPOWER_Pos6dBm,
#endif /* defined(RADIO_TXPOWER_TXPOWER_Pos6dBm) */
#if defined(RADIO_TXPOWER_TXPOWER_Pos7dBm)
	RADIO_TXPOWER_TXPOWER_Pos7dBm,
#endif /* defined(RADIO_TXPOWER_TXPOWER_Pos7dBm) */
#if defined(RADIO_TXPOWER_TXPOWER_Pos8dBm)
	RADIO_TXPOWER_TXPOWER_Pos8dBm
#endif /* defined(RADIO_TXPOWER_TXPOWER_Pos8dBm) */
};

#if DIRECTION_FINDING_SUPPORTED
/**@brief Antenna pin array.
 */
static const uint32_t antenna_pin[] = {
#if DT_NODE_HAS_PROP(DT_PATH(zephyr_user), dtm_antenna_1_pin)
	DT_PROP(DT_PATH(zephyr_user), dtm_antenna_1_pin),
#endif
#if DT_NODE_HAS_PROP(DT_PATH(zephyr_user), dtm_antenna_2_pin)
	DT_PROP(DT_PATH(zephyr_user), dtm_antenna_2_pin),
#endif
#if DT_NODE_HAS_PROP(DT_PATH(zephyr_user), dtm_antenna_3_pin)
	DT_PROP(DT_PATH(zephyr_user), dtm_antenna_3_pin),
#endif
#if DT_NODE_HAS_PROP(DT_PATH(zephyr_user), dtm_antenna_4_pin)
	DT_PROP(DT_PATH(zephyr_user), dtm_antenna_4_pin),
#endif
#if DT_NODE_HAS_PROP(DT_PATH(zephyr_user), dtm_antenna_5_pin)
	DT_PROP(DT_PATH(zephyr_user), dtm_antenna_6_pin),
#endif
#if DT_NODE_HAS_PROP(DT_PATH(zephyr_user), dtm_antenna_6_pin)
	DT_PROP(DT_PATH(zephyr_user), dtm_antenna_6_pin),
#endif
#if DT_NODE_HAS_PROP(DT_PATH(zephyr_user), dtm_antenna_7_pin)
	DT_PROP(DT_PATH(zephyr_user), dtm_antenna_7_pin),
#endif
#if DT_NODE_HAS_PROP(DT_PATH(zephyr_user), dtm_antenna_8_pin)
	DT_PROP(DT_PATH(zephyr_user), dtm_antenna_8_pin),
#endif
};
#endif /* DIRECTION_FINDING_SUPPORTED */

bool dtm_hw_radio_validate(nrf_radio_txpower_t tx_power,
			   nrf_radio_mode_t radio_mode)
{
	/* Initializing code below is quite generic - for BLE, the values are
	 * fixed, and expressions are constant. Non-constant values are
	 * essentially set in radio_prepare().
	 */

	if (!(
#if CONFIG_HAS_HW_NRF_RADIO_BLE_CODED
		radio_mode == NRF_RADIO_MODE_BLE_LR125KBIT  ||
		radio_mode == NRF_RADIO_MODE_BLE_LR500KBIT  ||
#endif /* CONFIG_HAS_HW_NRF_RADIO_BLE_CODED */
		radio_mode == NRF_RADIO_MODE_BLE_1MBIT      ||
		radio_mode == NRF_RADIO_MODE_BLE_2MBIT
		)
	) {
		return false;
	}

	for (size_t i = 0; i < ARRAY_SIZE(nrf_power_value); i++) {
		if (tx_power == nrf_power_value[i]) {
			return true;
		}
	}

	return false;
}

bool dtm_hw_radio_lr_check(nrf_radio_mode_t radio_mode)
{
#if CONFIG_HAS_HW_NRF_RADIO_BLE_CODED
	if (radio_mode == NRF_RADIO_MODE_BLE_LR125KBIT) {
		return true;
	}

	if (radio_mode == NRF_RADIO_MODE_BLE_LR500KBIT) {
		return true;
	}
#endif /* CONFIG_HAS_HW_NRF_RADIO_BLE_CODED */

	return false;
}

uint32_t dtm_hw_radio_min_power_get(void)
{
	return nrf_power_value[0];
}

uint32_t dtm_hw_radio_max_power_get(void)
{
	return nrf_power_value[ARRAY_SIZE(nrf_power_value) - 1];
}

size_t dtm_hw_radio_power_array_size_get(void)
{
	return ARRAY_SIZE(nrf_power_value);
}

const uint32_t *dtm_hw_radio_power_array_get(void)
{
	return nrf_power_value;
}

#if DIRECTION_FINDING_SUPPORTED
size_t dtm_radio_antenna_pin_array_size_get(void)
{
	return ARRAY_SIZE(antenna_pin);
}

const uint32_t *dtm_hw_radion_antenna_pin_array_get(void)
{
	return antenna_pin;
}
#endif /* DIRECTION_FINDING_SUPPORTED */
```

## src/dtm_hw.h
```c
/*
 * Copyright (c) 2020 Nordic Semiconductor ASA
 *
 * SPDX-License-Identifier: LicenseRef-Nordic-5-Clause
 */

#ifndef DTM_HW_H_
#define DTM_HW_H_

#include <stdbool.h>
#include <zephyr/types.h>

#include <hal/nrf_radio.h>

#ifdef __cplusplus
extern "C" {
#endif

/**@brief Function for validating tx power and radio mode settings.
 * @param[in] tx_power    TX power for transmission test.
 * @param[in] radio_mode  Radio mode value.
 *
 * @retval true  If validation was successful
 * @retval false Otherwise
 */
bool dtm_hw_radio_validate(nrf_radio_txpower_t tx_power,
			   nrf_radio_mode_t radio_mode);

/**@brief Function for checking if Radio operates in Long Range mode.
 * @param[in] radio_mode  Radio mode value.
 *
 * @retval true  If Long Range Radio mode is set
 * @retval false Otherwise
 */
bool dtm_hw_radio_lr_check(nrf_radio_mode_t radio_mode);

/**@brief Function for getting minimum tx power.
 *
 * @retval Minimum tx power value.
 */
uint32_t dtm_hw_radio_min_power_get(void);

/**@brief Function for getting maximum tx power.
 *
 * @retval Maximum tx power value.
 */
uint32_t dtm_hw_radio_max_power_get(void);

/**@brief Function for getting power array size. This array contains all
 *        possible tx power values for given divice sorted in ascending
 *        order.
 *
 * @reval Size of the tx power array.
 */
size_t dtm_hw_radio_power_array_size_get(void);

/**@brief Function for getting tx power array. This array contains all
 *        possible tx power values for given divice sorted in ascending
 *        order.
 *
 * @retval Size of the tx power array.
 */
const uint32_t *dtm_hw_radio_power_array_get(void);

/**@brief Function for getting antenna pins array. This array contains
 *        all antenna pins data.
 *
 * @retval Size of the antenna pin array.
 */
size_t dtm_radio_antenna_pin_array_size_get(void);

/**@brief Function for getting antenna pins array size.
 *
 * @retval Pointer to the first element in antenna pins array.
 */
const uint32_t *dtm_hw_radion_antenna_pin_array_get(void);

#ifdef __cplusplus
}
#endif

#endif /* DTM_HW_H_ */
```

## src/dtm_hw_config.h
```c
/*
 * Copyright (c) 2020 Nordic Semiconductor ASA
 *
 * SPDX-License-Identifier: LicenseRef-Nordic-5-Clause
 */

#ifndef DTM_HW_CONFIG_H_
#define DTM_HW_CONFIG_H_

#ifdef __cplusplus
extern "C" {
#endif

#if DT_NODE_HAS_PROP(DT_NODELABEL(radio), dfe_supported) && \
	DT_PROP(DT_PATH(zephyr_user), dtm_antenna_count) > 0
#define DIRECTION_FINDING_SUPPORTED 1
#else
#define DIRECTION_FINDING_SUPPORTED 0
#endif /* DT_NODE_HAS_PROP(DT_NODELABEL(radio), dfe_supported) && \
	* DT_PROP(DT_PATH(zephyr_user), dtm_antenna_count) > 0
	*/

/* Maximum transmit or receive time, in microseconds, that the local
 * Controller supports for transmission of a single
 * Link Layer Data Physical Channel PDU, divided by 2.
 */
#if defined(NRF52840_XXAA) || defined(NRF52833_XXAA) || \
	defined(NRF52811_XXAA) || defined(NRF52820_XXAA)
#define NRF_MAX_RX_TX_TIME 0x2148
#else
#define NRF_MAX_RX_TX_TIME 0x424
#endif /* defined(NRF52840_XXAA) || defined(NRF52833_XXAA) ||
	* defined(NRF52811_XXAA) || defined(NRF52820_XXAA)
	*/

#ifdef __cplusplus
}
#endif

#endif /* DTM_HW_CONFIG_H_ */
```
