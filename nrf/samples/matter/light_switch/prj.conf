## CMakeLists.txt
```
#
# Copyright (c) 2021 Nordic Semiconductor ASA
#
# SPDX-License-Identifier: LicenseRef-Nordic-5-Clause
#

cmake_minimum_required(VERSION 3.20.0)

find_package(Zephyr HINTS $ENV{ZEPHYR_BASE})

project(matter-light-switch)

set(COMMON_ROOT ${ZEPHYR_NRF_MODULE_DIR}/samples/matter/common)
set(NLIO_ROOT ${ZEPHYR_CONNECTEDHOMEIP_MODULE_DIR}/third_party/nlio/repo)
set(DATA_MODEL_ROOT ${ZEPHYR_CONNECTEDHOMEIP_MODULE_DIR}/zzz_generated)
include(${ZEPHYR_CONNECTEDHOMEIP_MODULE_DIR}/config/nrfconnect/app/enable-gnu-std.cmake)
include(${ZEPHYR_CONNECTEDHOMEIP_MODULE_DIR}/src/app/chip_data_model.cmake)

# NORDIC SDK APP START
target_include_directories(app PRIVATE
    src
    ${COMMON_ROOT}/src
    ${NLIO_ROOT}/include
    ${DATA_MODEL_ROOT}
    ${DATA_MODEL_ROOT}/app-common
    ${DATA_MODEL_ROOT}/controller-clusters
)

target_compile_options(app PRIVATE -Wno-deprecated-declarations)

target_sources(app PRIVATE
    src/app_task.cpp
    src/light_switch.cpp
    src/main.cpp
    ${COMMON_ROOT}/src/led_widget.cpp
    ${COMMON_ROOT}/src/thread_util.cpp
    ${ZEPHYR_CONNECTEDHOMEIP_MODULE_DIR}/src/app/util/im-client-callbacks.cpp
    ${DATA_MODEL_ROOT}/controller-clusters/zap-generated/callback-stub.cpp
    ${DATA_MODEL_ROOT}/controller-clusters/zap-generated/CHIPClientCallbacks.cpp
    ${DATA_MODEL_ROOT}/controller-clusters/zap-generated/CHIPClusters.cpp
    ${DATA_MODEL_ROOT}/controller-clusters/zap-generated/IMClusterCommandHandler.cpp
)

chip_configure_data_model(app)
# NORDIC SDK APP END
```

## sample.yaml
```
sample:
  name: Matter Light Switch
  description: Matter Light Switch example
tests:
  matter.light_switch:
    build_only: true
    platform_allow: nrf52840dk_nrf52840 nrf5340dk_nrf5340_cpuapp nrf21540dk_nrf52840
    integration_platforms:
      - nrf52840dk_nrf52840
      - nrf5340dk_nrf5340_cpuapp
      - nrf21540dk_nrf52840
    tags: ci_build
```

## prj.conf
```kconfig
#
# Copyright (c) 2021 Nordic Semiconductor ASA
#
# SPDX-License-Identifier: LicenseRef-Nordic-5-Clause
#

# Enable CHIP
CONFIG_CHIP=y
CONFIG_CHIP_PROJECT_CONFIG="src/chip_project_config.h"
CONFIG_CHIP_ENABLE_DNSSD_SRP=n
CONFIG_STD_CPP14=y

# General networking settings
CONFIG_NETWORKING=y
CONFIG_NET_IPV6_NBR_CACHE=n
CONFIG_NET_IPV6_MLD=n
CONFIG_NET_SOCKETS_POLL_MAX=5

# Enable OpenThread MTD
CONFIG_NET_L2_OPENTHREAD=y

CONFIG_OPENTHREAD_FTD=y
CONFIG_OPENTHREAD_SLAAC=y
CONFIG_OPENTHREAD_MTD_NETDIAG=y
CONFIG_OPENTHREAD_MANUAL_START=y
CONFIG_OPENTHREAD_THREAD_STACK_SIZE=6144
CONFIG_OPENTHREAD_NUM_MESSAGE_BUFFERS=64

CONFIG_OPENTHREAD_PANID=4660
CONFIG_OPENTHREAD_CHANNEL=15
CONFIG_OPENTHREAD_NETWORK_NAME="OpenThread"
CONFIG_OPENTHREAD_XPANID="11:11:11:11:22:22:22:22"

# Enable Thread 1.2 features
CONFIG_OPENTHREAD_THREAD_VERSION_1_2=y
CONFIG_OPENTHREAD_DUA=y
CONFIG_OPENTHREAD_MLR=y

# Use nrf_security
CONFIG_OPENTHREAD_NRF_SECURITY_CHOICE=y

CONFIG_CC3XX_BACKEND=n
CONFIG_OBERON_BACKEND=y

CONFIG_MBEDTLS_ENABLE_HEAP=y
CONFIG_MBEDTLS_HEAP_SIZE=15360
CONFIG_MBEDTLS_TLS_LIBRARY=y
CONFIG_NRF_SECURITY_ADVANCED=y

CONFIG_MBEDTLS_AES_C=y
CONFIG_MBEDTLS_ECP_C=y
CONFIG_MBEDTLS_ECP_DP_SECP256R1_ENABLED=y
CONFIG_MBEDTLS_CTR_DRBG_C=y
CONFIG_MBEDTLS_CIPHER_MODE_CTR=y
CONFIG_MBEDTLS_ECJPAKE_C=y
CONFIG_MBEDTLS_SHA256_C=y
CONFIG_MBEDTLS_PK_C=y
CONFIG_MBEDTLS_PK_WRITE_C=y
CONFIG_MBEDTLS_X509_CREATE_C=y
CONFIG_MBEDTLS_X509_CSR_WRITE_C=y
CONFIG_MBEDTLS_X509_CSR_PARSE_C=y

# Disable unneeded crypto operations
CONFIG_MBEDTLS_SHA384_C=n
CONFIG_MBEDTLS_SHA512_C=n
CONFIG_MBEDTLS_CIPHER_MODE_XTS=n
CONFIG_MBEDTLS_CHACHA20_C=n
CONFIG_MBEDTLS_POLY1305_C=n
CONFIG_MBEDTLS_CHACHAPOLY_C=n
CONFIG_MBEDTLS_GCM_C=n
CONFIG_MBEDTLS_RSA_C=n

# Add support for LEDs and buttons on Nordic development kits
CONFIG_DK_LIBRARY=y

# Other settings
CONFIG_LOG=y
CONFIG_LOG_MODE_MINIMAL=y
CONFIG_MATTER_LOG_LEVEL_DBG=y
CONFIG_PRINTK_SYNC=y
CONFIG_MAIN_STACK_SIZE=8192
CONFIG_INIT_STACKS=y
CONFIG_HW_STACK_PROTECTION=y
CONFIG_HWINFO=y
CONFIG_THREAD_NAME=y
CONFIG_SHELL=y
CONFIG_ASSERT=y
```

## src/main.cpp
```c
/*
 * Copyright (c) 2021 Nordic Semiconductor ASA
 *
 * SPDX-License-Identifier: LicenseRef-Nordic-5-Clause
 */

#include "app_task.h"

#include <cstdlib>
#include <logging/log.h>

LOG_MODULE_REGISTER(app);

int main()
{
	return GetAppTask().StartApp() == CHIP_NO_ERROR ? EXIT_SUCCESS : EXIT_FAILURE;
}
```

## src/app_event.h
```c
/*
 * Copyright (c) 2021 Nordic Semiconductor ASA
 *
 * SPDX-License-Identifier: LicenseRef-Nordic-5-Clause
 */

#pragma once

#include <inet/IPAddress.h>

#include <cstdint>

#include "led_widget.h"

struct AppEvent {
	using IPAddress = chip::Inet::IPAddress;

	enum SimpleEventType : uint8_t { FactoryReset, StartDiscovery, StopDiscovery, ToggleLight };
	enum LightLevelEventType : uint8_t { SetLevel = ToggleLight + 1 };
	enum LightFoundEventType : uint8_t { LightFound = SetLevel + 1 };
	enum UpdateLedStateEventType : uint8_t { UpdateLedState = LightFound + 1 };

	AppEvent() = default;
	explicit AppEvent(SimpleEventType type) : Type(type) {}
	AppEvent(LightLevelEventType type, uint8_t level) : Type(type), LightLevelEvent{ level } {}
	AppEvent(LightFoundEventType type, const IPAddress &addr) : Type(type), LightFoundEvent{ addr } {}
	AppEvent(UpdateLedStateEventType type, LEDWidget *ledWidget) : Type(type), UpdateLedStateEvent{ ledWidget } {}

	uint8_t Type;

	union {
		struct {
			uint8_t Level;
		} LightLevelEvent;
		struct {
			IPAddress PeerAddress;
		} LightFoundEvent;
		struct {
			LEDWidget *LedWidget;
		} UpdateLedStateEvent;
	};
};
```

## src/app_task.cpp
```c
/*
 * Copyright (c) 2021 Nordic Semiconductor ASA
 *
 * SPDX-License-Identifier: LicenseRef-Nordic-5-Clause
 */

#include "app_task.h"

#include "led_widget.h"
#include "light_switch.h"
#include "thread_util.h"

#include <lib/support/CHIPMem.h>
#include <lib/support/SafeInt.h>
#include <platform/CHIPDeviceLayer.h>

#include <dk_buttons_and_leds.h>
#include <logging/log.h>
#include <zephyr.h>

using namespace ::chip::DeviceLayer;

LOG_MODULE_DECLARE(app);

namespace
{
static constexpr size_t kAppEventQueueSize = 10;

K_MSGQ_DEFINE(sAppEventQueue, sizeof(AppEvent), kAppEventQueueSize, alignof(AppEvent));
LightSwitch sLightSwitch;
LEDWidget sStatusLED;
uint8_t sLightLevel = 255; /* light brightness 0-255 */
k_timer sLightLevelTimer; /* timer for increasing the light brightness while holding the button */
k_timer sDiscoveryTimeout; /* timer for stopping light bulb discovery */
} /* namespace */

AppTask AppTask::sAppTask;

CHIP_ERROR AppTask::Init()
{
	/* Initialize CHIP */

	CHIP_ERROR err = chip::Platform::MemoryInit();

	if (err != CHIP_NO_ERROR) {
		LOG_ERR("Platform::MemoryInit() failed");
		return err;
	}

	err = sLightSwitch.Init();

	if (err != CHIP_NO_ERROR)
		return err;

	err = ThreadStackMgr().InitThreadStack();

	if (err != CHIP_NO_ERROR) {
		LOG_ERR("ThreadStackMgr().InitThreadStack() failed: %s", chip::ErrorStr(err));
		return err;
	}

	err = ConnectivityMgr().SetThreadDeviceType(ConnectivityManager::kThreadDeviceType_Router);

	if (err != CHIP_NO_ERROR) {
		LOG_ERR("ConnectivityMgr().SetThreadDeviceType() failed: %s", chip::ErrorStr(err));
		return err;
	}

	/* Initialize UI components */

	LEDWidget::InitGpio();
	LEDWidget::SetStateUpdateCallback(LEDStateUpdateHandler);
	sStatusLED.Init(DK_LED1);

	int ret = dk_buttons_init(ButtonEventHandler);

	if (ret) {
		LOG_ERR("dk_buttons_init() failed");
		return chip::System::MapErrorZephyr(ret);
	}

	k_timer_init(&sLightLevelTimer, AppTask::LightLevelTimerHandler, nullptr);
	k_timer_init(&sDiscoveryTimeout, AppTask::DiscoveryTimeoutHandler, nullptr);
	return CHIP_NO_ERROR;
}

CHIP_ERROR AppTask::StartApp()
{
	CHIP_ERROR err = Init();

	if (err != CHIP_NO_ERROR) {
		LOG_ERR("AppTask.Init() failed");
		return err;
	}

	AppEvent event = {};

	while (true) {
		k_msgq_get(&sAppEventQueue, &event, K_FOREVER);
		DispatchEvent(event);
	}

	return CHIP_NO_ERROR;
}

void AppTask::PostEvent(const AppEvent &event)
{
	if (k_msgq_put(&sAppEventQueue, &event, K_NO_WAIT)) {
		LOG_INF("Failed to post event to app task event queue");
	}
}

void AppTask::DispatchEvent(const AppEvent &event)
{
	switch (event.Type) {
	case AppEvent::FactoryReset:
		LOG_INF("Factory reset triggered");
		ConfigurationMgr().InitiateFactoryReset();
		break;
	case AppEvent::StartDiscovery:
		StartDiscoveryHandler();
		break;
	case AppEvent::StopDiscovery:
		sLightSwitch.StopDiscovery();
		sStatusLED.Set(false);
		break;
	case AppEvent::ToggleLight:
		sLightSwitch.ToggleLight();
		break;
	case AppEvent::SetLevel:
		sLightSwitch.SetLightLevel(event.LightLevelEvent.Level);
		break;
	case AppEvent::LightFound:
		k_timer_stop(&sDiscoveryTimeout);
		sLightSwitch.StopDiscovery();
		sStatusLED.Set(sLightSwitch.Pair(event.LightFoundEvent.PeerAddress) == CHIP_NO_ERROR);
		break;
	case AppEvent::UpdateLedState:
		event.UpdateLedStateEvent.LedWidget->UpdateState();
		break;
	default:
		LOG_INF("Unknown event received");
		break;
	}
}

void AppTask::StartDiscoveryHandler()
{
	if (!ConnectivityMgr().IsThreadProvisioned()) {
		StartDefaultThreadNetwork(/* dataset timestamp */ 1);
		LOG_INF("Device is not commissioned to a Thread network. Starting with the default configuration");
	}

	sLightSwitch.StartDiscovery();
	sStatusLED.Blink(100, 900);
	k_timer_start(&sDiscoveryTimeout, K_SECONDS(10), K_NO_WAIT);
}

void AppTask::LEDStateUpdateHandler(LEDWidget &ledWidget)
{
	sAppTask.PostEvent(AppEvent{ AppEvent::UpdateLedState, &ledWidget });
}

void AppTask::ButtonEventHandler(uint32_t buttonsState, uint32_t hasChanged)
{
	if (DK_BTN1_MSK & buttonsState & hasChanged) {
		GetAppTask().PostEvent(AppEvent(AppEvent::FactoryReset));
	}

	if (DK_BTN2_MSK & buttonsState & hasChanged) {
		GetAppTask().PostEvent(AppEvent(AppEvent::ToggleLight));
	}

	if (DK_BTN3_MSK & buttonsState & hasChanged) {
		GetAppTask().PostEvent(AppEvent(AppEvent::StartDiscovery));
	}

	if (DK_BTN4_MSK & hasChanged & buttonsState) {
		k_timer_start(&sLightLevelTimer, K_MSEC(150), K_MSEC(150));
	} else if (DK_BTN4_MSK & hasChanged) {
		k_timer_stop(&sLightLevelTimer);
	}
}

void AppTask::LightLevelTimerHandler(k_timer *)
{
	/* The exponential formula below is used, since brightness differences become less and less
	 * visible for a human eye as the level increases. */
	const size_t newLevel = (sLightLevel + 1) * 5 / 4;
	sLightLevel = chip::CanCastTo<uint8_t>(newLevel) ? static_cast<uint8_t>(newLevel) : 0;
	GetAppTask().PostEvent(AppEvent(AppEvent::SetLevel, sLightLevel));
}

void AppTask::DiscoveryTimeoutHandler(k_timer *)
{
	GetAppTask().PostEvent(AppEvent(AppEvent::StopDiscovery));
}
```

## src/app_task.h
```c
/*
 * Copyright (c) 2021 Nordic Semiconductor ASA
 *
 * SPDX-License-Identifier: LicenseRef-Nordic-5-Clause
 */

#pragma once

#include "app_event.h"
#include "led_widget.h"

#include <core/CHIPError.h>

#include <cstdint>

struct k_timer;

class AppTask {
public:
	CHIP_ERROR StartApp();
	void PostEvent(const AppEvent &event);

private:
	CHIP_ERROR Init();

	void DispatchEvent(const AppEvent &event);
	void StartDiscoveryHandler();

	static void ButtonEventHandler(uint32_t buttonsState, uint32_t hasChanged);
	static void LightLevelTimerHandler(k_timer *);
	static void DiscoveryTimeoutHandler(k_timer *);
	static void LEDStateUpdateHandler(LEDWidget &ledWidget);

	friend AppTask &GetAppTask();
	static AppTask sAppTask;
};

inline AppTask &GetAppTask()
{
	return AppTask::sAppTask;
}
```

## src/chip_project_config.h
```c
/*
 * Copyright (c) 2021 Nordic Semiconductor ASA
 *
 * SPDX-License-Identifier: LicenseRef-Nordic-5-Clause
 */

#pragma once

#define CHIP_CONFIG_CONTROLLER_MAX_ACTIVE_DEVICES 2
```

## src/light_switch.cpp
```c
/*
 * Copyright (c) 2021 Nordic Semiconductor ASA
 *
 * SPDX-License-Identifier: LicenseRef-Nordic-5-Clause
 */

#include "light_switch.h"

#include "app_task.h"

#include <controller/CHIPDeviceControllerFactory.h>
#include <controller/CommissioneeDeviceProxy.h>
#include <crypto/CHIPCryptoPAL.h>
#include <lib/support/ErrorStr.h>
#include <lib/support/ScopedBuffer.h>
#include <platform/CHIPDeviceLayer.h>
#include <platform/KeyValueStoreManager.h>
#include <zap-generated/CHIPClusters.h>

#include <logging/log.h>
#include <net/net_ip.h>

LOG_MODULE_DECLARE(app);

namespace
{
static constexpr chip::EndpointId kLightBulbEndpointId = 1;
static constexpr uint16_t kDiscoveryPort = 12345;
static constexpr const char kDiscoveryMagicString[] = "chip-light-bulb";
} /* namespace */

void LightSwitch::DiscoveryHandler::HandleMessageReceived(const chip::Transport::PeerAddress &source,
							  chip::System::PacketBufferHandle &&msgBuf)
{
	if (!mEnabled.load(std::memory_order_relaxed)) {
		return;
	}

	if (msgBuf->DataLength() != sizeof(kDiscoveryMagicString) ||
	    memcmp(msgBuf->Start(), kDiscoveryMagicString, sizeof(kDiscoveryMagicString)) != 0) {
		LOG_ERR("Discovery service received invalid message");
		return;
	}

	GetAppTask().PostEvent(AppEvent(AppEvent::LightFound, source.GetIPAddress()));
}

CHIP_ERROR
LightSwitch::PlaformPersistentStorageDelegate::SyncGetKeyValue(const char *key, void *buffer, uint16_t &size)
{
	return chip::DeviceLayer::PersistedStorage::KeyValueStoreMgr().Get(key, buffer, size);
}

CHIP_ERROR
LightSwitch::PlaformPersistentStorageDelegate::SyncSetKeyValue(const char *key, const void *value, uint16_t size)
{
	return chip::DeviceLayer::PersistedStorage::KeyValueStoreMgr().Put(key, value, size);
}

CHIP_ERROR LightSwitch::PlaformPersistentStorageDelegate::SyncDeleteKeyValue(const char *key)
{
	return chip::DeviceLayer::PersistedStorage::KeyValueStoreMgr().Delete(key);
}

CHIP_ERROR LightSwitch::Init()
{
	CHIP_ERROR err = mOpCredDelegate.Initialize(mStorageDelegate);

	if (err != CHIP_NO_ERROR) {
		LOG_ERR("ExampleOperationalCredentialsIssuer::Initialize() failed: %s", chip::ErrorStr(err));
		return err;
	}

	chip::Crypto::P256Keypair ephemeralKey;
	err = ephemeralKey.Initialize();

	if (err != CHIP_NO_ERROR) {
		LOG_ERR("P256Keypair::Initialize() failed: %s", chip::ErrorStr(err));
		return err;
	}

	chip::Platform::ScopedMemoryBuffer<uint8_t> rcac;
	chip::Platform::ScopedMemoryBuffer<uint8_t> icac;
	chip::Platform::ScopedMemoryBuffer<uint8_t> noc;

	if (!rcac.Alloc(chip::Controller::kMaxCHIPDERCertLength) ||
	    !icac.Alloc(chip::Controller::kMaxCHIPDERCertLength) ||
	    !noc.Alloc(chip::Controller::kMaxCHIPDERCertLength)) {
		LOG_ERR("Failed to allocated memory for certificate chain");
		return CHIP_ERROR_NO_MEMORY;
	}

	chip::MutableByteSpan rcacSpan(rcac.Get(), chip::Controller::kMaxCHIPDERCertLength);
	chip::MutableByteSpan icacSpan(icac.Get(), chip::Controller::kMaxCHIPDERCertLength);
	chip::MutableByteSpan nocSpan(noc.Get(), chip::Controller::kMaxCHIPDERCertLength);

	err = mOpCredDelegate.GenerateNOCChainAfterValidation(chip::kTestControllerNodeId, 0, ephemeralKey.Pubkey(),
							      rcacSpan, icacSpan, nocSpan);

	if (err != CHIP_NO_ERROR) {
		LOG_ERR("Failed to issue certificate chain: %s", chip::ErrorStr(err));
		return err;
	}

	chip::Controller::SetupParams commissionerSetupParams = {};
	commissionerSetupParams.storageDelegate = &mStorageDelegate;
	commissionerSetupParams.operationalCredentialsDelegate = &mOpCredDelegate;
	commissionerSetupParams.ephemeralKeypair = &ephemeralKey;
	commissionerSetupParams.controllerRCAC = chip::ByteSpan(rcac.Get(), chip::Controller::kMaxCHIPDERCertLength);
	commissionerSetupParams.controllerICAC = chip::ByteSpan(icac.Get(), chip::Controller::kMaxCHIPDERCertLength);
	commissionerSetupParams.controllerNOC = chip::ByteSpan(noc.Get(), chip::Controller::kMaxCHIPDERCertLength);

	err = mFabricStorage.Initialize(&mStorageDelegate);
	if (err != CHIP_NO_ERROR) {
		LOG_ERR("mFabricStorage.Initialize() failed: %s", chip::ErrorStr(err));
		return err;
	}

	chip::Controller::FactoryInitParams factoryParams;
	factoryParams.fabricStorage = &mFabricStorage;
	factoryParams.listenPort = CHIP_PORT + 2;

	err = chip::Controller::DeviceControllerFactory::GetInstance().Init(factoryParams);
	if (err != CHIP_NO_ERROR) {
		LOG_ERR("DeviceControllerFactory::Init() failed: %s", chip::ErrorStr(err));
		return err;
	}

	err = chip::Controller::DeviceControllerFactory::GetInstance().SetupCommissioner(commissionerSetupParams,
											 mCommissioner);
	if (err != CHIP_NO_ERROR) {
		LOG_ERR("DeviceControllerFactory::SetupCommissioner() failed: %s", chip::ErrorStr(err));
		return err;
	}

	err = chip::Controller::DeviceControllerFactory::GetInstance().ServiceEvents();

	if (err != CHIP_NO_ERROR) {
		LOG_ERR("DeviceCommissioner::ServiceEvents() failed: %s", chip::ErrorStr(err));
		return err;
	}

	auto params = chip::Transport::UdpListenParameters(chip::DeviceLayer::UDPEndPointManager())
			      .SetListenPort(kDiscoveryPort);
	err = mDiscoveryServiceEndpoint.Init(params);

	if (err != CHIP_NO_ERROR) {
		LOG_ERR("Transport::UDP::Init() failed: %s", chip::ErrorStr(err));
		return err;
	}

	mDiscoveryHandler.SetEnabled(true);
	mDiscoveryServiceEndpoint.SetDelegate(&mDiscoveryHandler);
	return CHIP_NO_ERROR;
}

void LightSwitch::StartDiscovery()
{
	LOG_INF("Starting light bulb discovery");
	mDiscoveryHandler.SetEnabled(true);
}

void LightSwitch::StopDiscovery()
{
	LOG_INF("Stopping light bulb discovery");
	mDiscoveryHandler.SetEnabled(false);
}

CHIP_ERROR LightSwitch::Pair(const chip::Inet::IPAddress &lightBulbAddress)
{
	{
		char addrStr[NET_IPV6_ADDR_LEN];
		LOG_INF("Pairing with light bulb %s", lightBulbAddress.ToString(addrStr, NET_IPV6_ADDR_LEN));
	}

	CHIP_ERROR err = CHIP_NO_ERROR;

	{
		err = mCommissioner.PairTestDeviceWithoutSecurity(
			chip::kTestDeviceNodeId, chip::Transport::PeerAddress::UDP(lightBulbAddress, CHIP_PORT));
	}

	if (err != CHIP_NO_ERROR)
		LOG_ERR("Pairing failed: %s", chip::ErrorStr(err));

	return err;
}

CHIP_ERROR LightSwitch::ToggleLight()
{
	LOG_INF("Toggling the light");

	chip::CommissioneeDeviceProxy *device;
	CHIP_ERROR err = mCommissioner.GetDeviceBeingCommissioned(chip::kTestDeviceNodeId, &device);

	if (err != CHIP_NO_ERROR) {
		LOG_ERR("No light bulb device is paired");
		return err;
	}

	chip::Controller::OnOffCluster cluster;
	cluster.Associate(device, kLightBulbEndpointId);

	return cluster.Toggle(nullptr, nullptr);
}

CHIP_ERROR LightSwitch::SetLightLevel(uint8_t level)
{
	LOG_INF("Setting brightness level to %u", level);

	chip::CommissioneeDeviceProxy *device;
	CHIP_ERROR err = mCommissioner.GetDeviceBeingCommissioned(chip::kTestDeviceNodeId, &device);

	if (err != CHIP_NO_ERROR) {
		LOG_ERR("No light bulb device is paired");
		return err;
	}

	chip::Controller::LevelControlCluster cluster;
	cluster.Associate(device, kLightBulbEndpointId);

	return cluster.MoveToLevel(nullptr, nullptr, level, 0, 0, 0);
}
```

## src/light_switch.h
```c
/*
 * Copyright (c) 2021 Nordic Semiconductor ASA
 *
 * SPDX-License-Identifier: LicenseRef-Nordic-5-Clause
 */

#pragma once

#include <controller/CHIPDeviceController.h>
#include <controller/ExampleOperationalCredentialsIssuer.h>
#include <transport/raw/UDP.h>

#include <atomic>

/** @class LightSwitch
 *  @brief Class for controlling a CHIP light bulb over a Thread network
 *
 *  Features:
 *  - discovering a CHIP light bulb which advertises itself by sending Thread multicast packets
 *  - toggling and dimming the connected CHIP light bulb by sending appropriate CHIP messages
 */
class LightSwitch {
public:
	CHIP_ERROR Init();

	void StartDiscovery();
	void StopDiscovery();
	bool IsDiscoveryEnabled() const;

	CHIP_ERROR Pair(const chip::Inet::IPAddress &lightBulbAddress);
	CHIP_ERROR ToggleLight();
	CHIP_ERROR SetLightLevel(uint8_t level);

private:
	class DiscoveryHandler : public chip::Transport::RawTransportDelegate {
	public:
		void SetEnabled(bool enabled) { mEnabled.store(enabled, std::memory_order_relaxed); }
		void HandleMessageReceived(const chip::Transport::PeerAddress &source,
					   chip::System::PacketBufferHandle &&msgBuf) override;

	private:
		std::atomic_bool mEnabled;
	};

	class PlaformPersistentStorageDelegate : public chip::PersistentStorageDelegate {
	public:
		CHIP_ERROR SyncGetKeyValue(const char *key, void *buffer, uint16_t &size) override;
		CHIP_ERROR SyncSetKeyValue(const char *key, const void *value, uint16_t size) override;
		CHIP_ERROR SyncDeleteKeyValue(const char *key) override;
	};

	chip::Transport::UDP mDiscoveryServiceEndpoint;
	chip::Controller::DeviceCommissioner mCommissioner;
	chip::Controller::ExampleOperationalCredentialsIssuer mOpCredDelegate;
	chip::SimpleFabricStorage mFabricStorage;
	PlaformPersistentStorageDelegate mStorageDelegate;
	DiscoveryHandler mDiscoveryHandler;
};
```
