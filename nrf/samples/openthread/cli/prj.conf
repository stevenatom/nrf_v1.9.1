## CMakeLists.txt
```
#
# Copyright (c) 2020 Nordic Semiconductor ASA
#
# SPDX-License-Identifier: LicenseRef-Nordic-5-Clause
#
cmake_minimum_required(VERSION 3.20.0)

find_package(Zephyr REQUIRED HINTS $ENV{ZEPHYR_BASE})

project(openthread_cli)

# NORDIC SDK APP START
target_sources(app PRIVATE src/main.c)
# NORDIC SDK APP END

target_sources_ifdef(CONFIG_BT app PRIVATE src/ble.c)
```

## Kconfig
```
#
# Copyright (c) 2020 Nordic Semiconductor ASA
#
# SPDX-License-Identifier: LicenseRef-Nordic-5-Clause
#

menu "Zephyr Kernel"
source "Kconfig.zephyr"
endmenu

module = OT_COMMAND_LINE_INTERFACE
module-str = ot_cli
source "${ZEPHYR_BASE}/subsys/logging/Kconfig.template.log_config"
```

## sample.yaml
```
sample:
  name: OpenThread CLI sample
  description: Test OpenThread Command Line Interface.
tests:
  samples.openthread.cli:
    build_only: true
    platform_allow: nrf5340dk_nrf5340_cpuapp nrf5340dk_nrf5340_cpuapp_ns nrf52840dk_nrf52840 nrf52833dk_nrf52833 nrf21540dk_nrf52840
    tags: ci_build
    integration_platforms:
      - nrf5340dk_nrf5340_cpuapp
      - nrf5340dk_nrf5340_cpuapp_ns
      - nrf52840dk_nrf52840
      - nrf52833dk_nrf52833
      - nrf21540dk_nrf52840
  samples.openthread.cli.thread_1_2:
    build_only: true
    platform_allow: nrf52840dk_nrf52840 nrf52833dk_nrf52833 nrf21540dk_nrf52840
    tags: ci_build
    extra_args: CONFIG_OPENTHREAD_THREAD_VERSION_1_2=y
    integration_platforms:
      - nrf52840dk_nrf52840
      - nrf52833dk_nrf52833
      - nrf21540dk_nrf52840
  samples.openthread.cli.usb:
    build_only: true
    platform_allow: nrf5340dk_nrf5340_cpuapp nrf5340dk_nrf5340_cpuapp_ns nrf52840dk_nrf52840 nrf52840dongle_nrf52840 nrf52833dk_nrf52833 nrf21540dk_nrf52840
    tags: ci_build
    extra_args: OVERLAY_CONFIG=overlay-usb.conf
                DTC_OVERLAY_FILE="usb.overlay"
    integration_platforms:
      - nrf5340dk_nrf5340_cpuapp
      - nrf5340dk_nrf5340_cpuapp_ns
      - nrf52840dk_nrf52840
      - nrf52840dongle_nrf52840
      - nrf52833dk_nrf52833
      - nrf21540dk_nrf52840
  samples.openthread.cli.minimal_multiprotocol:
    build_only: true
    platform_allow: nrf5340dk_nrf5340_cpuapp nrf5340dk_nrf5340_cpuapp_ns nrf52840dk_nrf52840 nrf52833dk_nrf52833 nrf21540dk_nrf52840
    tags: ci_build
    extra_args: OVERLAY_CONFIG=overlay-minimal_multiprotocol.conf
    integration_platforms:
      - nrf5340dk_nrf5340_cpuapp
      - nrf5340dk_nrf5340_cpuapp_ns
      - nrf52840dk_nrf52840
      - nrf52833dk_nrf52833
      - nrf21540dk_nrf52840
  samples.openthread.cli.minimal_singleprotocol:
    build_only: true
    platform_allow: nrf5340dk_nrf5340_cpuapp nrf5340dk_nrf5340_cpuapp_ns nrf52840dk_nrf52840 nrf52833dk_nrf52833 nrf21540dk_nrf52840
    tags: ci_build
    extra_args: OVERLAY_CONFIG=overlay-minimal_singleprotocol.conf
    integration_platforms:
      - nrf5340dk_nrf5340_cpuapp
      - nrf5340dk_nrf5340_cpuapp_ns
      - nrf52840dk_nrf52840
      - nrf52833dk_nrf52833
      - nrf21540dk_nrf52840
```

## prj.conf
```kconfig
#
# Copyright (c) 2020 Nordic Semiconductor
#
# SPDX-License-Identifier: LicenseRef-Nordic-5-Clause
#

# Network shell
CONFIG_SHELL=y
CONFIG_OPENTHREAD_SHELL=y
CONFIG_SHELL_ARGC_MAX=26
CONFIG_SHELL_CMD_BUFF_SIZE=416

# Enable OpenThread features set
CONFIG_OPENTHREAD_NORDIC_LIBRARY_MASTER=y

CONFIG_NET_L2_OPENTHREAD=y

# Generic networking options
CONFIG_NETWORKING=y

CONFIG_ASSERT=y
CONFIG_ASSERT_NO_COND_INFO=y
CONFIG_MBEDTLS_SHA1_C=n
CONFIG_FPU=y

CONFIG_GPIO_SHELL=y
```

## overlay-debug.conf
```kconfig
#
# Copyright (c) 2022 Nordic Semiconductor
#
# SPDX-License-Identifier: LicenseRef-Nordic-5-Clause
#

# Enable multithread support in gdb
CONFIG_DEBUG=y
CONFIG_THREAD_MONITOR=y
CONFIG_INIT_STACKS=y
CONFIG_THREAD_STACK_INFO=y
CONFIG_TIMESLICING=n
CONFIG_OPENOCD_SUPPORT=y
CONFIG_THREAD_NAME=y
CONFIG_DEBUG_THREAD_INFO=y
```

## overlay-logging.conf
```kconfig
#
# Copyright (c) 2021 Nordic Semiconductor
#
# SPDX-License-Identifier: LicenseRef-Nordic-5-Clause

# Enable Zephyr logging
CONFIG_LOG=y

# Option for configuring log level in cli sample
CONFIG_OT_COMMAND_LINE_INTERFACE_LOG_LEVEL_INF=y

# Enable net module logging
# CONFIG_NET_LOG=y
# Option for configuring log level in net config library
# CONFIG_NET_CONFIG_LOG_LEVEL_INF=y

# Option for configuring log level in Zephyr l2 logging
# CONFIG_OPENTHREAD_L2_DEBUG=y
# CONFIG_OPENTHREAD_L2_LOG_LEVEL_DBG=y
# CONFIG_OPENTHREAD_L2_DEBUG_DUMP_15_4=y
# CONFIG_OPENTHREAD_L2_DEBUG_DUMP_IPV6=y

# Enable OpenThread logging
CONFIG_OPENTHREAD_DEBUG=y
# Option for configuring log level in OpenThread
CONFIG_OPENTHREAD_LOG_LEVEL_INFO=y

# Adjust log strdup settings
CONFIG_LOG_STRDUP_BUF_COUNT=32
CONFIG_LOG_STRDUP_MAX_STRING=128
```

## overlay-minimal_multiprotocol.conf
```kconfig
#
# Copyright (c) 2020 Nordic Semiconductor
#
# SPDX-License-Identifier: LicenseRef-Nordic-5-Clause
#

# Build
CONFIG_SIZE_OPTIMIZATIONS=y

# Boot
CONFIG_BOOT_BANNER=n
CONFIG_BOOT_DELAY=0

# Disable asserts to save ~28kB ROM
CONFIG_ASSERT=n

# Disable logging to save ~11kB ROM
CONFIG_LOG=n
CONFIG_OPENTHREAD_DEBUG=n
CONFIG_OPENTHREAD_L2_DEBUG=n

# Network shell
CONFIG_NET_SHELL=n

# Enable and configure Bluetooth LE
CONFIG_BT=y
CONFIG_BT_PERIPHERAL=y
CONFIG_BT_DEVICE_NAME="NCS DUT"
CONFIG_BT_DEVICE_APPEARANCE=833

# Disable BT Security Manager Protocol support to save ~20kB ROM
# Pairing with the device will not be available, only non-secure connection
CONFIG_BT_SMP=n

# Restrict number of BT connection
CONFIG_BT_MAX_CONN=1

# Disable Bluetooth features not needed
CONFIG_BT_DEBUG_NONE=y
CONFIG_BT_ASSERT=n
CONFIG_BT_DATA_LEN_UPDATE=n
CONFIG_BT_PHY_UPDATE=n
CONFIG_BT_GATT_CACHING=n
CONFIG_BT_GATT_SERVICE_CHANGED=n
CONFIG_BT_GAP_PERIPHERAL_PREF_PARAMS=n
CONFIG_BT_HCI_VS_EXT=n

# # Disable LE Controller-based Privacy
CONFIG_BT_CTLR_PRIVACY=n

# Disable HCI Vendor-Specific Extensions
CONFIG_BT_HCI_VS_EXT=n

# Reduce Bluetooth buffers
CONFIG_BT_BUF_EVT_DISCARDABLE_COUNT=1
CONFIG_BT_BUF_EVT_DISCARDABLE_SIZE=43
CONFIG_BT_BUF_EVT_RX_COUNT=2
CONFIG_BT_CONN_TX_MAX=2
CONFIG_BT_L2CAP_TX_BUF_COUNT=2
CONFIG_BT_CTLR_RX_BUFFERS=1
CONFIG_BT_BUF_ACL_TX_COUNT=3
CONFIG_BT_BUF_ACL_TX_SIZE=27

# To correctly tune the stack sizes for the threads, the following
# configurations can enabled to print the current use:
# CONFIG_THREAD_NAME=y
# CONFIG_THREAD_ANALYZER=y
# CONFIG_THREAD_ANALYZER_AUTO=y
# CONFIG_THREAD_ANALYZER_RUN_UNLOCKED=y
# CONFIG_THREAD_ANALYZER_USE_PRINTK=y
# CONFIG_CONSOLE=y
# CONFIG_UART_CONSOLE=y
# CONFIG_SERIAL=y
# CONFIG_PRINTK=y

# Example output of thread analyzer:
#  SDC RX              : unused 160 usage 200 / 360 (55 %)
#  BT RX               : unused 616 usage 408 / 1024 (39 %)
#  BT TX               : unused 304 usage 336 / 640 (52 %)
#  thread_analyzer     : unused 160 usage 352 / 512 (68 %)
#  rx_workq            : unused 332 usage 180 / 512 (35 %)
#  openthread          : unused 1944 usage 2152 / 4096 (52 %)
#  workqueue           : unused 232 usage 280 / 512 (54 %)
#  tx_workq            : unused 136 usage 120 / 256 (46 %)
#  net_mgmt            : unused 104 usage 152 / 256 (59 %)
#  nrf5_rx             : unused 256 usage 256 / 512 (50 %)
#  sysworkq            : unused 792 usage 232 / 1024 (22 %)
#  MPSL signal         : unused 152 usage 488 / 640 (76 %)
#  shell_uart          : unused 648 usage 1400 / 2048 (68 %)
#  idle 00             : unused 56 usage 72 / 128 (56 %)

# Configurations set based on thread analyzer output.
CONFIG_BT_CTLR_SDC_RX_STACK_SIZE=360
CONFIG_BT_RX_STACK_SIZE=1024
CONFIG_BT_HCI_TX_STACK_SIZE_WITH_PROMPT=y
CONFIG_BT_HCI_TX_STACK_SIZE=640
CONFIG_OPENTHREAD_THREAD_STACK_SIZE=4096
CONFIG_NET_RX_STACK_SIZE=512
CONFIG_NET_TX_STACK_SIZE=256
CONFIG_NET_MGMT_EVENT_STACK_SIZE=256
CONFIG_IEEE802154_NRF5_RX_STACK_SIZE=512
CONFIG_SYSTEM_WORKQUEUE_STACK_SIZE=2144
CONFIG_MPSL_SIGNAL_STACK_SIZE=640
CONFIG_SHELL_STACK_SIZE=2048
CONFIG_IDLE_STACK_SIZE=128
CONFIG_MAIN_STACK_SIZE=2048
CONFIG_ISR_STACK_SIZE=1024
```

## overlay-minimal_singleprotocol.conf
```kconfig
#
# Copyright (c) 2020 Nordic Semiconductor
#
# SPDX-License-Identifier: LicenseRef-Nordic-5-Clause
#

# Build
CONFIG_SIZE_OPTIMIZATIONS=y

# Boot
CONFIG_BOOT_BANNER=n
CONFIG_BOOT_DELAY=0

# Disable asserts to save ~28kB ROM
CONFIG_ASSERT=n

# Disable logging to save ~11kB ROM
CONFIG_LOG=n
CONFIG_OPENTHREAD_DEBUG=n
CONFIG_OPENTHREAD_L2_DEBUG=n

# Network shell
CONFIG_NET_SHELL=n

# To correctly tune the stack sizes for the threads, the following
# configurations can enabled to print the current use:
# CONFIG_THREAD_NAME=y
# CONFIG_THREAD_ANALYZER=y
# CONFIG_THREAD_ANALYZER_AUTO=y
# CONFIG_THREAD_ANALYZER_RUN_UNLOCKED=y
# CONFIG_THREAD_ANALYZER_USE_PRINTK=y
# CONFIG_CONSOLE=y
# CONFIG_UART_CONSOLE=y
# CONFIG_SERIAL=y
# CONFIG_PRINTK=y

# Example output of thread analyzer:
#  thread_analyzer     : unused 160 usage 352 / 512 (68 %)
#  conn_mgr_thread     : unused 136 usage 120 / 256 (46 %)
#  rx_workq            : unused 332 usage 180 / 512 (35 %)
#  openthread          : unused 1944 usage 2152 / 4096 (52 %)
#  workqueue           : unused 232 usage 280 / 512 (54 %)
#  tx_workq            : unused 136 usage 120 / 256 (46 %)
#  net_mgmt            : unused 104 usage 152 / 256 (59 %)
#  nrf5_rx             : unused 256 usage 256 / 512 (50 %)
#  sysworkq            : unused 792 usage 232 / 1024 (22 %)
#  MPSL signal         : unused 152 usage 488 / 640 (76 %)
#  shell_uart          : unused 648 usage 1400 / 2048 (68 %)
#  idle 00             : unused 56 usage 72 / 128 (56 %)

# Configurations set based on thread analyzer output.
CONFIG_OPENTHREAD_THREAD_STACK_SIZE=4096
CONFIG_NET_RX_STACK_SIZE=512
CONFIG_NET_TX_STACK_SIZE=256
CONFIG_NET_MGMT_EVENT_STACK_SIZE=256
CONFIG_IEEE802154_NRF5_RX_STACK_SIZE=512
CONFIG_SYSTEM_WORKQUEUE_STACK_SIZE=1024
CONFIG_MPSL_SIGNAL_STACK_SIZE=640
CONFIG_SHELL_STACK_SIZE=2048
CONFIG_IDLE_STACK_SIZE=128
CONFIG_MAIN_STACK_SIZE=2048
CONFIG_ISR_STACK_SIZE=1024
```

## overlay-rtt.conf
```kconfig
#
# Copyright (c) 2022 Nordic Semiconductor
#
# SPDX-License-Identifier: LicenseRef-Nordic-5-Clause
#

# Enable RTT logging backend
CONFIG_USE_SEGGER_RTT=y
CONFIG_LOG_BACKEND_RTT=y

CONFIG_LOG_BACKEND_UART=n
CONFIG_SHELL_LOG_BACKEND=n
```

## overlay-usb.conf
```kconfig
#
# Copyright (c) 2021 Nordic Semiconductor
#
# SPDX-License-Identifier: LicenseRef-Nordic-5-Clause
#

CONFIG_SHELL_BACKEND_SERIAL_INIT_PRIORITY=51

CONFIG_UART_LINE_CTRL=y
CONFIG_SHELL_BACKEND_SERIAL_CHECK_DTR=y
CONFIG_USB_CDC_ACM_LOG_LEVEL_OFF=y

CONFIG_USB_DEVICE_STACK=y
CONFIG_USB_DEVICE_MANUFACTURER="Nordic Semiconductor ASA"
CONFIG_USB_DEVICE_PRODUCT="Thread CLI"
CONFIG_USB_DEVICE_VID=0x1915
CONFIG_USB_DEVICE_PID=0x0000
```

## usb.overlay
```dts
/*
 * Copyright (c) 2021 Nordic Semiconductor ASA
 *
 * SPDX-License-Identifier: LicenseRef-Nordic-5-Clause
 */

/ {
	chosen {
		zephyr,shell-uart = &cdc_acm_uart0;
	};
};

&zephyr_udc0 {
	cdc_acm_uart0: cdc_acm_uart0 {
		compatible = "zephyr,cdc-acm-uart";
		label = "CDC_ACM_0";
	};
};
```

## boards/nrf52840dongle_nrf52840.overlay
```dts
/* Copyright (c) 2021 Nordic Semiconductor ASA
 *
 * SPDX-License-Identifier: LicenseRef-Nordic-5-Clause
 */

&uart0 {
	status = "okay";
	hw-flow-control;
};

/ {
	/*
	* In some default configurations within the nRF Connect SDK,
	* e.g. on nRF52840, the chosen zephyr,entropy node is &cryptocell.
	* This devicetree overlay ensures that default is overridden wherever it
	* is set, as this application uses the RNG node for entropy exclusively.
	*/
	chosen {
		zephyr,entropy = &rng;
	};
};
```

## src/main.c
```c
/*
 * Copyright (c) 2020 Nordic Semiconductor ASA
 *
 * SPDX-License-Identifier: LicenseRef-Nordic-5-Clause
 */

#include <zephyr.h>
#include <logging/log.h>

#if defined(CONFIG_BT)
#include "ble.h"
#endif

#include <drivers/uart.h>
#include <usb/usb_device.h>

LOG_MODULE_REGISTER(cli_sample, CONFIG_OT_COMMAND_LINE_INTERFACE_LOG_LEVEL);

#define WELLCOME_TEXT \
	"\n\r"\
	"\n\r"\
	"OpenThread Command Line Interface is now running.\n\r" \
	"Use the 'ot' keyword to invoke OpenThread commands e.g. " \
	"'ot thread start.'\n\r" \
	"For the full commands list refer to the OpenThread CLI " \
	"documentation at:\n\r" \
	"https://github.com/openthread/openthread/blob/master/src/cli/README.md\n\r"

void main(void)
{
#if DT_NODE_HAS_COMPAT(DT_CHOSEN(zephyr_shell_uart), zephyr_cdc_acm_uart)
	int ret;
	const struct device *dev;
	uint32_t dtr = 0U;

	ret = usb_enable(NULL);
	if (ret != 0) {
		LOG_ERR("Failed to enable USB");
		return;
	}

	dev = DEVICE_DT_GET(DT_CHOSEN(zephyr_shell_uart));
	if (dev == NULL) {
		LOG_ERR("Failed to find specific UART device");
		return;
	}

	LOG_INF("Waiting for host to be ready to communicate");

	/* Data Terminal Ready - check if host is ready to communicate */
	while (!dtr) {
		ret = uart_line_ctrl_get(dev, UART_LINE_CTRL_DTR, &dtr);
		if (ret) {
			LOG_ERR("Failed to get Data Terminal Ready line state: %d",
				ret);
			continue;
		}
		k_msleep(100);
	}

	/* Data Carrier Detect Modem - mark connection as established */
	(void)uart_line_ctrl_set(dev, UART_LINE_CTRL_DCD, 1);
	/* Data Set Ready - the NCP SoC is ready to communicate */
	(void)uart_line_ctrl_set(dev, UART_LINE_CTRL_DSR, 1);
#endif

	LOG_INF(WELLCOME_TEXT);

#if CONFIG_BT
	ble_enable();
#endif

}
```

## src/ble.c
```c
/*
 * Copyright (c) 2020 Nordic Semiconductor ASA
 *
 * SPDX-License-Identifier: LicenseRef-Nordic-5-Clause
 */

#include <zephyr.h>
#include <bluetooth/gatt.h>

#include "ble.h"

#define DEVICE_NAME CONFIG_BT_DEVICE_NAME
#define DEVICE_NAME_LEN (sizeof(DEVICE_NAME) - 1)

static const struct bt_data ad[] = {
	BT_DATA_BYTES(BT_DATA_FLAGS, (BT_LE_AD_GENERAL | BT_LE_AD_NO_BREDR)),
	BT_DATA(BT_DATA_NAME_COMPLETE, DEVICE_NAME, DEVICE_NAME_LEN),
};

static struct bt_conn_cb conn_callbacks;

void ble_enable(void)
{
	bt_enable(NULL);
	bt_conn_cb_register(&conn_callbacks);
	bt_le_adv_start(BT_LE_ADV_CONN, ad, ARRAY_SIZE(ad), NULL, 0);
}
```
