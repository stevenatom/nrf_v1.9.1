## CMakeLists.txt
```
#
# Copyright (c) 2020 Nordic Semiconductor ASA
#
# SPDX-License-Identifier: LicenseRef-Nordic-5-Clause
#

cmake_minimum_required(VERSION 3.20.0)

set(OT_NCP_VENDOR_HOOK_SOURCE_DIR ${CMAKE_CURRENT_SOURCE_DIR})

find_package(Zephyr REQUIRED HINTS $ENV{ZEPHYR_BASE})

project(openthread_coprocessor)

# NORDIC SDK APP START
target_sources(app PRIVATE src/main.c src/nrf_802154_radio_wrapper.c)
# NORDIC SDK APP END
```

## Kconfig
```
#
# Copyright (c) 2020 Nordic Semiconductor ASA
#
# SPDX-License-Identifier: LicenseRef-Nordic-5-Clause
#

menu "Zephyr Kernel"
source "Kconfig.zephyr"
endmenu

module = OT_COPROCESSOR
module-str = ot_coprocessor
source "${ZEPHYR_BASE}/subsys/logging/Kconfig.template.log_config"
```

## sample.yaml
```
sample:
  name: OpenThread Co-Processor sample
  description: Test OpenThread Co-Processor
tests:
  samples.openthread.coprocessor:
    build_only: true
    platform_allow: nrf52840dk_nrf52840 nrf52833dk_nrf52833 nrf21540dk_nrf52840
    tags: ci_build
    extra_args: OVERLAY_CONFIG=overlay-logging.conf;overlay-vendor_hook.conf
    integration_platforms:
      - nrf52840dk_nrf52840
      - nrf52833dk_nrf52833
      - nrf21540dk_nrf52840
  samples.openthread.coprocessor.rcp:
    build_only: true
    platform_allow: nrf52840dk_nrf52840 nrf52833dk_nrf52833 nrf21540dk_nrf52840
    tags: ci_build
    extra_args: OVERLAY_CONFIG=overlay-rcp.conf;overlay-logging.conf;overlay-vendor_hook.conf
    integration_platforms:
      - nrf52840dk_nrf52840
      - nrf52833dk_nrf52833
      - nrf21540dk_nrf52840
  samples.openthread.coprocessor.usb:
    build_only: true
    platform_allow: nrf52840dk_nrf52840 nrf52840dongle_nrf52840 nrf52833dk_nrf52833 nrf21540dk_nrf52840
    tags: ci_build
    extra_args: OVERLAY_CONFIG=overlay-usb.conf
                DTC_OVERLAY_FILE="usb.overlay"
    integration_platforms:
      - nrf52840dk_nrf52840
      - nrf52840dongle_nrf52840
      - nrf52833dk_nrf52833
      - nrf21540dk_nrf52840
```

## prj.conf
```kconfig
#
# Copyright (c) 2020 Nordic Semiconductor
#
# SPDX-License-Identifier: LicenseRef-Nordic-5-Clause
#

# Set OpenThread NCP architecture
CONFIG_OPENTHREAD_COPROCESSOR=y
CONFIG_OPENTHREAD_COPROCESSOR_NCP=y

# Logging
CONFIG_LOG=y
CONFIG_OT_COPROCESSOR_LOG_LEVEL_ERR=y
CONFIG_LOG_MAX_LEVEL=1
CONFIG_OPENTHREAD_DEBUG=y
CONFIG_OPENTHREAD_LOG_LEVEL_CRIT=y
CONFIG_LOG_BACKEND_SPINEL=y
CONFIG_LOG_BACKEND_RTT=n
CONFIG_LOG_BACKEND_UART=n
CONFIG_BOOT_BANNER=n

# Increase logging thread stack size due to Spinel backend needs
CONFIG_LOG_PROCESS_THREAD_STACK_SIZE=2048

# Enable OpenThread features set
CONFIG_OPENTHREAD_NORDIC_LIBRARY_MASTER=y

CONFIG_NET_L2_OPENTHREAD=y

# Generic networking options
CONFIG_NETWORKING=y

CONFIG_ASSERT=y
CONFIG_ASSERT_NO_COND_INFO=y
CONFIG_MBEDTLS_SHA1_C=n
CONFIG_FPU=y
```

## overlay-logging.conf
```kconfig
#
# Copyright (c) 2020 Nordic Semiconductor
#
# SPDX-License-Identifier: LicenseRef-Nordic-5-Clause

# Disable Spinel logging backend
CONFIG_LOG_BACKEND_SPINEL=n

# Enable RTT logging backend
CONFIG_USE_SEGGER_RTT=y
CONFIG_LOG_BACKEND_RTT=y

# Option for configuring log level in whole Zephyr
CONFIG_LOG_MAX_LEVEL=3

# Option for configuring log level in sample module
CONFIG_OT_COPROCESSOR_LOG_LEVEL_INF=y

# Option for configuring log level in OpenThread
CONFIG_OPENTHREAD_LOG_LEVEL_INFO=y

# Adjust log strdup settings
CONFIG_LOG_STRDUP_BUF_COUNT=32
CONFIG_LOG_STRDUP_MAX_STRING=128
```

## overlay-minimal_rcp.conf
```kconfig
#
# Copyright (c) 2021 Nordic Semiconductor
#
# SPDX-License-Identifier: LicenseRef-Nordic-5-Clause
#

# Enable networking
CONFIG_NETWORKING=y

# Enable OpenThread
CONFIG_NET_L2_OPENTHREAD=y

# Set OpenThread Radio Co-Processor architecture
CONFIG_OPENTHREAD_COPROCESSOR=y
CONFIG_OPENTHREAD_COPROCESSOR_RCP=y

# Use basic 802154 service layer
CONFIG_NRF_802154_SL_OPENSOURCE=y

# Use built-in mbedtls
CONFIG_OPENTHREAD_MBEDTLS_CHOICE=y
CONFIG_MBEDTLS_HEAP_SIZE=0

# Disable unnecessary features
CONFIG_BOOT_BANNER=n
CONFIG_ASSERT=n
CONFIG_LOG=n
CONFIG_CONSOLE=n
CONFIG_PRINTK=n
CONFIG_CBPRINTF_NANO=y
CONFIG_GPIO=n
CONFIG_FPU=n
CONFIG_NEWLIB_LIBC=n
CONFIG_MINIMAL_LIBC=y

# Disable certain parts of Zephyr IPv6 stack
CONFIG_NET_IPV6_NBR_CACHE=n
CONFIG_NET_IPV6_MLD=n

# Optimize stacks
CONFIG_OPENTHREAD_THREAD_STACK_SIZE=1024
CONFIG_SYSTEM_WORKQUEUE_STACK_SIZE=512
CONFIG_MAIN_STACK_SIZE=1024
CONFIG_ISR_STACK_SIZE=512
CONFIG_IDLE_STACK_SIZE=256
CONFIG_STACK_SENTINEL=y
CONFIG_NET_TX_STACK_SIZE=256
CONFIG_NET_RX_STACK_SIZE=512

# Optimize buffers
CONFIG_OPENTHREAD_COPROCESSOR_UART_RING_BUFFER_SIZE=1024
CONFIG_OPENTHREAD_PKT_LIST_SIZE=1

CONFIG_NET_PKT_RX_COUNT=1
CONFIG_NET_BUF_RX_COUNT=1
CONFIG_NET_PKT_TX_COUNT=2
CONFIG_NET_BUF_TX_COUNT=2

CONFIG_NET_MAX_CONN=0
CONFIG_NET_MAX_CONTEXTS=0

CONFIG_NET_IF_MAX_IPV6_COUNT=1
CONFIG_NET_IF_UNICAST_IPV6_ADDR_COUNT=1
CONFIG_NET_IF_MCAST_IPV6_ADDR_COUNT=1
CONFIG_NET_IF_IPV6_PREFIX_COUNT=1

CONFIG_NRF_802154_PENDING_SHORT_ADDRESSES=8
CONFIG_NRF_802154_PENDING_EXTENDED_ADDRESSES=8
CONFIG_NRF_802154_RX_BUFFERS=8
```

## overlay-rcp.conf
```kconfig
#
# Copyright (c) 2021 Nordic Semiconductor
#
# SPDX-License-Identifier: LicenseRef-Nordic-5-Clause
#

CONFIG_OPENTHREAD_COPROCESSOR_RCP=y
```

## overlay-usb.conf
```kconfig
#
# Copyright (c) 2021 Nordic Semiconductor
#
# SPDX-License-Identifier: LicenseRef-Nordic-5-Clause
#

CONFIG_USB_DEVICE_STACK=y
CONFIG_USB_CDC_ACM=y
CONFIG_USB_DEVICE_MANUFACTURER="Nordic Semiconductor ASA"
CONFIG_USB_DEVICE_PRODUCT="Thread Co-Processor"
CONFIG_USB_DEVICE_VID=0x1915
CONFIG_USB_DEVICE_PID=0x0000

CONFIG_UART_LINE_CTRL=y
```

## overlay-vendor_hook.conf
```kconfig
#
# Copyright (c) 2020 Nordic Semiconductor
#
# SPDX-License-Identifier: LicenseRef-Nordic-5-Clause
#

CONFIG_OPENTHREAD_COPROCESSOR_VENDOR_HOOK_SOURCE="/src/user_vendor_hook.cpp"
```

## usb.overlay
```dts
/*
 * Copyright (c) 2021 Nordic Semiconductor ASA
 *
 * SPDX-License-Identifier: LicenseRef-Nordic-5-Clause
 */

/ {
	chosen {
		zephyr,ot-uart = &cdc_acm_uart0;
	};
};

&zephyr_udc0 {
	cdc_acm_uart0: cdc_acm_uart0 {
		compatible = "zephyr,cdc-acm-uart";
		label = "CDC_ACM_0";
	};
};
```

## src/main.c
```c
/*
 * Copyright (c) 2020 Nordic Semiconductor ASA
 *
 * SPDX-License-Identifier: LicenseRef-Nordic-5-Clause
 */
#include <zephyr.h>
#include <logging/log.h>

LOG_MODULE_REGISTER(coprocessor_sample, CONFIG_OT_COPROCESSOR_LOG_LEVEL);

#define WELCOME_TEXT                                                           \
	"\n\r"                                                                 \
	"\n\r"                                                                 \
	"=========================================================\n\r"        \
	"OpenThread Coprocessor application is now running on NCS.\n\r"        \
	"=========================================================\n\r"

void main(void)
{
	LOG_INF(WELCOME_TEXT);
}
```

## src/nrf_802154_radio_wrapper.c
```c
/*
 * Copyright (c) 2020 Nordic Semiconductor ASA
 *
 * SPDX-License-Identifier: LicenseRef-Nordic-5-Clause
 */
#include "nrf_802154_radio_wrapper.h"
#include <nrf_802154.h>
#include <device.h>
#include <net/ieee802154_radio.h>

static const struct device *radio_dev;
static struct ieee802154_radio_api *radio_api;

bool nrf_802154_radio_wrapper_auto_ack_get(void)
{
	return nrf_802154_auto_ack_get();
}

void nrf_802154_radio_wrapper_auto_ack_set(bool enabled)
{
	nrf_802154_auto_ack_set(enabled);
}

uint16_t nrf_802154_radio_wrapper_hw_capabilities_get(void)
{
	radio_dev = device_get_binding(CONFIG_NET_CONFIG_IEEE802154_DEV_NAME);
	__ASSERT_NO_MSG(radio_dev != NULL);

	radio_api = (struct ieee802154_radio_api *)radio_dev->api;
	__ASSERT_NO_MSG(radio_api != NULL);

	return radio_api->get_capabilities(radio_dev);
}
```

## src/nrf_802154_radio_wrapper.h
```c
/*
 * Copyright (c) 2020 Nordic Semiconductor ASA
 *
 * SPDX-License-Identifier: LicenseRef-Nordic-5-Clause
 */
#ifndef __NRF_802154_RADIO_WRAPPER_H__
#define __NRF_802154_RADIO_WRAPPER_H__

#include <stdint.h>
#include <stdbool.h>

#ifdef __cplusplus
extern "C" {
#endif

/**
 * Gets current automatic acknowledgments mode state.
 *
 * @return                true when auto ACK is set, false otherwise
 */
bool nrf_802154_radio_wrapper_auto_ack_get(void);

/**
 * Enables or disables the automatic acknowledgments mode (auto ACK).
 *
 * @param[in]  enabled        Value setting (true) or clearing (false)
 *                              auto ACK radio mode.
 */
void nrf_802154_radio_wrapper_auto_ack_set(bool enabled);

/**
 * Gets the device hardware capabilities
 *
 * @return                0 on failure; nonzero hw capabilities value
 *                          on success (@ref ieee802154_hw_caps).
 */
uint16_t nrf_802154_radio_wrapper_hw_capabilities_get(void);

#ifdef __cplusplus
}
#endif

#endif
```

## src/user_vendor_hook.cpp
```c
/*
 * Copyright (c) 2020 Nordic Semiconductor ASA
 *
 * SPDX-License-Identifier: LicenseRef-Nordic-5-Clause
 */
/**
 * @file
 *   This file shows how to implement the NCP vendor hook.
 */
#if OPENTHREAD_ENABLE_NCP_VENDOR_HOOK
#include "nrf_802154_radio_wrapper.h"
#include <logging/log.h>
#include <ncp_base.hpp>
#include <ncp_hdlc.hpp>
#include <common/new.hpp>

#define VENDOR_SPINEL_PROP_VENDOR_NAME SPINEL_PROP_VENDOR__BEGIN
#define VENDOR_SPINEL_PROP_AUTO_ACK_ENABLED SPINEL_PROP_VENDOR__BEGIN + 1
#define VENDOR_SPINEL_PROP_HW_CAPABILITIES SPINEL_PROP_VENDOR__BEGIN + 2

LOG_MODULE_REGISTER(ncp_sample_vendor_hook, CONFIG_OT_COPROCESSOR_LOG_LEVEL);

namespace ot {
namespace Ncp {

otError NcpBase::VendorCommandHandler(uint8_t aHeader, unsigned int aCommand)
{
    otError error = OT_ERROR_NONE;

    LOG_DBG("VendorCommandHandler");

    switch (aCommand)
    {
        // TODO: Implement your command handlers here.

    default:
        error = PrepareLastStatusResponse(aHeader, SPINEL_STATUS_INVALID_COMMAND);
    }

    return error;
}

void NcpBase::VendorHandleFrameRemovedFromNcpBuffer(Spinel::Buffer::FrameTag aFrameTag)
{
    // This method is a callback which mirrors `NcpBase::HandleFrameRemovedFromNcpBuffer()`.
    // It is called when a spinel frame is sent and removed from NCP buffer.
    //
    // (a) This can be used to track and verify that a vendor spinel frame response is
    //     delivered to the host (tracking the frame using its tag).
    //
    // (b) It indicates that NCP buffer space is now available (since a spinel frame is
    //     removed). This can be used to implement reliability mechanisms to re-send
    //     a failed spinel command response (or an async spinel frame) transmission
    //     (failed earlier due to NCP buffer being full).

    OT_UNUSED_VARIABLE(aFrameTag);
}

otError NcpBase::VendorGetPropertyHandler(spinel_prop_key_t aPropKey)
{
    otError error = OT_ERROR_NONE;

    switch (aPropKey)
    {
    case VENDOR_SPINEL_PROP_VENDOR_NAME:
        LOG_DBG("Got NAME get property request");
        error = mEncoder.WriteUtf8("Nordic Seminconductor");
        break;
    case VENDOR_SPINEL_PROP_AUTO_ACK_ENABLED:
        LOG_DBG("Got VENDOR_SPINEL_PROP_AUTO_ACK_ENABLED get property request");
        error = mEncoder.WriteUint8(nrf_802154_radio_wrapper_auto_ack_get());
        break;
    case VENDOR_SPINEL_PROP_HW_CAPABILITIES:
        LOG_DBG("Got VENDOR_SPINEL_PROP_HW_CAPABILITIES get property request");
        error = mEncoder.WriteUint16(nrf_802154_radio_wrapper_hw_capabilities_get());
        break;

        // TODO: Implement your get properties handlers here.
    default:
        error = OT_ERROR_NOT_FOUND;
        break;
    }

    return error;
}

otError NcpBase::VendorSetPropertyHandler(spinel_prop_key_t aPropKey)
{
    otError error = OT_ERROR_NONE;

    switch (aPropKey)
    {
    case VENDOR_SPINEL_PROP_AUTO_ACK_ENABLED: {
            LOG_DBG("Got VENDOR_SPINEL_PROP_AUTO_ACK_ENABLED set property request");

            uint8_t mode = 0;
            SuccessOrExit(error = mDecoder.ReadUint8(mode));
            nrf_802154_radio_wrapper_auto_ack_set(mode);
        }
        break;

        // TODO: Implement your set properties handlers here.
    default:
        error = OT_ERROR_NOT_FOUND;
        break;
    }

exit:
    return error;
}

} // namespace Ncp
} // namespace ot

//------------------------------------------------------------------
// When OPENTHREAD_ENABLE_NCP_VENDOR_HOOK is enabled, vendor code is
// expected to provide the `otNcpInit()` function. The reason behind
// this is to enable vendor code to define its own sub-class of
// `NcpBase` or `NcpHdlc`/`NcpSpi`.
//
// Example below show how to add a vendor sub-class over `NcpHdlc`.

class NcpVendorUart : public ot::Ncp::NcpHdlc
{

    static int SendHdlc(const uint8_t *aBuf, uint16_t aBufLength)
    {
        return mSendCallback(aBuf, aBufLength);
    }

public:
    NcpVendorUart(ot::Instance *aInstance, otNcpHdlcSendCallback aSendCallback)
        : ot::Ncp::NcpHdlc(aInstance, &NcpVendorUart::SendHdlc)
    {
        OT_ASSERT(aSendCallback);
        mSendCallback = aSendCallback;
    }

    // Add public/private methods or member variables
private:
    static otNcpHdlcSendCallback mSendCallback;
};

otNcpHdlcSendCallback NcpVendorUart::mSendCallback;

static OT_DEFINE_ALIGNED_VAR(sNcpVendorRaw, sizeof(NcpVendorUart), uint64_t);


extern "C" void otNcpHdlcInit(otInstance *aInstance, otNcpHdlcSendCallback aSendCallback)
{
    NcpVendorUart *ncpVendor = NULL;
    ot::Instance *instance = static_cast<ot::Instance *>(aInstance);

    ncpVendor = new (&sNcpVendorRaw) NcpVendorUart(instance, aSendCallback);
}
#endif
```
