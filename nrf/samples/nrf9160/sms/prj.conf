## sample.yaml
```
sample:
  name: sms Sample
tests:
  samples.nrf9160.sms:
    build_only: true
    platform_allow: nrf9160dk_nrf9160_ns
    integration_platforms:
      - nrf9160dk_nrf9160_ns
    tags: ci_build
```

## prj.conf
```kconfig
#
# Copyright (c) 2021 Nordic Semiconductor ASA
#
# SPDX-License-Identifier: LicenseRef-Nordic-5-Clause
#
# General config

CONFIG_SMS_SEND_PHONE_NUMBER=""

CONFIG_SMS=y
CONFIG_SMS_SUBSCRIBERS_MAX_CNT=2
CONFIG_SMS_LOG_LEVEL_DBG=n
CONFIG_NEWLIB_LIBC=y
CONFIG_MAIN_STACK_SIZE=1536

# Networking
CONFIG_NETWORKING=y
CONFIG_NET_SOCKETS=y
CONFIG_NET_SOCKETS_OFFLOAD=y
CONFIG_NRF_MODEM_LIB=y
CONFIG_POSIX_API=y

# LTE link control
CONFIG_LTE_LINK_CONTROL=y
CONFIG_LTE_AUTO_INIT_AND_CONNECT=y
CONFIG_LTE_NETWORK_USE_FALLBACK=n

# Debugging
CONFIG_LOG=y
CONFIG_ASSERT=y
CONFIG_ASSERT_VERBOSE=y
```

## src/main.c
```c
/*
 * Copyright (c) 2021 Nordic Semiconductor ASA
 *
 * SPDX-License-Identifier: LicenseRef-Nordic-5-Clause
 */

#include <stdio.h>
#include <kernel.h>
#include <string.h>
#include <modem/sms.h>


static void sms_callback(struct sms_data *const data, void *context)
{
	if (data == NULL) {
		printk("%s with NULL data\n", __func__);
		return;
	}

	if (data->type == SMS_TYPE_DELIVER) {
		/* When SMS message is received, print information */
		struct sms_deliver_header *header = &data->header.deliver;

		printk("\nSMS received:\n");
		printk("\tTime:   %02d-%02d-%02d %02d:%02d:%02d\n",
			header->time.year,
			header->time.month,
			header->time.day,
			header->time.hour,
			header->time.minute,
			header->time.second);

		printk("\tText:   '%s'\n", data->payload);
		printk("\tLength: %d\n", data->payload_len);

		if (header->app_port.present) {
			printk("\tApplication port addressing scheme: dest_port=%d, src_port=%d\n",
				header->app_port.dest_port,
				header->app_port.src_port);
		}
		if (header->concatenated.present) {
			printk("\tConcatenated short message: ref_number=%d, msg %d/%d\n",
				header->concatenated.ref_number,
				header->concatenated.seq_number,
				header->concatenated.total_msgs);
		}
	} else if (data->type == SMS_TYPE_STATUS_REPORT) {
		printk("SMS status report received\n");
	} else {
		printk("SMS protocol message with unknown type received\n");
	}
}

void main(void)
{
	int handle = 0;
	int ret = 0;

	printk("\nSMS sample starting\n");

	handle = sms_register_listener(sms_callback, NULL);
	if (handle) {
		printk("sms_register_listener returned err: %d\n", handle);
		return;
	}

	printk("SMS sample is ready for receiving messages\n");

	/* Sending is done to the phone number specified in the configuration,
	 * or if it's left empty, an information text is printed.
	 */
	if (strcmp(CONFIG_SMS_SEND_PHONE_NUMBER, "")) {
		printk("Sending SMS: number=%s, text=\"SMS sample: testing\"\n",
			CONFIG_SMS_SEND_PHONE_NUMBER);
		ret = sms_send_text(CONFIG_SMS_SEND_PHONE_NUMBER, "SMS sample: testing");
		if (ret) {
			printk("sms_send returned err: %d\n", ret);
		}
	} else {
		printk("\nSMS sending is skipped but receiving will still work.\n"
			"If you wish to send SMS, please configure CONFIG_SMS_SEND_PHONE_NUMBER\n");
	}

	/* In our application, we should unregister SMS in some conditions with:
	 *   sms_unregister_listener(handle);
	 * However, this sample will continue to be registered for
	 * received SMS messages and they can be seen in serial port log.
	 */
}
```
