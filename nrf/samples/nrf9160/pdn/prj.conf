## CMakeLists.txt
```
#
# Copyright (c) 2021 Nordic Semiconductor
#
# SPDX-License-Identifier: LicenseRef-Nordic-5-Clause
#

cmake_minimum_required(VERSION 3.20.0)

find_package(Zephyr REQUIRED HINTS $ENV{ZEPHYR_BASE})
project(pdn)

# NORDIC SDK APP START
target_sources(app PRIVATE src/main.c)
target_sources(app PRIVATE src/esm.c)
# NORDIC SDK APP END
```

## sample.yaml
```
sample:
  name: pdn sample
tests:
  samples.nrf9160.pdn:
    build_only: true
    platform_allow: nrf9160dk_nrf9160_ns
    integration_platforms:
      - nrf9160dk_nrf9160_ns
    tags: ci_build
```

## prj.conf
```kconfig
#
# Copyright (c) 2021 Nordic Semiconductor ASA
#
# SPDX-License-Identifier: LicenseRef-Nordic-5-Clause
#

# Samples default
CONFIG_NCS_SAMPLES_DEFAULTS=y

# Network
CONFIG_NETWORKING=y
CONFIG_NET_NATIVE=n
CONFIG_NET_SOCKETS=y
CONFIG_NET_SOCKETS_OFFLOAD=y

# Modem library
CONFIG_NRF_MODEM_LIB=y

# AT libraries
CONFIG_AT_MONITOR=y
CONFIG_NEWLIB_LIBC=y

# LTE link control
CONFIG_LTE_LINK_CONTROL=y
CONFIG_LTE_AUTO_INIT_AND_CONNECT=n

# PDN library
CONFIG_PDN=y

# Stacks and heaps
CONFIG_HEAP_MEM_POOL_SIZE=1024
CONFIG_MAIN_STACK_SIZE=1536
```

## src/main.c
```c
/*
 * Copyright (c) 2021 Nordic Semiconductor ASA
 *
 * SPDX-License-Identifier: LicenseRef-Nordic-5-Clause
 */

#include <stdio.h>
#include <stdint.h>
#include <zephyr.h>
#include <modem/pdn.h>
#include <modem/lte_lc.h>
#include <nrf_modem_at.h>

extern const char *esm_strerr(int reason);

static const char * const fam_str[] = {
	[PDN_FAM_IPV4V6] = "IPV4V6",
	[PDN_FAM_IPV6] = "IPV6",
	[PDN_FAM_IPV4] = "IPV4",
};

static const char * const event_str[] = {
	[PDN_EVENT_CNEC_ESM] = "ESM",
	[PDN_EVENT_ACTIVATED] = "activated",
	[PDN_EVENT_DEACTIVATED] = "deactivated",
	[PDN_EVENT_IPV6_UP] = "IPv6 up",
	[PDN_EVENT_IPV6_DOWN] = "IPv6 down",
};

void pdn_event_handler(uint8_t cid, enum pdn_event event, int reason)
{
	switch (event) {
	case PDN_EVENT_CNEC_ESM:
		printk("Event: PDP context %d, %s\n", cid, esm_strerr(reason));
		break;
	default:
		printk("Event: PDP context %d %s\n", cid, event_str[event]);
		break;
	}
}

void main(void)
{
	int err;
	int esm;
	uint8_t cid;
	char apn[32];

	printk("PDN sample started\n");

	/* Register to the necessary packet domain AT notifications */
	err = nrf_modem_at_printf("AT+CNEC=16");
	if (err) {
		printk("AT+CNEC=16 failed, err %d\n", err);
		return;
	}

	err = nrf_modem_at_printf("AT+CGEREP=1");
	if (err) {
		printk("AT+CGEREP=1 failed, err %d\n", err);
		return;
	}

	err = pdn_init();
	if (err) {
		return;
	}

	/* Setup a callback for the default PDP context (zero).
	 * Do this before switching to function mode 1 (CFUN=1)
	 * to receive the first activation event.
	 */
	err = pdn_default_callback_set(pdn_event_handler);
	if (err) {
		printk("pdn_default_callback_set() failed, err %d\n", err);
		return;
	}

	err = lte_lc_init_and_connect();
	if (err) {
		return;
	}

	err = pdn_default_apn_get(apn, sizeof(apn));
	if (err) {
		printk("pdn_default_apn_get() failed, err %d\n", err);
		return;
	}

	printk("Default APN is %s\n", apn);

	/* Create a PDP context and assign an event handler to receive events */
	err = pdn_ctx_create(&cid, pdn_event_handler);
	if (err) {
		printk("pdn_ctx_create() failed, err %d\n", err);
		return;
	}

	printk("Created new PDP context %d\n", cid);

	/* Configure a PDP context with APN and Family */
	err = pdn_ctx_configure(cid, apn, PDN_FAM_IPV4V6, NULL);
	if (err) {
		printk("pdn_ctx_configure() failed, err %d\n", err);
		return;
	}

	printk("PDP context %d configured: APN %s, Family %s\n",
	       cid, apn, fam_str[PDN_FAM_IPV4V6]);

	/* Activate a PDN connection */
	err = pdn_activate(cid, &esm, NULL);
	if (err) {
		printk("pdn_activate() failed, err %d esm %d %s\n",
			err, esm, esm_strerr(esm));
		return;
	}

	printk("PDP Context %d, PDN ID %d\n", 0, pdn_id_get(0));
	printk("PDP Context %d, PDN ID %d\n", cid, pdn_id_get(cid));

	lte_lc_power_off();
	printk("Bye\n");
}
```

## src/esm.c
```c
/*
 * Copyright (c) 2021 Nordic Semiconductor ASA
 *
 * SPDX-License-Identifier: LicenseRef-Nordic-5-Clause
 */

#include <stddef.h>
#include <zephyr.h>

/* From the specification:
 * 3GPP TS 24.301 version 8.7.0
 * EMM cause, 9.9.3.9
 */

static const struct {
	int reason;
	const char *str;
} esm_table[] = {
	{ 0x08, "Operator Determined Barring" },
	{ 0x1a, "Insufficient resources" },
	{ 0x1b, "Missing or unknown APN" },
	{ 0x1c, "Unknown PDN type" },
	{ 0x1d, "User authentication failed" },
	{ 0x1e, "Request rejected by Serving GW or PDN GW" },
	{ 0x1f, "Request rejected, unspecified" },
	{ 0x20, "Service option not supported" },
	{ 0x21, "Requested service option not subscribed" },
	{ 0x22, "Service option temporarily out of order" },
	{ 0x23, "PTI already in use" },
	{ 0x24, "Regular deactivation" },
	{ 0x25, "EPS QoS not accepted" },
	{ 0x26, "Network failure" },
	{ 0x27, "Reactivation requested" },
	{ 0x29, "Semantic error in the TFT operation" },
	{ 0x2a, "Syntactical error in the TFT operation" },
	{ 0x2b, "Invalid EPS bearer identity" },
	{ 0x2c, "Semantic errors in packet filter(s)" },
	{ 0x2d, "Syntactical errors in packet filter(s)" },
	{ 0x2e, "Unused" },
	{ 0x2f, "PTI mismatch" },
	{ 0x31, "Last PDN disconnection not allowed" },
	{ 0x32, "PDN type IPv4 only allowed" },
	{ 0x33, "PDN type IPv6 only allowed" },
	{ 0x34, "Single address bearers only allowed" },
	{ 0x35, "ESM information not received" },
	{ 0x36, "PDN connection does not exist" },
	{ 0x37, "Multiple PDN connections for a given APN not allowed" },
	{ 0x38, "Collision with network initiated request" },
	{ 0x39, "PDN type IPv4v6 only allowed" },
	{ 0x3a, "PDN type non IP only allowed" },
	{ 0x3b, "Unsupported QCI value" },
	{ 0x3c, "Bearer handling not supported" },
	{ 0x3d, "PDN type Ethernet only allowed" },
	{ 0x41, "Maximum number of EPS bearers reached" },
	{ 0x42, "Requested APN not supported in current RAT and PLMN combination" },
	{ 0x51, "Invalid PTI value" },
	{ 0x5f, "Semantically incorrect message" },
	{ 0x60, "Invalid mandatory information" },
	{ 0x61, "Message type non-existent or not implemented" },
	{ 0x62, "Message type not compatible with the protocol state" },
	{ 0x63, "Information element non-existent or not implemented" },
	{ 0x64, "Conditional IE error" },
	{ 0x65, "Message not compatible with the protocol state" },
	{ 0x6f, "Protocol error, unspecified" },
	{ 0x70, "APN restriction value incompatible with active EPS bearer context" },
	{ 0x71, "Multiple accesses to a PDN connection not allowed" },
};

const char *esm_strerr(int reason)
{
	for (size_t i = 0; i < ARRAY_SIZE(esm_table); i++) {
		if ((esm_table[i].reason == reason) &&
		    (esm_table[i].str != NULL)) {
			return esm_table[i].str;
		}
	}

	return "<unknown>";
}
```
