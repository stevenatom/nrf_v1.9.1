## prj.conf
```kconfig
#
# Copyright (c) 2021 Nordic Semiconductor ASA
#
# SPDX-License-Identifier: LicenseRef-Nordic-5-Clause
#
CONFIG_ZTEST=y
CONFIG_FPROTECT=y
CONFIG_FPROTECT_APP=y

CONFIG_PM_SINGLE_IMAGE=y
CONFIG_DEBUG_OPTIMIZATIONS=y
# Ensure that flash writes are allowed
CONFIG_FLASH=y
CONFIG_MPU_ALLOW_FLASH_WRITE=y

# Ensure that 'storage' partition is defined, so that we have somewhere legal
# to write.
CONFIG_FLASH_MAP=y
CONFIG_SETTINGS=y
CONFIG_NVS=y

# Set the size of the 'storage' partition so that the 'app' partition is 32kB
# aligned, this should be sufficient for all HW supported by this test.
CONFIG_PM_PARTITION_SIZE_SETTINGS_STORAGE=0x8000
```

## src/main.c
```c
/*
 * Copyright (c) 2021 Nordic Semiconductor ASA
 *
 * SPDX-License-Identifier: LicenseRef-Nordic-5-Clause
 */

#include <ztest.h>
#include <pm_config.h>
#include <device.h>
#include <string.h>
#include <drivers/flash.h>

#define STORAGE_LAST_WORD (PM_SETTINGS_STORAGE_END_ADDRESS - 4)
#define IMAGE_LAST_WORD (PM_APP_END_ADDRESS - 4)

static uint32_t expected_fatal;
static uint32_t actual_fatal;

void k_sys_fatal_error_handler(unsigned int reason, const z_arch_esf_t *pEsf)
{
	printk("Caught system error -- reason %d\n", reason);
	actual_fatal++;
}

static void test_writing_to_app_image(void)
{
	/* Prepare for flash writes */
	int err;
	const struct device *flash_dev;
	static uint8_t val[] = {0xba, 0x53, 0xba, 0x11};

	flash_dev = device_get_binding(PM_APP_DEV_NAME);
	zassert_not_null(flash_dev, "Could not load flash driver");

	printf("Perform a legal flash write to show that it is supported\n");
	err = flash_write(flash_dev, STORAGE_LAST_WORD, val, sizeof(val));
	zassert_equal(err, 0, "Failed when writing to legal flash area");

	zassert_equal(expected_fatal, actual_fatal, "An unexpected fatal error has occurred.\n");
	expected_fatal++;

	printf("Next we write inside the image and expect a failure\n");
	printf("The next lines should be a BUS FAULT\n");
	flash_write(flash_dev, IMAGE_LAST_WORD, val, sizeof(val));
	zassert_unreachable("Should have BUS FAULTed before coming here.");
}

static void test_fatal(void)
{
	zassert_equal(expected_fatal, actual_fatal,
			"The wrong number of fatal error has occurred (e:%d != a:%d).\n",
			expected_fatal, actual_fatal);
}

void test_main(void)
{
	ztest_test_suite(fprotect_test,
			 ztest_unit_test(test_writing_to_app_image),
			 ztest_unit_test(test_fatal)
			 );

	ztest_run_test_suite(fprotect_test);
}
```
