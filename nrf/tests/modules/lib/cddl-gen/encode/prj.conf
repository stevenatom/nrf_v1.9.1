## CMakeLists.txt
```
#
# Copyright (c) 2021 Nordic Semiconductor
#
# SPDX-License-Identifier: LicenseRef-Nordic-5-Clause
#

cmake_minimum_required(VERSION 3.20.0)

find_package(Zephyr REQUIRED HINTS $ENV{ZEPHYR_BASE})
project(test_cddl_gen_encode)

find_program(CDDL_GEN cddl-gen REQUIRED)

set(cddl_gen_args
  -c ${CMAKE_CURRENT_LIST_DIR}/../cddl/test.cddl
  code
  --output-c ${PROJECT_BINARY_DIR}/src/test_encode.c
  --output-h ${PROJECT_BINARY_DIR}/include/test_encode.h
  -t Test
  -e
  )

add_custom_command(
  OUTPUT
  ${PROJECT_BINARY_DIR}/src/test_encode.c
  ${PROJECT_BINARY_DIR}/include/test_encode.h
  DEPENDS
  ${CMAKE_CURRENT_LIST_DIR}/../cddl/test.cddl
  COMMAND
  ${CDDL_GEN} ${cddl_gen_args}
  )

FILE(GLOB app_sources src/*.c)
target_sources(app PRIVATE ${app_sources} ${PROJECT_BINARY_DIR}/src/test_encode.c)
target_include_directories(app PRIVATE ${PROJECT_BINARY_DIR}/include)
```

## prj.conf
```kconfig
#
# Copyright (c) 2021 Nordic Semiconductor ASA
#
# SPDX-License-Identifier: LicenseRef-Nordic-5-Clause
#
CONFIG_ZTEST=y
CONFIG_CDDL_GEN=y
```

## src/main.c
```c
/*
 * Copyright (c) 2021 Nordic Semiconductor ASA
 *
 * SPDX-License-Identifier: LicenseRef-Nordic-5-Clause
 */
#include <ztest.h>
#include "test_encode.h"

static void test_encode(void)
{
	uint8_t payload[32];
	uint32_t payload_len;

	uint8_t first_name[] = "Foo";
	uint8_t last_name[] = "Bar";
	uint8_t time[] = {1, 2, 3, 4, 5, 6, 7, 8};
	struct Test test = {
		._Test_name_tstr = {
			{.value = first_name, .len = sizeof(first_name) - 1},
			{.value = last_name, .len = sizeof(last_name) - 1},
		},
		._Test_name_tstr_count = 2,
		._Test_time = {.value = time, .len = sizeof(time)},
		._Test_types_choice = _Test_types_something,
	};

	bool res = cbor_encode_Test(payload, sizeof(payload), &test, &payload_len);

	zassert_true(res, "Encoding should have been successful\n");
}

void test_main(void)
{
	ztest_test_suite(lib_cddl_gen_test,
	     ztest_unit_test(test_encode)
	 );

	ztest_run_test_suite(lib_cddl_gen_test);
}
```
