## CMakeLists.txt
```
#
# Copyright (c) 2020 Nordic Semiconductor ASA
#
# SPDX-License-Identifier: LicenseRef-Nordic-5-Clause
#

cmake_minimum_required(VERSION 3.20.0)

find_package(Zephyr REQUIRED HINTS $ENV{ZEPHYR_BASE})
project(zigbee_osif_test)

zephyr_compile_definitions(CONFIG_ZBOSS_OSIF_LOG_LEVEL=3)

FILE(GLOB app_sources src/*.c)
target_sources(app
  PRIVATE
  ${app_sources}
  ${NRF_DIR}/subsys/zigbee/osif/zb_nrf_timer.c
)

target_include_directories(app
  PRIVATE
  ${NRF_DIR}/tests/subsys/zigbee/osif/timer/mock
  ${NRF_DIR}/tests/subsys/zigbee/osif/timer/stubs
  ${NRFXLIB_DIR}/zboss/production/include/osif
)
```

## prj.conf
```kconfig
#
# Copyright (c) 2019 Nordic Semiconductor ASA
#
# SPDX-License-Identifier: LicenseRef-Nordic-5-Clause
#

CONFIG_ZTEST=y
CONFIG_COUNTER=y
CONFIG_COUNTER_TIMER2=y
```

## src/main.c
```c
/*
 * Copyright (c) 2019 Nordic Semiconductor ASA
 *
 * SPDX-License-Identifier: LicenseRef-Nordic-5-Clause
 */

#include <ztest.h>

#include <zboss_api.h>
#include <zb_osif_platform.h>

#define ZB_BEACON_INTERVAL_USEC 15360

static zb_uint32_t alarm_counter;

/* mock for timer alarm handler */
void zb_osif_zboss_timer_tick(void)
{
	alarm_counter++;
}

zb_uint32_t GetAlarmCount(void)
{
	return alarm_counter;
}

static void test_zb_osif_timer(void)
{
	ZB_START_HW_TIMER();
	zassert_true(ZB_CHECK_TIMER_IS_ON(), "Counter stopped");

	ZB_STOP_HW_TIMER();
	zassert_false(ZB_CHECK_TIMER_IS_ON(), "Counter running");

	ZB_START_HW_TIMER();
	uint32_t timestamp1 = zb_osif_timer_get();

	k_usleep(500);
	uint32_t timestamp2 = zb_osif_timer_get();

	zassert_true((timestamp2 > timestamp1),
		     "Timer is not incrementing");

	ZB_START_HW_TIMER();
	uint32_t alarm_count = GetAlarmCount();

	k_usleep(ZB_BEACON_INTERVAL_USEC);
	uint32_t new_alarm_count = GetAlarmCount();

	zassert_true((alarm_count != new_alarm_count),
		     "Alarm handler has not occurred");
}

void test_main(void)
{
	ztest_test_suite(osif_test,
			 ztest_unit_test(test_zb_osif_timer)
			 );

	ztest_run_test_suite(osif_test);
}
```
