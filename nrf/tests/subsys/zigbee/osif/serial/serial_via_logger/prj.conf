## CMakeLists.txt
```
#
# Copyright (c) 2020 Nordic Semiconductor ASA
#
# SPDX-License-Identifier: LicenseRef-Nordic-5-Clause
#

cmake_minimum_required(VERSION 3.20.0)

find_package(Zephyr REQUIRED HINTS $ENV{ZEPHYR_BASE})

project(app)
add_definitions(-Wno-packed-bitfield-compat)

zephyr_compile_definitions(CONFIG_ZBOSS_TRACE_HEXDUMP_LOGGING)
zephyr_compile_definitions(CONFIG_ZBOSS_TRACE_LOGGER_BUFFER_SIZE=1024)

zephyr_include_directories(${NRFXLIB_DIR}/zboss/production/include)
zephyr_include_directories(${NRFXLIB_DIR}/zboss/production/include/osif)
target_include_directories(app BEFORE PRIVATE mock)

target_sources(app PRIVATE
  ${NRF_DIR}/subsys/zigbee/osif/zb_nrf_logger.c
  ${NRF_DIR}/subsys/zigbee/osif/zb_nrf_serial.c
  src/main.c
  mock/log_mock.c
)
```

## prj.conf
```kconfig
#
# Copyright (c) 2020 Nordic Semiconductor ASA
#
# SPDX-License-Identifier: LicenseRef-Nordic-5-Clause
#

CONFIG_ZTEST=y
CONFIG_RING_BUFFER=y
```

## src/main.c
```c
/*
 * Copyright (c) 2020 Nordic Semiconductor ASA
 *
 * SPDX-License-Identifier: LicenseRef-Nordic-5-Clause
 */


#define ZB_HAVE_SERIAL
#define ZB_DONT_NEED_TRACE_FILE_ID
#define ZB_TRACE_LEVEL 4
#define ZB_TRACE_MASK  0x00000800

#include <zephyr/types.h>
#include <ztest.h>
#include <zboss_api.h>
#include "log_mock.h"


static uint8_t test_logger_data[] = {1, 2, 3, 4, 5, 6, 7, 8, 9, 10,
				  11, 12, 13, 14, 15, 16, 17, 18};


static void test_logger(void)
{
	int32_t i;

	zb_osif_serial_put_bytes(test_logger_data,
				 ARRAY_SIZE(test_logger_data));
	zb_osif_serial_flush();

	zassert_equal(log_mock_get_buf_len(),
		      ARRAY_SIZE(test_logger_data),
		      "data length error");

	for (i = 0; i < log_mock_get_buf_len(); i++) {
		zassert_equal(log_mock_get_buf_data(i),
			      test_logger_data[i],
			      "data compare error");
	}
}

void test_main(void)
{
	ztest_test_suite(nrf_osif_logger_tests,
			 ztest_unit_test(test_logger)
	);

	ztest_run_test_suite(nrf_osif_logger_tests);
}
```
