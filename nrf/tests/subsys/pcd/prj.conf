## CMakeLists.txt
```
#
# Copyright (c) 2020 Nordic Semiconductor
#
# SPDX-License-Identifier: LicenseRef-Nordic-5-Clause
#

cmake_minimum_required(VERSION 3.20.0)

find_package(Zephyr REQUIRED HINTS $ENV{ZEPHYR_BASE})

# This check is needed since CMake does not fail when performing
# 'set_source_files_properties' to a source file which does not exist.
set(pcd_dir ${ZEPHYR_BASE}/../nrf/subsys/pcd)
set(pcd_source ${pcd_dir}/src/pcd.c)
if (NOT EXISTS ${pcd_source})
  message(FATAL_ERROR "Unable to find source being tested")
endif()

# Set 'CONFIG_MCUBOOT' in order to include code which is conditionally included.
set_source_files_properties(
  ${pcd_source}
  DIRECTORY ${pcd_dir}
  PROPERTIES COMPILE_DEFINITIONS
  "CONFIG_MCUBOOT")

project(pcd_test)

FILE(GLOB app_sources src/*.c)

target_sources(app PRIVATE ${app_sources})
```

## prj.conf
```kconfig
#
# Copyright (c) 2020 Nordic Semiconductor ASA
#
# SPDX-License-Identifier: LicenseRef-Nordic-5-Clause
#
CONFIG_ZTEST=y
CONFIG_FLASH=y
CONFIG_DEBUG_OPTIMIZATIONS=y
CONFIG_PCD_APP=y
CONFIG_BOARD_ENABLE_CPUNET=y
CONFIG_ZTEST_STACKSIZE=2048
CONFIG_PARTITION_MANAGER_ENABLED=y
```

## src/main.c
```c
/*
 * Copyright (c) 2020 Nordic Semiconductor ASA
 *
 * SPDX-License-Identifier: LicenseRef-Nordic-5-Clause
 */

#include <ztest.h>
#include <string.h>
#include <stdbool.h>
#include <zephyr/types.h>
#include <devicetree.h>
#include <drivers/flash.h>
#include <dfu/pcd.h>

#define BUF_LEN ((32*1024) + 10) /* Some pages, and then some */

/* Only 'a' */
static const uint8_t data[BUF_LEN] = {[0 ... BUF_LEN - 1] = 'a'};

static void test_pcd_network_core_update(void)
{
	enum pcd_status status;
	int err;

	/* Since image does not have fw_info the update will fail */
	err = pcd_network_core_update(&data, sizeof(data));
	zassert_not_equal(err, 0, "Unexpected success");

	status = pcd_fw_copy_status_get();
	zassert_equal(status, PCD_STATUS_COPY_FAILED, "Unexpected success");
}


void test_main(void)
{
	ztest_test_suite(pcd_test,
			 ztest_unit_test(test_pcd_network_core_update)
			 );

	ztest_run_test_suite(pcd_test);
}
```
